## dts/bindings/crypto/linkedsemi,crypto.yaml
```yaml
# Copyright (c) 2024, linkedsemi
# SPDX-License-Identifier: Apache-2.0

description: linkedsemi CRYPTO

compatible: "linkedsemi,crypto"

include: [base.yaml]
```

## dts/bindings/flash_controller/vnd,linkedsemi-flash-controller.yaml
```yaml
description: vnd linkedsemi flash controller

compatible: "vnd,linkedsemi-flash-controller"

include: flash-controller.yaml
```

## dts/bindings/gpio/linkedsemi,ls-gpio.yaml
```yaml
# Copyright (c) 2023 Linkedsemi
# SPDX-License-Identifier: Apache-2.0

description: Linkedsemi LS GPIO node

compatible: "linkedsemi,ls-gpio"

include: [gpio-controller.yaml, base.yaml]

properties:
    reg:
      required: true

    "#gpio-cells":
      const: 2

gpio-cells:
  - pin
  - flags
```

## dts/bindings/gpio/linkedsemi,lsqsh-gpio.yaml
```yaml
# Copyright (c) 2024 Linkedsemi
# SPDX-License-Identifier: Apache-2.0

description: Linkedsemi LSQSH GPIO node

compatible: "linkedsemi,lsqsh-gpio"

include: [gpio-controller.yaml, base.yaml]

properties:
    reg:
      required: true

    "#gpio-cells":
      const: 2

gpio-cells:
  - pin
  - flags
```

## dts/bindings/i2c/le501x-i2c.yaml
```yaml
# Copyright (c) 2017 I-SENSE group of ICCS
# SPDX-License-Identifier: Apache-2.0

description: LE501X I2C  controller

compatible: "le501x-i2c"

include: [i2c-controller.yaml, pinctrl-device.yaml]

properties:
    reg:
      required: true

    interrupts:
      required: true

    pinctrl-0:
      required: true

    pinctrl-names:
      required: true
```

## dts/bindings/interrupt-controller/ls,riscv,e906-intc.yaml
```yaml
# Copyright (c) 2019, Linaro Limited
# SPDX-License-Identifier: Apache-2.0

description: RISC-V CPU interrupt controller

compatible: "ls,riscv,e906-intc"

include: [interrupt-controller.yaml, base.yaml]

properties:
  "#interrupt-cells":
    const: 2

interrupt-cells:
  - irq
  - priority
```

## dts/bindings/mdio/snps,dwmac-mdio.yaml
```yaml
# Copyright (c) 2024 BayLibre, SAS
# Copyright (c) 2024 Analog Devices Inc.
# SPDX-License-Identifier: Apache-2.0

description: SNPS DWMAC MDIO Features

compatible: "snps,dwmac-mdio"

include: [mdio-controller.yaml, pinctrl-device.yaml]
```

## dts/bindings/misc/linkedsemi,spid.yaml
```yaml
# Copyright (c) 2024, linkedsemi
# SPDX-License-Identifier: Apache-2.0

description: linkedsemi SPID

compatible: "linkedsemi,spid"

include: [base.yaml, pinctrl-device.yaml]
```

## dts/bindings/pinctrl/linkedsemi,ls-pinctrl.yaml
```yaml
# Copyright (c) 2023 Linkedsemi
# SPDX-License-Identifier: Apache-2.0

description: |
  The linkedsemi LS pin controller is responsible for connecting peripheral outputs
  to specific port/pins (also known as alternate functions) and configures pin properties.

  The pinctrl settings are referenced in a device tree peripheral node. For example in a UART
  node:

  &uart {
      compatible = "linkedsemi,ls-uart";
      pinctrl-0 = <&uart1_tx_pb00 &uart1_rx_pb01>;
      pinctrl-names = "default";
      ...
  };

  The pre-defined nodes only set the alternate function of the output pin. The
  configuration for the pin (i.e. drive strength) should be set in the board setup.
  The set of possible configurations are defined in the properties section below (in addition
  to the inherited property-allowlist list from pincfg-node.yaml).

  To create a new pin configuration, the user may append to the &pinctrl node, for example

  #include <zephyr/dt-bindings/pinctrl/ls-pinctrl.h>
  &pinctrl {
      my_node_config: my_node_config {
      pinmux = <LS_PINMUX_SET(A, 01, ALTERNATE_FUNCTION)>;
        ... other supported pin configurations ..
  };
  where LS_PINMUX_SET(PORT, PIN, ALTERNATE_FUNCTION) is a helper macro for setting the
  alternate function for a given port/pin. 

compatible: "linkedsemi,ls-pinctrl"

include: base.yaml

child-binding:
    description: Each child node defines the configuration for a particular state.

    include:
      - name: pincfg-node.yaml
        property-allowlist:
          - bias-pull-down
          - bias-pull-up
          - drive-push-pull
          - drive-open-drain
          - input-enable
          - output-enable
          - output-high
          - output-low

    properties:
        pinmux:
          description: |
            Encodes port/pin and alternate function. See helper macro LS_PINMUX_SET().
            To simplify the usage, macro is available to generate "pinmux" field.
            This macro is available here:
              -include/zephyr/dt-bindings/pinctrl/ls-pinctrl.h
            Some examples of macro usage:
               GPIO A9 set as alernate function UART1_TXD
            ... {
                     pinmux = <LS_PINMUX_SET('A', 9, UART1_TXD)>;
            };
          required: true
          type: int

        drive-strength:
          description: |
            Drive strength of the output pin. Following options as in io_drive_type_t
            See ls_soc_gpio.h. Default to 1/4 max driver.
          type: string
          default: "1/4 max driver"
          enum:
            - "1/4 max driver"          
            - "1/4 max driver"
            - "1/2 max driver"
            - "max driver"
```

## dts/bindings/sdhc/linkedsemi,sdhci.yaml
```yaml
# Copyright 2024, LIKEDSEMI
# SPDX-License-Identifier: Apache-2.0

description: LIKEDSEMI SDHC

compatible: "linkedsemi,sdhci"

include: [sdhc.yaml, pinctrl-device.yaml]
```

## dts/bindings/serial/le501x_uart.yaml
```yaml
description: LE501X UART

compatible: "le501x-uart"

include: uart-controller.yaml

properties:
    reg:
      required: true

    current-speed:
      required: true

    interrupts:
      required: false
```

## dts/bindings/serial/linkedsemi_uart.yaml
```yaml
description: LINKEDSEMI UART

compatible: "linkedsemi-uart"

include: [uart-controller.yaml,pinctrl-device.yaml]

properties:
    reg:
      required: true

    current-speed:
      required: true

    interrupts:
      required: false

    # pinctrl-0:
    #   required: true

    # pinctrl-names:
    #   required: true
```

## dts/bindings/smbus/linkedsemi,smbus.yaml
```yaml
# Copyright (c) 2023 SILA Embedded Solutions GmbH
# SPDX-License-Identifier: Apache-2.0

description: LINKEDSEMI SMBus controller

compatible: "linkedsemi,smbus"

include: [smbus-controller.yaml, pinctrl-device.yaml]

properties:
  i2c:
    type: phandle
    required: true
    description: I2C device which maps to the same address
```

## dts/bindings/spi/linkedsemi,ls-spi.yaml
```yaml
# Copyright (c) 2023 LinkedSemi.
# SPDX-License-Identifier: Apache-2.0

description: LinkedSemi LS SPI

compatible: "linkedsemi,ls-spi"

include: [spi-controller.yaml, pinctrl-device.yaml]

properties:
  reg:
    required: true

  interrupts:
    required: false
```

## dts/bindings/timer/linkedsemi,machine-timer.yaml
```yaml
# Copyright (c) 2022 Nordic Semiconductor ASA
# SPDX-License-Identifier: Apache-2.0

description: |
  linkedsemi Machine Timer

  The linkedsemi machine timer provides RISC-V privileged mtime and mtimecmp
  registers.

compatible: "linkedsemi,machine-timer"

include: base.yaml

properties:
  reg:
    required: true

  interrupts:
    required: true
```

## samples/linkedsemi/adc/adc_mutil_channel/sample.yaml
```yaml
sample:
  description: adc sample, the simplest Zephyr
    application
  name: adc_test
common:
  tags: introduction
  integration_platforms:
    - native_sim
  harness: console
  harness_config:
    type: one_line
    regex:
      - "Multi-channel adc testing! (.*)"
tests:
  sample.basic.helloworld:
    tags: introduction
```

## samples/linkedsemi/adc/adc_signal_channel/sample.yaml
```yaml
sample:
  description: adc sample, the simplest Zephyr
    application
  name: adc_test
common:
  tags: introduction
  integration_platforms:
    - native_sim
  harness: console
  harness_config:
    type: one_line
    regex:
      - "Single-channel adc test! (.*)"
tests:
  sample.basic.helloworld:
    tags: introduction
```

## samples/linkedsemi/bhs_bmc_ready_shell_module/boards/lsqsh_evb_cpu0.conf
```kconfig
CONFIG_GPIO=y
CONFIG_ESPI=y
CONFIG_KCS=y
CONFIG_IPMI=y

CONFIG_SHELL_STACK_SIZE=4096
CONFIG_LOG_PROCESS_THREAD_STACK_SIZE=4096
CONFIG_TEST_EXTRA_STACK_SIZE=4096
```

## samples/linkedsemi/bhs_espi_peci/boards/lsqsh_evb_cpu1.conf
```kconfig
CONFIG_GPIO=y
CONFIG_GPIO_LINKEDSEMI_SGPIOM=y
CONFIG_ESPI=y
CONFIG_KCS=y
CONFIG_IPMI=y

CONFIG_SHELL=y

CONFIG_SHELL_STACK_SIZE=4096
CONFIG_LOG_PROCESS_THREAD_STACK_SIZE=4096
CONFIG_TEST_EXTRA_STACK_SIZE=4096

CONFIG_PECI=y
```

## samples/linkedsemi/crypto/aes256/Kconfig
```kconfig
mainmenu "test"

config CRYPTO_MBEDTLS_SHIM
	bool "MbedTLS shim driver [EXPERIMENTAL]"
	select MBEDTLS
	select MBEDTLS_ENABLE_HEAP
	select MBEDTLS_SHA512
	select MBEDTLS_CIPHER_AES_ENABLED
	select EXPERIMENTAL
	help
	  Enable mbedTLS shim layer compliant with crypto APIs. You will need
	  to fill in a relevant value to CONFIG_MBEDTLS_HEAP_SIZE.

config CRYPTO_MBEDTLS_SHIM_DRV_NAME
	string "Device name for mbedTLS Pseudo device"
	default "CRYPTO_MTLS"
	# depends on CRYPTO_MBEDTLS_SHIM
	help
	  Device name for mbedTLS Pseudo device.

config CRYPTO_MBEDTLS_SHIM_MAX_SESSION
	int "Maximum of sessions mbedTLS shim driver can handle"
	default 2
	# depends on CRYPTO_MBEDTLS_SHIM
	help
	  This can be used to tweak the amount of sessions the driver
	  can handle in parallel.

source "Kconfig.zephyr"
```

## samples/linkedsemi/subsys/fs/format/boards/lsqsh_evb_cpu1.conf
```kconfig
CONFIG_DISK_ACCESS=y
CONFIG_DISK_DRIVERS=y
CONFIG_DISK_DRIVER_MMC=y

CONFIG_DEBUG=y
CONFIG_LOG=y
CONFIG_LOG_MODE_MINIMAL=y

CONFIG_FILE_SYSTEM=y
CONFIG_FILE_SYSTEM_MKFS=y
CONFIG_FILE_SYSTEM_LITTLEFS=n
CONFIG_FAT_FILESYSTEM_ELM=y

CONFIG_FS_LITTLEFS_BLK_DEV=n
CONFIG_FS_LITTLEFS_FMP_DEV=n

CONFIG_FLASH=n
CONFIG_FLASH_MAP=n
```

## samples/linkedsemi/wolfssh_server/Kconfig
```kconfig
config WOLFSSHPORT
	int "WOLFSSHPORT"
	default 22
	help
	  WOLFSSHPORT

config SSH_SERVER_BACKEND_STACK_SIZE
	int "SSH_SERVER_BACKEND_STACK_SIZE"
	default 32768
	help
	  SSH_SERVER_BACKEND_STACK_SIZE

config SSH_SERVER_RING_BUF_SIZE
	int "SSH_SERVER_RING_BUF_SIZE"
	default 10240
	help
	  SSH_SERVER_RING_BUF_SIZE

config SHELL_BACKEND_WOLFSSH_INIT_PRIORITY
	int "Initialization priority"
	default 95
	range 0 99
	help
	  Initialization priority for wolfssh shell backend.

config SHELL_PROMPT_SSH
	string "Displayed prompt name"
	default "$ "
	help
	  Displayed prompt name for WOLFSSH backend. If prompt is set, the shell will
	  send two newlines during initialization.

config SHELL_BACKEND_WOLFSSH_LOG_LEVEL_DEFAULT
	bool "System limit (LOG_MAX_LEVEL)"
	default y
	help
	  LOG_LEVEL_DEFAULT

config SHELL_BACKEND_WOLFSSH_LOG_LEVEL_DBG
	bool "Debug"
	default n
	help
	  LOG_LEVEL_DBG

config SHELL_BACKEND_WOLFSSH_LOG_LEVEL_INF
	bool "Info"
	default n
	help
	  LOG_LEVEL_INF

config SHELL_BACKEND_WOLFSSH_LOG_LEVEL_WRN
	bool "Warning"
	default n
	help
	  LOG_LEVEL_WRN

config SHELL_BACKEND_WOLFSSH_LOG_LEVEL_ERR
	bool "Error"
	default n
	help
	  LOG_LEVEL_ERR

config SHELL_BACKEND_WOLFSSH_LOG_LEVEL_NONE
	bool "None"
	default n
	help
	  LOG_LEVEL_NONE

config SHELL_BACKEND_WOLFSSH_LOG_LEVEL
	int
	default 0 if SHELL_BACKEND_WOLFSSH_LOG_LEVEL_NONE
	default 1 if SHELL_BACKEND_WOLFSSH_LOG_LEVEL_ERR
	default 2 if SHELL_BACKEND_WOLFSSH_LOG_LEVEL_WRN
	default 3 if SHELL_BACKEND_WOLFSSH_LOG_LEVEL_INF
	default 4 if SHELL_BACKEND_WOLFSSH_LOG_LEVEL_DBG
	default 5 if SHELL_BACKEND_WOLFSSH_LOG_LEVEL_DEFAULT

module = SHELL_BACKEND_WOLFSSH
default-timeout = 100
source "subsys/shell/Kconfig.template.shell_log_queue_timeout"

default-size = 512
source "subsys/shell/Kconfig.template.shell_log_queue_size"

source "Kconfig.zephyr"
```

## samples/net/sockets/http_server/boards/lsqsh_evb_cpu0.conf
```kconfig
CONFIG_STDOUT_CONSOLE=y
CONFIG_NET_L2_ETHERNET=y
CONFIG_NET_MGMT=y
CONFIG_NET_DRIVERS=y

CONFIG_NET_PKT_RX_COUNT=8
CONFIG_NET_PKT_TX_COUNT=8
CONFIG_NET_BUF_RX_COUNT=40
CONFIG_NET_BUF_TX_COUNT=40

CONFIG_NET_IPV6=n
CONFIG_NET_CONFIG_NEED_IPV6=n

CONFIG_MBEDTLS_DEBUG=y
CONFIG_MBEDTLS_HEAP_SIZE=30000


CONFIG_NET_BUF_DATA_SIZE=80
CONFIG_NET_TCP_WORKQ_STACK_SIZE=512
CONFIG_NET_SAMPLE_HTTPS_SERVICE=y
CONFIG_MBEDTLS_KEY_EXCHANGE_PSK_ENABLED=y
CONFIG_NET_SAMPLE_CERTS_WITH_SC=y
```

## soc/arm/linkedsemi_arm/Kconfig
```kconfig
config SOC_FAMILY_LINKEDSEMI_ARM
    bool

if SOC_FAMILY_LINKEDSEMI_ARM

config SOC_FAMILY
    string
    default "linkedsemi_arm"

config SOC_LE5010
    bool "LE5010"

source "soc/arm/linkedsemi_arm/*/Kconfig.soc"

endif # SOC_FAMILY_LINKEDSEMI_ARM
```
