## dts/bindings/crypto/linkedsemi,sha256.yaml
```yaml
description: LINKEDSEMI SHA256

compatible: "linkedsemi,sha256"

include: [base.yaml]
```

## dts/bindings/crypto/linkedsemi,sha512.yaml
```yaml
description: LINKEDSEMI SHA512

compatible: "linkedsemi,sha512"

include: [base.yaml, reset-device.yaml]
```

## dts/bindings/crypto/linkedsemi,sm4.yaml
```yaml
description: LINKEDSEMI SM4

compatible: "linkedsemi,sm4"

include: [base.yaml, reset-device.yaml]
```

## dts/bindings/dma/linkedsemi,dma.yaml
```yaml
# Copyright (c) 2025 linkedsemi. All rights reserved.
# SPDX-License-Identifier: Apache-2.0

description: DMA Controller node

compatible: "linkedsemi,dma"

include: [dma-controller.yaml, reset-device.yaml]

properties:
  reg:
    required: true

  interrupts:
    required: true

  "#dma-cells":
    const: 2

  ctlh-block-ts-mask:
    type: int
    description: |
      Mask of the BLOCK_TS field inside the channel CTRL_HI register. The field
      width is integration dependent: the original DW_ahb_dmac IP uses 17 bits
      (0x1ffff), while some SoC integrations implement fewer, e.g. 11 bits
      (0x7ff). The driver rejects transfers larger than the mask and never
      writes block size bits outside it, so a too large mask would corrupt the
      neighbouring CTRL_HI fields (DONE, CLASS/WEIGHT).

dma-cells:
  - channel
  - handshake
```

## dts/bindings/entropy/linkedsemi,ls-dwtrng.yaml
```yaml
# dts/bindings/entropy/linkedsemi,ls-dwtrng.yaml
# SPDX-License-Identifier: Apache-2.0
description: linkedsemi digital-whitening true random number generator

compatible: "linkedsemi,ls-dwtrng"

include: [base.yaml, reset-device.yaml]

properties:
  reg:
    type: array
    required: true
    description: MMIO base address and size

  interrupts:
    required: true
    description: Independent Watchdog interrupt
  clocks:
    type: phandle-array
    required: false
    description: Optional clock(s) controlling the DWTRNG

  resets:
    type: phandle-array
    required: false
    description: Optional reset line(s) for the DWTRNG block

  status:
    required: true
```

## dts/bindings/espi/linkedsemi,host-bmc-container.yaml
```yaml
description: Linkedsemi espi lpc host bmc container

compatible: "linkedsemi,host-bmc-container"

include: [base.yaml]
```

## dts/bindings/espi/linkedsemi,ls-espi-bmc.yaml
```yaml
description: Linkedsemi eSPI BMC slave

compatible: "linkedsemi,ls-espi-bmc"


properties:

  h2b-vw-base:
    type: int
    required: true

  mbox:
    type: phandle
```

## dts/bindings/espi/linkedsemi,ls-espi.yaml
```yaml
description: Linkedsemi eSPI slave

compatible: "linkedsemi,ls-espi"

include: [espi-controller.yaml, pinctrl-device.yaml, reset-device.yaml]

properties:
  reg:
    required: true

  interrupts:
    required: true

  reset-gpios:
    type: phandle-array
    description: |
      GPIO connected to the host reset signal, active low. A falling-edge
      interrupt is configured on this pin; when it fires, the driver sends
      the eSPI virtual wire SLAVE_BOOT_LOAD_DONE.

  h2b-vw-base:
    type: int
    required: true

  ms-vw-idx:
    type: array

  mbox:
    type: phandle
```

## dts/bindings/espi/linkedsemi,ls-host-kcs.yaml
```yaml
description: Linkedsemi HOST KCS controller

compatible: "linkedsemi,ls-host-kcs"

include: base.yaml

properties:
    port:
      type: array
      required: true

    up-irq:
      type: array

    kcs-env-addr:
      type: int
      required: true

    espi_lpc:
      type: phandle
      required: true
      description: espi lpc device handle
  
    mbox:
      type: phandle
```

## dts/bindings/espi/linkedsemi,ls-host-mmbi.yaml
```yaml
description: Linkedsemi eSPI slave to mmbi

compatible: "linkedsemi,ls-host-mmbi"

include: base.yaml

properties:
    espi_lpc:
      type: phandle
      required: true
      description: espi lpc device handle

    mbox:
      type: phandle

    host-map-addr-hi:
      type: int
      required: true

    host-map-addr-lo:
      type: int
      required: true
```

## dts/bindings/espi/linkedsemi,ls-host-pcc.yaml
```yaml
description: Linkedsemi HOST PCC controller

compatible: "linkedsemi,ls-host-pcc"

include: base.yaml

properties:
    ports:
      type: array
      required: true
      description: |
        I/O port addresses snooped by the eSPI/LPC host interface. Every write
        to one of these ports is captured as a post code.

    pcc-env-addr:
      type: int
      required: true
      description: Address of the shared host_pcc_env post code FIFO

    espi_lpc:
      type: phandle
      required: true
      description: espi lpc device handle

    mbox:
      type: phandle
```

## dts/bindings/espi/linkedsemi,ls-host-vuart.yaml
```yaml
description: LINKEDSEMI Host VUART

compatible: "linkedsemi,ls-host-vuart"

include: [base.yaml, pinctrl-device.yaml, reset-device.yaml]

properties:
  port:
    type: int
    required: true
    description: "Base I/O port address for the host VUART"

  clock-source:
    type: int
    required: true
    description: |
      Clock source subsystem ID used for clock control configuration.
      This value is passed to the clock control subsystem to get the rate.
  
  current-speed:
    type: int
    description: Initial baud rate setting for UART
  
  up-irq:
    type: array
    required: true
    description: "Upstream interrupt specification"

  fifo_base:
    type: int
    required: true
    description: Virtual UART FIFO Base Addr

  espi_lpc:
    type: phandle
    required: true
    description: espi lpc device handle

  mbox:
    type: phandle
```

## dts/bindings/espi/linkedsemi,ls-mmbi.yaml
```yaml
description: Linkedsemi mmbi

compatible: "linkedsemi,ls-mmbi"

include: base.yaml

properties:
    mbox:
      type: phandle
```

## dts/bindings/espi/linkedsemi,ls-port-80.yaml
```yaml
description: Linkedsemi espi slave port 80

compatible: "linkedsemi,ls-port-80"

include: [uart-controller.yaml, pinctrl-device.yaml]

properties:
  port:
    type: int
    required: true
```

## dts/bindings/espi/linkedsemi,ls-sio.yaml
```yaml
description: Linkedsemi eSPI slave to sio

compatible: "linkedsemi,ls-sio"

include: [pinctrl-device.yaml]

properties:
  port:
    type: int
    required: true
```

## dts/bindings/espi/linkedsemi,ls-vuart.yaml
```yaml
description: Linkedsemi eSPI slave to vuart

compatible: "linkedsemi,ls-vuart"

include: [uart-controller.yaml, pinctrl-device.yaml]

properties:
  port:
    type: int
    required: true

  up-irq:
    type: array
    required: true

  uart:
    type: phandle
```

## dts/bindings/ethernet/linkedsemi,ethernet.yaml
```yaml
# Copyright (c) 2020, Linaro Limited
# SPDX-License-Identifier: Apache-2.0

description: LINKEDSEMI Ethernet

compatible: "linkedsemi,ethernet"

include: [ethernet-controller.yaml, pinctrl-device.yaml, reset-device.yaml]

properties:
  clock-frequency:
    type: int
    required: true
    description: |
      clock frequency in Hz

  tx-delay:
    type: int
    description: |
      mac internal tx clock delay

  rx-delay:
    type: int
    description: |
      mac internal rx clock delay

  mdio-handle:
    type: phandle
    description: |
      Specifies a reference to a node representing a MDIO device.
```

## dts/bindings/flash_controller/linkedsemi,ls-flash-controller.yaml
```yaml
description: linkedsemi ls flash controller

compatible: "linkedsemi,ls-flash-controller"

include: [flash-controller.yaml,pinctrl-device.yaml]

properties:
  quad_mode:
    type: boolean

  continuous_mode:
    type: boolean

  mbox:
    type: phandle
```

## dts/bindings/flash_controller/linkedsemi,ls-flash-delegation-client.yaml
```yaml
description: linkedsemi ls flash delegation client

compatible: "linkedsemi,ls-flash-delegation-client"

include: [flash-controller.yaml]

properties:
  mbox:
    type: phandle
    required: true
```

## dts/bindings/flash_controller/linkedsemi,mbox-cpu0-flash-controller.yaml
```yaml
description: linkedsemi ls flash controller

compatible: "linkedsemi,mbox-cpu0-flash-controller"

include: [flash-controller.yaml,pinctrl-device.yaml]

properties:
  mbox:
    type: phandle
    description: mbox consumer
```

## dts/bindings/flash_controller/linkedsemi,mbox-cpu1-flash-controller.yaml
```yaml
description: linkedsemi ls flash controller

compatible: "linkedsemi,mbox-cpu1-flash-controller"

include: [flash-controller.yaml]

properties:
  mbox:
    type: phandle
    description: mbox consumer
```

## dts/bindings/flash_controller/linkedsemi,mbox-cpu2-flash-controller.yaml
```yaml
description: linkedsemi ls flash controller

compatible: "linkedsemi,mbox-cpu2-flash-controller"

include: [flash-controller.yaml]

properties:
  mbox:
    type: phandle
    description: mbox consumer
```

## dts/bindings/hwmon/hwmon-controller.yaml
```yaml
# Copyright (c) 2021, Linaro Limited
# SPDX-License-Identifier: Apache-2.0

# Common fields for hwmon controller

properties:
  "#hwmon-in-cells":
    const: 1
    type: int
    description: Number of items to expect in a hwmon input specifier
  "#hwmon-out-cells":
    const: 1
    type: int
    description: Number of items to expect in a hwmon output specifier

hwmon-in-cells:
  - channel

hwmon-out-cells:
  - channel
```

## dts/bindings/i2c/linkedsemi,ls-i2c.yaml
```yaml
# Copyright (c) 2017 I-SENSE group of ICCS
# SPDX-License-Identifier: Apache-2.0

description: Linkedsemi I2C controller

compatible: "linkedsemi,ls-i2c"

include: [i2c-controller.yaml, pinctrl-device.yaml, reset-device.yaml, hwmon-controller.yaml]

properties:
    reg:
      required: true

    interrupts:
      required: true

    clock-frequency:
      type: int
      description: i2c clock frequency (Hz)
      required: true

    bus-frequency:
      type: int
      enum: [100000, 400000, 1000000]
      description: output clock frequency (Hz)

    scl-overhead-ns:
      type: int
      default: 398
      description: |
        Fixed per-cycle SCL period overhead in nanoseconds caused by bus
        pull-up RC charge/discharge time (board/wiring dependent, independent
        of the prescaler). Subtracted from the target period before deriving
        the TIMINGR values. Default calibrated on LSQSH EVB.

    scl-gpios:
      type: phandle-array
      description: |
        GPIO to which the I2C SCL signal is routed. This is only needed for I2C bus recovery
        support.

    sda-gpios:
      type: phandle-array
      description: |
        GPIO to which the I2C SDA signal is routed. This is only needed for I2C bus recovery
        support.

    pinctrl-noinit:
      type: boolean
      description: |
        do not run pinctrl during init stage
```
