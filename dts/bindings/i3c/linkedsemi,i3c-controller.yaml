## dts/bindings/i3c/linkedsemi,i3c-controller.yaml
```yaml
# Copyright (c) 2019 NXP
# Copyright (c) 2022 Intel Corporation
#
# SPDX-License-Identifier: Apache-2.0

description:  LINKEDSEMI I3C controller

# compatible: "linkedsemi,i3c"

include: [i3c-controller.yaml]

properties:
  reg:
    required: true

  interrupts:
    required: true
```

## dts/bindings/i3c/linkedsemi,i3c.yaml
```yaml
# Copyright (c) 2019 NXP
# Copyright (c) 2022 Intel Corporation
#
# SPDX-License-Identifier: Apache-2.0

description:  LINKEDSEMI I3C CONFIG

compatible: "linkedsemi,i3c"

include: [i3c-controller.yaml]

properties:
  reg:
    required: true

  interrupts:
    required: true

  is-secondary:
    type: boolean
    description: |
      if true, the device is secondary controller(target), 
      otherwise it is the primary controller device

  static-address:
    type: int
    description: |
      Target static address.

  own-dynamic_address:
    type: int
    description: |
      If the local device is the primary controller, the dynamic 
      address  can be directly configured instead of assigned.

  tgt-pid:
    type: array
    description: |
      Target 48-bit Provisioned ID.
      array[0]: PID[47:33] MIPI manufacturer ID.
                PID[32] ID type selector (i'b1 ramdom value, 1'b0 vendor fixed).
      array[1]: PID[31:0] Random value or vendor fixed value.

  dcr:
    type: int
    description: |
      Device Characteristics Register, used for bus enumeration with ENTDAA.

  bcr:
    required: true
    type: int
    description: |
      Bus Characteristics Register, used for bus enumeration with ENTDAA and
      determine device role and capabilities of the device on the bus.

  maximum-write:
    type: int
    default: 4095
    description: |
      Maximum number of bytes that I3C controller may write to I3C target per message.
      Range: 8 to 4095.

  maximum-read:
    type: int
    default: 4095
    description: |
      Maximum number of bytes that I3C controller may read from to I3C target per message.
      Range: 8 to 4095.
```

## dts/bindings/ipmb/linkedsemi,ls-ipmb-target.yaml
```yaml
description: Linkedsemi IPMB Device

compatible: "linkedsemi,ls-ipmb-target"

include: [i2c-device.yaml]
```

## dts/bindings/ipmi/linkedsemi,ls-ipmi-kcs.yaml
```yaml
description: Linkedsemi IPMI over KCS controller

compatible: "linkedsemi,ls-ipmi-kcs"

include: base.yaml

properties:
    kcs_chan:
      type: phandle
      required: true
```

## dts/bindings/jtag/linkedsemi,ls-jtag.yaml
```yaml
description: LINKEDSEMI LS JTAG

compatible: "linkedsemi,ls-jtag"

include: [base.yaml,pinctrl-device.yaml, reset-device.yaml]

properties:
  clock-source:
    type: int
    description: "System clock source"

  bus-frequency:
    type: int
    description: "jtag master bus frequency"

  tx-delay:
    type: int
    default: 0
    description: |
      TXD_CAP_DLY register value (0..31), delay = reg + 1 APB clock
      cycles. Tuned manually per board, no frequency auto-calculation.

  rx-delay:
    type: int
    default: 0
    description: |
      RXD_CAP_DLY register value (0..31), delay = reg + 1 APB clock
      cycles. Tuned manually per board, no frequency auto-calculation.

  tck-gpios:
    type: phandle-array
    description: "tck simulated by gpio"

  tms-gpios:
    type: phandle-array
    description: "tms simulated by gpio"

  tdi-gpios:
    type: phandle-array
    description: "tdi simulated by gpio"

  tdo-gpios:
    type: phandle-array
    description: "tdo simulated by gpio"

  trst-gpios:
    type: phandle-array
    description: "trst simulated by gpio"
```

## dts/bindings/kcs/linkedsemi,ls-kcs.yaml
```yaml
description: Linkedsemi KCS controller

compatible: "linkedsemi,ls-kcs"

include: base.yaml

properties:
    kcs-env-addr:
      type: int
      required: true
    port:
      type: array
      required: true

    mbox:
      type: phandle
```

## dts/bindings/linkedsemi/linkedsemi,emmc-partitions.yaml
```yaml
description: |
  eMMC partition information node for LinkedSemi SoCs.
  This node defines partition layout for eMMC storage including
  coredump region boundaries.

compatible: "linkedsemi,emmc-partitions"

properties:
  mbr-area-size:
    type: int
    required: true
    description: |
      Size of the MBR/Management area in bytes.
      This includes the MBR sector (512 bytes) and reserved sectors.
      Typically 1 MB (1048576 bytes), which equals 2048 sectors.

  user-partition-size:
    type: int
    required: true
    description: |
      Size of the user (FAT32) partition in sectors.
      Each sector is 512 bytes.

  coredump-partition-size:
    type: int
    required: true
    description: |
      Size of the coredump partition in sectors.
      Each sector is 512 bytes.
      Example: 20480 sectors = 10MB
```

## dts/bindings/lpc/linkedsemi,ls-lpc.yaml
```yaml
description: Linkedsemi LPC controller

compatible: "linkedsemi,ls-lpc"

include: [base.yaml, pinctrl-device.yaml, reset-device.yaml]

properties:
  reg:
    required: true

  interrupts:
    required: true
```

## dts/bindings/mbox/linkedsemi,mbox.yaml
```yaml
# Copyright (c) 2021, linkedsemi
# SPDX-License-Identifier: Apache-2.0

description: linkedsemi CPU Mailbox

compatible: "linkedsemi,mbox"

include: [base.yaml, mailbox-controller.yaml]

properties:
  initiator:
    type: int
    required: true
  intr_mask:
    type: int
    description: |
      Interrupt mask register address
  intr_clr:
    type: int
    required: true
    description: |
      Interrupt clear register address
  peer_intr_set:
    type: int
    required: true
    description: |
      Peer pInterrupt set register address

mbox-cells:
  - channel
  - tx_fifo_width
  - tx_fifo_depth
  - rx_fifo_width
  - rx_fifo_depth
```

## dts/bindings/misc/linkedsemi,iopmp.yaml
```yaml
# Copyright (c) 2026 linkedsemi
# SPDX-License-Identifier: Apache-2.0

description: linkedsemi IOPMP controller

compatible: "linkedsemi,iopmp"

include: [base.yaml, reset-device.yaml]

properties:
  reg:
    required: true

  partitions:
    type: phandle
    required: true
    description: Phandle to a fixed-partitions node used as access regions
    required: true
```

## dts/bindings/pcc/linkedsemi,ls-pcc.yaml
```yaml
description: Linkedsemi PCC controller

compatible: "linkedsemi,ls-pcc"

include: base.yaml

properties:
    pcc-env-addr:
      type: int
      required: true
      description: Address of the shared host_pcc_env post code FIFO

    mbox:
      type: phandle
```

## dts/bindings/peci/linkedsemi,ls-peci.yaml
```yaml
# Copyright (c) 2024 LINKEDSEMI Corporation. All Rights Reserved.
# SPDX-License-Identifier: Apache-2.0

description: LINKEDSEMI LS PECI

compatible: "linkedsemi,ls-peci"

include: [peci.yaml, pinctrl-device.yaml, reset-device.yaml]

properties:
  clock-source:
    type: int
    description: "System clock source"

  peci-frequence:
    type: int
    description: "peci bus mafrequence"
```

## dts/bindings/pinctrl/linkedsemi,lsqsh-pinctrl.yaml
```yaml
# Copyright (c) 2023 Linkedsemi
# SPDX-License-Identifier: Apache-2.0

description: |
  The linkedsemi pin controller is responsible for connecting peripheral outputs
  to specific port/pins (also known as alternate functions) and configures pin properties.

  The pinctrl settings are referenced in a device tree peripheral node. For example in a UART
  node:

  &uart {
      compatible = "linkedsemi,ls-uart";
      pinctrl-0 = <&uart1_tx_pb00 &uart1_rx_pb01>;
      pinctrl-names = "default";
      ...
  };

  The pre-defined nodes only set the alternate function of the output pin. The
  configuration for the pin (i.e. drive strength) should be set in the board setup.
  The set of possible configurations are defined in the properties section below (in addition
  to the inherited property-allowlist list from pincfg-node.yaml).

  To create a new pin configuration, the user may append to the &pinctrl node, for example

  #include <zephyr/dt-bindings/pinctrl/lsqsh-pinctrl.h>
  &pinctrl {
      my_node_config: my_node_config {
      pinmux = <LS_PINMUX_SET(A, 01, ALTERNATE_FUNCTION)>;
        ... other supported pin configurations ..
  };
  where LS_PINMUX_SET(PORT, PIN, ALTERNATE_FUNCTION) is a helper macro for setting the
  alternate function for a given port/pin. 

compatible: "linkedsemi,lsqsh-pinctrl"

include: base.yaml

child-binding:
    description: Each child node defines the configuration for a particular state.

    include:
      - name: pincfg-node.yaml
        property-allowlist:
          - bias-pull-down
          - drive-push-pull
          - drive-open-drain
          - output-high
          - output-low
          - input-enable
          - output-enable
          - bias-pull-up

    properties:
        pinmux:
          description: |
            Encodes port/pin and alternate function. See helper macro LS_PINMUX_SET().
            To simplify the usage, macro is available to generate "pinmux" field.
            This macro is available here:
              -include/zephyr/dt-bindings/pinctrl/lsqsh-pinctrl.h
            Some examples of macro usage:
               GPIO A9 set as alernate function UART1_TXD
            ... {
                     pinmux = <LS_PINMUX_SET('A', 9, UART1_TXD)>;
            };
          required: true
          type: int

        drive-strength:
          type: int
          enum: [0, 1, 2, 3, 4, 5, 6, 7]
          default: 0
          description: |
            There are 7 drive strength mode.
            0 ~ 3 are common io driver strength mode.
            5 ~ 7 are sdhc io driver strength mode.
            Default io output drive strength is mode 0.
            For more information please take a look device user guide, datasheet.

        input-1v8-enable:
          type: boolean
          description: |
            enable input on pin (e.g. enable an input buffer, no effect on output)

        bias-pull-up0:
          type: boolean
          description: enable pull-up resistor

        bias-pull-up1:
          type: boolean
          description: enable pull-up resistor

        bias-pull-up2:
          type: boolean
          description: enable pull-up resistor

        lock:
          type: boolean

        gpio:
          type: boolean

        disable-all:
          type: boolean

        st:
          type: boolean

        sl:
          type: boolean

        input-filter:
          type: boolean

        analog:
          type: boolean
```

## dts/bindings/pwm/linkedsemi,ls-pwm.yaml
```yaml
description: PWM controller for Linkedsemi 101x

compatible: "linkedsemi,ls-pwm"

include: [base.yaml, pwm-controller.yaml, pinctrl-device.yaml, reset-device.yaml]

properties:
  reg:
    required: true

  pinctrl-0:
    required: true

  clock-frequency:
    type: int
    required: true

  prescaler:
    type: int
    required: true

  pinctrl-names:
    required: true

  clocks:
    required: true

  "#pwm-cells":
    const: 3

pwm-cells:
  - channel
  - period
  - flags
```

## dts/bindings/reset/linkedsemi,rctl.yaml
```yaml
# Copyright (c) 2025, linkedsemi
# SPDX-License-Identifier: Apache-2.0

compatible: "linkedsemi,rctl"

include: [reset-controller.yaml, base.yaml]

properties:
  "#reset-cells":
    const: 1

reset-cells:
  - id
```

## dts/bindings/rng/linkedsemi,ls-apb-trng.yaml
```yaml
# SPDX-License-Identifier: Apache-2.0
description: Linkedsemi APB ring-oscillator TRNG

compatible: "linkedsemi,ls-apb-trng"

include: [base.yaml, reset-device.yaml]

properties:
  reg:
    required: true
  interrupts:
    required: false
  clocks:
    type: phandle-array
    required: false
  resets:
    type: phandle-array
    required: false
```

## dts/bindings/rtc/aurasemi,au1901c.yaml
```yaml
# Copyright (c) 2026 Linkedsemi Corporation
# SPDX-License-Identifier: Apache-2.0

description: Aurasemi AU1901C I2C RTC

compatible: "aurasemi,au1901c"

include:
  - name: rtc-device.yaml
  - name: i2c-device.yaml

properties:
  reg:
    type: array
    description: I2C device address 0x6F
    required: true
```

## dts/bindings/rtc/dapu,ins5710c.yaml
```yaml
# SPDX-License-Identifier: Apache-2.0
# Copyright (c) 2026 wzou <wzou@linkedsemi.com>

description: Dapu INS5710 RTC

compatible: "dapu,ins5710c"

include:
  - name: rtc-device.yaml
  - name: i2c-device.yaml

properties:
  reg:
    type: array
    description: I2C device address 0x32
    required: true
```

## dts/bindings/rtc/linkedsemi,ls-rtc-timer.yaml
```yaml
# Copyright (c) 2026 Linkedsemi
# SPDX-License-Identifier: Apache-2.0

description: |
  Linkedsemi software RTC using the BSTIM + PIS + GPTIMA chain.

  This is a logical Zephyr RTC device, not a dedicated RTC IP block. There is
  no MMIO reg, interrupt, or clock-frequency property on this node: the driver
  enables BSTIM1, GPTIMA1 and PIS via SYSC_APP_PER and configures the timer
  chain in platform.c. Time offset is stored in SEC_PMU SFT_CTRL[4];
  LSGPTIMA->CNT increments once per second.

compatible: "linkedsemi,ls-rtc-timer"

include: base.yaml
```

## dts/bindings/sensor/ali,psu.yaml
```yaml
# ALI PSU Sensor

compatible: "ali,psu"

include: [sensor-device.yaml, smbus-device.yaml, hwmon-controller.yaml]

properties:
  reg:
    required: true

  alert-gpios:
    type: phandle-array
    description: Alert pin
    # Optional

  smbus-max-frequency:
    type: int
    description: Maximum frequency of the SMBus interface
    default: 100000
```

## dts/bindings/sensor/linkedsemi,caseopen.yaml
```yaml
# Copyright (c) 2026 Linkedsemi
# SPDX-License-Identifier: Apache-2.0

description: |
  Linkedsemi case-open (chassis intrusion) detector.

  Backed by the CASEOPEN_CTRL register in the APP_PMU block. The reg
  property points directly at the CASEOPEN_CTRL register (base 0x4006f000
  + offset 0x44 on QSH).

compatible: "linkedsemi,caseopen"

include: [base.yaml, hwmon-controller.yaml]

properties:
  reg:
    required: true
```

## dts/bindings/sensor/monolithic-power,mp5023.yaml
```yaml
# MP5023 PMBus Sensor

compatible: "monolithic-power,mp5023"

include: [sensor-device.yaml, smbus-device.yaml]

properties:
  reg:
    required: true

  alert-gpios:
    type: phandle-array
    description: Alert pin
    # Optional

  smbus-max-frequency:
    type: int
    description: Maximum frequency of the SMBus interface
    default: 100000
```
