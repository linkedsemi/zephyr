## dts/bindings/serial/linkedsemi,ls-vuart.yaml
```yaml
description: Linkedsemi virtual UART
compatible: "linkedsemi,ls-vuart"

include: [base.yaml]

properties:
  fifo_base:
    type: int
    required: true
    description: Virtual UART FIFO Base Addr

  mbox:
    type: phandle
```

## dts/bindings/serial/linkedsemi,uart-agent.yaml
```yaml
description: Linkedsemi uart agent
compatible: "linkedsemi,uart-agent"

include: [base.yaml]

properties:
  fifo_base:
    type: int
    required: true
    description: Virtual UART FIFO Base Addr

  mbox:
    type: phandle

  uart:
    type: phandle
    required: true
    description: Phandle to the physical UART controller node
```

## dts/bindings/serial/linkedsemi,vuart.yaml
```yaml
description: LINKEDSEMI vUART

compatible: "linkedsemi,vuart"

include: [uart-controller.yaml]

properties:
  reg:
    required: true
```

## dts/bindings/spi/linkedsemi,ls-qspi.yaml
```yaml
# Copyright (c) 2026 LinkedSemi.
# SPDX-License-Identifier: Apache-2.0

description: LinkedSemi QSPIv2 SPI NOR controller

compatible: "linkedsemi,ls-qspi"

include: [spi-controller.yaml, pinctrl-device.yaml, reset-device.yaml]

properties:
  reg:
    required: true

  interrupts:
    required: false

  fifo-depth:
    type: int
    default: 8
    description: |
      QSPI STIG FIFO depth. When FIFO_FLVL equals this value
      the TX FIFO is considered full.

  spi-ctrl-caps-mask:
    type: int
    required: false
    description: |
      SPI flash controller mode/protocol configuration.

      bit 0 : disable 1-1-1
      bit 1 : disable 1-1-1 (fast read)
      bit 8 : disable 1-1-2
      bit 9 : disable 1-2-2
      bit 10: disable 2-2-2
      bit 16: disable 1-1-4
      bit 17: disable 1-4-4
      bit 18: disable 4-4-4

  timing-calibration-disabled:
    type: boolean
    required: false
    description: |
      Disable QSPI controller capture timing calibration.

  timing-calibration-clock-frequency:
    type: int
    required: false
    default: 10000000
    description: |
      Low clock frequency used to read flash and generate the CRC reference
      during capture timing calibration (default 10MHz). The read uses the same
      command and bus mode as the runtime read path (from SFDP / devicetree).

  auto-wait-ready:
    type: boolean
    required: false
    description: |
      After an STIG RDSR read, if the WIP bit is still set, use the QSPI
      hardware AUTO engine to poll status until WIP clears instead of returning
      immediately to software.

  auto-wait-interval:
    type: int
    required: false
    default: 1000
    description: |
      AUTO engine poll interval between RDSR retries when auto-wait-ready is
      enabled. Hardware accepts values up to 0xFFF,
      The time interval between two consecutive WIP checks :time = (auto-wait-interval / 200M)s.
```

## dts/bindings/spi/snps,designware-spi.yaml
```yaml
# Copyright (c) 2018 Synopsys, Inc. All rights reserved.
# Copyright (c) 2023 Meta Platforms All rights reserved.
# SPDX-License-Identifier: Apache-2.0

description: Synopsys DesignWare SPI node

compatible: "snps,designware-spi"

include: [spi-controller.yaml, pinctrl-device.yaml, reset-device.yaml]

properties:
  reg:
    required: true

  interrupts:
    required: true

  aux-reg:
    type: boolean
    description: |
      This value is used for auxiliary register access. For
      other platform, this value should be default 0.

  fifo-depth:
    type: int
    description: |
      RX/TX FIFO depth. Corresponds to the SSI_TX_FIFO_DEPTH
      and SSI_RX_FIFO_DEPTH of the DesignWare Synchronous
      Serial Interface. Depth ranges from 2-256.

  serial-target:
    type: boolean
    description: |
      True if it is a Serial Target. False if it is a Serial
      Master. Corresponds to SSI_IS_MASTER of the Designware
      Synchronous Serial Interface.

  max-xfer-size:
    type: int
    description: |
      Maximum transfer size. Corresponds to SPI_MAX_XFER_SIZE
      of the DesignWare Synchronous Serial Interface. Only
      values of 16 and 32 are supported.
    enum:
      - 16
      - 32

  timing-calibration-disabled:
    type: boolean
    required: false
    description: |
      Disable SPI controller timing calibration capability.

  timing-calibration-auto-detect-content-disable:
    type: boolean
    required: false
    description: |
      Disable SPI controller timing calibration auto detect flash valid content capability.

  timing-calibration-start-offset:
    type: int
    required: false
    description: |
      The flash data offset for timing calibration.
    default: 0

  timing-calibration-clock-frequency:
    type: int
    required: false
    description: |
      low clock frequency for calibration.
    default: 10000000

  spi-ctrl-caps-mask:
    type: int
    required: false
    description: |
      SPI flash controller mode/protocol capability configuration.

      bit 0 : disable 1-1-1
      bit 1 : disable 1-1-1 (fast read)
      bit 8 : disable 1-1-2
      bit 9 : disable 1-2-2
      bit 10: disable 2-2-2
      bit 16: disable 1-1-4
      bit 17: disable 1-4-4
      bit 18: disable 4-4-4
```

## dts/bindings/usb/linkedsemi,ls-fs-usb.yaml
```yaml
# Copyright (c) 2021, Pete Johanson
# SPDX-License-Identifier: Apache-2.0

description: linkedsemi USB Device Controller.

compatible: "linkedsemi,ls-fs-usb"

include: [usb-ep.yaml, reset-device.yaml, pinctrl-device.yaml]

properties:
  reg:
    required: true

  interrupts:
    required: true

  ram-size:
    type: int
    required: true
    description: |
      Size of USB dedicated RAM. STM32 SOC's reference
      manual defines USB packet SRAM size.

  phys:
    type: phandle
    description: PHY provider specifier

  dp-gpios:
    type: phandle-array
```

## dts/bindings/usb/snps,dwc3.yaml
```yaml
# Copyright (c) 2023 Nordic Semiconductor ASA
# SPDX-License-Identifier: Apache-2.0

description: DesignWare USB 3.0 controller

compatible: "snps,dwc3"

include: [base.yaml,reset-device.yaml]

bus: usb

properties:
  reg:
    required: true

  interrupts:
    required: true

  num-in-eps:
    type: int
    required: true
    description: |
      Number of configured OUT endpoints including control endpoint.

  num-out-eps:
    type: int
    required: true
    description: |
      Number of configured IN endpoints including control endpoint.

  phys:
    type: phandle
    description: PHY provider specifier
```

## dts/bindings/watchdog/linkedsemi,ls_iwdg.yaml
```yaml
description: LS Independent Watchdog Timer

compatible: "linkedsemi,ls-watchdog"

include: [base.yaml, reset-device.yaml]

properties:
  reg:
    required: true
    description: "Register address and size"
  interrupts:
    required: true
    description: Independent Watchdog interrupt
  clock-frequency:
    type: int
    required: true
    description: "clock-frequency value for the Independent Watchdog timer"
  clocks:
    required: true
    description: "Independent Watchdog module clock"
```

## modules/fatfs/Kconfig
```kconfig
# Copyright (c) 2022 Nordic Semiconductor ASA
# SPDX-License-Identifier: Apache-2.0

config ZEPHYR_FATFSFS_MODULE
	bool

# Configuration of ELM FAT is found in subsys/fs/Kconfig.fatfs for historic
# reasons.

config ZEPHYR_FATFS_UNIX_MNTPOINT
	bool "Using unix style mount point"
	default n

config ZEPHYR_FATFS_RAM_ALIAS_UNIX
	string "RAM unix style alias in FF_VOLUME_STRS"
	default "RAM"

config ZEPHYR_FATFS_NAND_ALIAS_UNIX
	string "NAND unix style alias in FF_VOLUME_STRS"
	default "NAND"
	
config ZEPHYR_FATFS_CF_ALIAS_UNIX
	string "CF unix style alias in FF_VOLUME_STRS"
	default "CF"

config ZEPHYR_FATFS_SD_ALIAS_UNIX
	string "SD unix style alias in FF_VOLUME_STRS"
	default "SD"
	
config ZEPHYR_FATFS_SD2_ALIAS_UNIX
	string "SD2 unix style alias in FF_VOLUME_STRS"
	default "SD2"

config ZEPHYR_FATFS_USB_ALIAS_UNIX
	string "USB unix style alias in FF_VOLUME_STRS"
	default "USB"

config ZEPHYR_FATFS_USB2_ALIAS_UNIX
	string "USB2 unix style alias in FF_VOLUME_STRS"
	default "USB2"
	
config ZEPHYR_FATFS_USB3_ALIAS_UNIX
	string "USB3 unix style alias in FF_VOLUME_STRS"
	default "USB3"
```

## samples/net/sockets/http_server/boards/lsqsh_evb_cpu1.conf
```kconfig
CONFIG_MAIN_STACK_SIZE=40960
CONFIG_NET_TX_STACK_SIZE=4096
CONFIG_NET_RX_STACK_SIZE=4096
CONFIG_NET_TCP_WORKQ_STACK_SIZE=4096
CONFIG_NET_MGMT_EVENT_STACK_SIZE=4096
CONFIG_HTTP_SERVER_STACK_SIZE=4096
CONFIG_NET_CONNECTION_MANAGER_MONITOR_STACK_SIZE=4096
CONFIG_SYSTEM_WORKQUEUE_STACK_SIZE=4096
CONFIG_STDOUT_CONSOLE=y
CONFIG_NET_L2_ETHERNET=y
CONFIG_NET_MGMT=y
CONFIG_NET_DRIVERS=y

CONFIG_NET_IPV6=n
CONFIG_NET_CONFIG_NEED_IPV6=n

CONFIG_MBEDTLS_DEBUG=y
CONFIG_MBEDTLS_HEAP_SIZE=65000
CONFIG_MBEDTLS_SSL_MAX_CONTENT_LEN=16384

CONFIG_NET_SAMPLE_HTTPS_SERVICE=y
CONFIG_MBEDTLS_KEY_EXCHANGE_PSK_ENABLED=y
CONFIG_NET_SAMPLE_CERTS_WITH_SC=y
```

## samples/net/telnet/boards/lsqsh_evb_cpu1.conf
```kconfig
CONFIG_NET_CONFIG_MY_IPV4_ADDR="192.168.1.123"
CONFIG_MDIO=y
CONFIG_MDIO_SHELL=y

CONFIG_NET_PHY_AUTO_NEGOTIATION=n
CONFIG_NET_PHY_FORCE_100M=y
```

## samples/net/zperf/boards/lsqsh_evb_cpu1.conf
```kconfig
# CONFIG_NET_CONFIG_MY_IPV4_ADDR="192.168.1.123"
CONFIG_NET_CONFIG_MY_IPV4_ADDR="10.10.20.134"
CONFIG_MDIO=y
CONFIG_MDIO_SHELL=y
CONFIG_NEWLIB_LIBC=y
CONFIG_NET_PKT_RX_COUNT=256
CONFIG_NET_PKT_TX_COUNT=256
CONFIG_NET_BUF_RX_COUNT=64
CONFIG_NET_BUF_TX_COUNT=24
CONFIG_NET_BUF_DATA_SIZE=1024
# CONFIG_NET_TCP_MAX_RECV_WINDOW_SIZE=20480
CONFIG_DWMAC_NB_TX_DESCS=24
CONFIG_DWMAC_NB_RX_DESCS=48
# CONFIG_COMPILER_OPT="-O3"
CONFIG_THREAD_ANALYZER=y
# CONFIG_NET_PHY_FORCE_100M=y
# CONFIG_NUM_COOP_PRIORITIES=0
CONFIG_NET_TC_THREAD_PRIO_CUSTOM=y
CONFIG_NET_TC_RX_THREAD_BASE_PRIO=5
CONFIG_NET_TC_TX_THREAD_BASE_PRIO=4
# CONFIG_NET_SOCKETS_SERVICE_THREAD_PRIO=6
CONFIG_PRECISE_EXCEPTION=n
```

## soc/linkedsemi/Kconfig
```kconfig
if SOC_FAMILY_LS_MCU

config ESPI_LPC
    bool
    default y
    select PCC

config ESPI_LPC_MBOX
    bool "espi lpc mbox for dual core cooperation"
    default n
    depends on ESPI_LPC

config ESPI_LPC_HOST_VUART
    bool "Linkedsemi ESPI/LPC HOST VUART"
    default y
    depends on DT_HAS_LINKEDSEMI_LS_HOST_VUART_ENABLED
    depends on ESPI_LPC

    help
        Enable Host-side VUART

config ESPI_LPC_HOST_KCS
    bool "Linkedsemi ESPI/LPC HOST KCS"
    default y
    depends on DT_HAS_LINKEDSEMI_LS_HOST_KCS_ENABLED
    depends on ESPI_LPC

    help
        Enable Host-side KCS

config ESPI_LPC_SIO
    bool "Linkedsemi ESPI/LPC sio driver"
    default y
    depends on DT_HAS_LINKEDSEMI_LS_SIO_ENABLED
    help
        Enable Linkedsemi ESPI/LPC sio driver.

config ESPI_LPC_HOST_MMBI
    bool "Linkedsemi ESPI/LPC mmbi driver"
    default y
    depends on DT_HAS_LINKEDSEMI_LS_HOST_MMBI_ENABLED
    help
        Enable Linkedsemi ESPI/LPC mmbi driver.

config ESPI_LPC_HOST_PCC
    bool "Linkedsemi ESPI/LPC HOST PCC"
    default y
    depends on DT_HAS_LINKEDSEMI_LS_HOST_PCC_ENABLED
    depends on ESPI_LPC

    help
        Enable Host-side PCC

config ESPI_LPC_PCC_FIFO_LENGTH
    int "Linkedsemi ESPI/LPC HOST PCC FIFO length"
    default 128
    depends on ESPI_LPC

    help
        Length of the FIFO for Host-side PCC

config LINKEDSEMI_TPM_WWDT
    bool "LinkedSemi TPM WWDT"
    default n
    depends on SOC_LSQSH

    help
      Enable wwdt1_tpm_init() in lsqsh soc.c
rsource "*/Kconfig"

endif
```

## soc/linkedsemi/ls101x/Kconfig
```kconfig
config SOC_SERIES_LS101X
    select RISCV
  	select XIP
    select TICKLESS_CAPABLE
    select INCLUDE_RESET_VECTOR
    select RISCV_PRIVILEGED
    select BUILD_OUTPUT_HEX
    select CPU_HAS_FPU
    select FPU
    select ARCH_HAS_RAMFUNC_SUPPORT
  	select RISCV_ISA_RV32I
    select RISCV_ISA_EXT_M
    select RISCV_ISA_EXT_A
    select RISCV_ISA_EXT_C
    select RISCV_ISA_EXT_F
    select RISCV_HAS_CLIC
    select RISCV_GP
    select RISCV_ALWAYS_SWITCH_THROUGH_ECALL
    select RISCV_SOC_INTERRUPT_INIT
    select ARCH_HAS_USERSPACE
    select TOOLCHAIN_SUPPORTS_THREAD_LOCAL_STORAGE
    select RISCV_SOC_HAS_CUSTOM_IRQ_HANDLING
    select ATOMIC_OPERATIONS_E906
```

## soc/linkedsemi/ls101x/Kconfig.defconfig
```kconfig
if SOC_SERIES_LS101X

config RISCV_HAS_PLIC
	default n

config RISCV_HAS_CLIC
	default y

config XUANTIE_E906_CLIC
	bool
	default y

config RISCV_MCAUSE_EXCEPTION_MASK
	default 0xfff

config SYS_CLOCK_HW_CYCLES_PER_SEC
	default $(dt_node_int_prop_int,/cpus/cpu@0,clock-frequency)
	
config NUM_IRQS
	default 80

config MAIN_STACK_SIZE
	default 2048

config USERSPACE
	default n

config RISCV_PMP
	default y
	
config PMP_SLOTS
	default 16

config PMP_GRANULARITY
	default 128

config SYSMAP_GRANULARITY
	int
	default 4096

config NOCACHE_GRANULARITY
	int
	default SYSMAP_GRANULARITY

config PMP_NO_NA4
	default y

config RISCV_SOC_HAS_ISR_STACKING
	default y

if SMP

config TICKET_SPINLOCKS
	default y

endif

if SPI_DW
config SPI_EXTENDED_MODES
	default y
endif

config DMA_DW_LLI_POOL_SIZE
	int
	default 2

endif
```

## soc/linkedsemi/lsqsh/Kconfig
```kconfig
config SOC_SERIES_LSQSH
    select RISCV
  	# select XIP
    select TICKLESS_CAPABLE
    select INCLUDE_RESET_VECTOR
    select RISCV_PRIVILEGED
    select CPU_HAS_FPU
    select FPU
    select CPU_HAS_FPU_DOUBLE_PRECISION if !$(dt_path_enabled,/cpus/cpu@1)
    select ARCH_HAS_RAMFUNC_SUPPORT
  	select RISCV_ISA_RV32I
    select RISCV_ISA_EXT_M
    select RISCV_ISA_EXT_A
    select RISCV_ISA_EXT_C
    select RISCV_ISA_EXT_F
    # select RISCV_ISA_EXT_ZICSR
    select RISCV_ISA_EXT_ZIFENCEI
    select RISCV_ISA_EXT_THEAD
    select RISCV_HAS_CLIC
    select RISCV_GP
    select RISCV_ALWAYS_SWITCH_THROUGH_ECALL
    select RISCV_SOC_INTERRUPT_INIT
    select CPU_HAS_DCACHE
    select CPU_HAS_ICACHE
    select ARCH_HAS_NOCACHE_MEMORY_SUPPORT
    select ARCH_HAS_USERSPACE
    select TOOLCHAIN_SUPPORTS_THREAD_LOCAL_STORAGE
    select RISCV_SOC_HAS_CUSTOM_IRQ_HANDLING
```
