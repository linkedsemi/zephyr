## soc/linkedsemi/lsqsh/Kconfig.defconfig
```kconfig
if SOC_SERIES_LSQSH

config SOC
    default "lsqsh"

config RISCV_HAS_PLIC
	default n

config RISCV_HAS_CLIC
	default y

config XUANTIE_E906_CLIC
	bool
	default y

config RISCV_MCAUSE_EXCEPTION_MASK
	default 0xfff

config LSQSH_ARCH_HAS_CUSTOM_BUSY_WAIT
	bool "LSQSH_ARCH_HAS_CUSTOM_BUSY_WAIT"

if LSQSH_ARCH_HAS_CUSTOM_BUSY_WAIT
	config ARCH_HAS_CUSTOM_BUSY_WAIT
		default y
endif

config SYS_CLOCK_HW_CYCLES_PER_SEC
	default $(dt_node_int_prop_int,/cpus/cpu@1,clock-frequency) if $(dt_path_enabled,/cpus/cpu@1)
	default $(dt_node_int_prop_int,/cpus/cpu@2,clock-frequency) if $(dt_path_enabled,/cpus/cpu@2)
	default 0

config NUM_IRQS
	default 176

config ADC
	default y

config CRYPTO
	default y

config DMA
	default y

config ENTROPY_GENERATOR
	default y

config ESPI
	default y

config I2C
	default y

config I3C
	default y

config IPMI
	default y

config JTAG
	default y

config KCS
	default y

config LPC
	default y

config PECI
	default y

config PWM
	default y

config SENSOR
	default y

config SMBUS
	default y

config SPI
	default y

config WATCHDOG
	default y

if MINIMAL_LIBC
	config MINIMAL_LIBC_RAND
		default y
endif

config MAIN_STACK_SIZE
	default 10240

config ISR_STACK_SIZE
	default 4096

config ICACHE_LINE_SIZE
	default 32

config DCACHE_LINE_SIZE
	default 32

config COMPILER_SAVE_TEMPS
	default y

config OUTPUT_DISASSEMBLY
	default y

config NOCACHE_MEMORY
	default y

config RISCV_PMP
	default y

config ASSERT
	default y

config PINCTRL
	default y

config CLOCK_CONTROL
	default y

config RESET
	default y

config GPIO
	default y

config SERIAL
	default y

config CONSOLE
	default y

config UART_CONSOLE
	default y

config XIP
	default y

config CACHE
	default y

config CACHE_MANAGEMENT
	default y

config CACHE_LINKEDSEMI
	default y

config ICACHE_LINE_SIZE_DETECT
	default y

config DCACHE_LINE_SIZE_DETECT
	default y

config IOPMP_LINKEDSEMI
	bool "IOPMP_LINKEDSEMI"
	default n

if IOPMP_LINKEDSEMI

config IOPMP_GRANULARITY
	int "IOPMP_GRANULARITY"
	default 8

config IOPMP_SLOTS
	int "IOPMP_SLOTS"
	default 8

config IOPMP_NO_TOR
	bool "PMP_NO_TOR"
	default n

config IOPMP_NO_NA4
	bool "PMP_NO_NA4"
	default y

config IOPMP_NO_NAPOT
	bool "IOPMP_NO_NAPOT"
	default n

config IOPMP_DEBUG_INIT_DUMP
	bool "IOPMP_DEBUG_INIT_DUMP"
	default n

config IOPMP_DEBUG_WRITE_DUMP
	bool "IOPMP_DEBUG_WRITE_DUMP"
	default n

config IOPMP_LOG_LEVEL
	int "IOPMP_LOG_LEVEL"
	default 3

endif

config RV_BOOT_HART_MRADDR
	hex
	default 0x1000000

choice CACHE_TYPE
	default EXTERNAL_CACHE
endchoice

config SOC_PREP_HOOK
	default y

config SOC_EARLY_INIT_HOOK
	default y

config SOC_LATE_INIT_HOOK
	default y

if SMP

config TICKET_SPINLOCKS
	default y

config ATOMIC_OPERATIONS_E906_SMP
	default y

endif

if NETWORKING

config NET_L2_ETHERNET
	default y

config NET_DRIVERS
	default y

config MDIO
	default y

config MDIO_RESET_MAC
	default y

config NETWORKING_AUTO_INIT
	bool "NETWORKING_AUTO_INIT"
	default y

config NETWORKING_MODULE
	bool "NETWORKING_MODULE"
	default n

endif # NETWORKING

if CACHE
if DCACHE

if NETWORKING
config NET_BUF_ALIGNMENT
	default DCACHE_LINE_SIZE
endif # NETWORKING

if FAT_FILESYSTEM_ELM
config FS_FATFS_WINDOW_ALIGNMENT
	default DCACHE_LINE_SIZE
endif # FAT_FILESYSTEM_ELM

endif # DCACHE
endif # CACHE

config NUM_USE_CPU
	int "running CPU number"
	range 1 2
	default 2

config NUM_OS
	int "running OS number"
	range 1 2
	default 2

if (NUM_USE_CPU=2)
	if $(dt_path_enabled,/cpus/cpu@1)
		config BOOT_CPU2
			bool "BOOT_CPU2"
			default n

	if (NUM_OS=2)
		config FLASH_OP_DELEGATION_SERVER
			default y
	endif # (NUM_OS=2)
endif # (NUM_USE_CPU=2)

	config MBOX
		default y
endif

config CPU2_IMAGE_HEADER
	bool "CPU2_IMAGE_HEADER"
	default n

config CPU2_BOOT_ADDR
	hex "CPU2_BOOT_ADDR"
	default 0x8100000

config FLASH
	default y

config CAP_V2
	default y

config CRC
	default y

config USERSPACE
	default n

config RISCV_PMP
	default y

config PMP_SLOTS
	default 16

config PMP_GRANULARITY
	default 128

config SYSMAP_GRANULARITY
	int
	default 4096

config NOCACHE_GRANULARITY
	int
	default SYSMAP_GRANULARITY

config PMP_NO_NA4
	default y

config RISCV_SOC_HAS_ISR_STACKING
	default y

config PSRAM
	bool "PSRAM"
	default n

config NEWLIB_LIBC_MALLOC_LSQSH
	bool "NEWLIB_LIBC_MALLOC_LSQSH"
	select SYS_HEAP_RUNTIME_STATS
	default n

config NEWLIB_LIBC_MALLOC_TLSF_LSQSH
	bool "NEWLIB_LIBC_MALLOC_TLSF_LSQSH"
	default n

config NEWLIB_LIBC_MALLOC_TLSF_MULIT_LSQSH
	bool "NEWLIB_LIBC_MALLOC_TLSF_MULIT_LSQSH"
	default n

config NEWLIB_LIBC_MALLOC_DEBUG_FOOTER
	bool "NEWLIB_LIBC_MALLOC_DEBUG_FOOTER"
	default n

config NEWLIB_LIBC_MALLOC_DEBUG_FOOTER_RA
	bool "NEWLIB_LIBC_MALLOC_DEBUG_FOOTER_RA"
	default n

config CXX_OPERATOR_NEW_DELETE
	bool "cpp operator new and delete"
	default n

config HEAP_DEBUG_LSQSH
	bool "HEAP_DEBUG_LSQSH"
	default n

config HEAP_DEBUG_RD_LSQSH
	bool "HEAP_DEBUG_RD_LSQSH"
	default n

config HEAP_DEBUG_RECORD_MAX_NUM
	int "HEAP_DEBUG_RECORD_MAX_NUM"
	default 4096

if NEWLIB_LIBC_MALLOC_LSQSH || NEWLIB_LIBC_MALLOC_TLSF_LSQSH || NEWLIB_LIBC_MALLOC_TLSF_MULIT_LSQSH

config NEWLIB_LIBC_MALLOC_ARENA_SIZE
	int "NEWLIB_LIBC_MALLOC_ARENA_SIZE"
	default 0

config NEWLIB_LIBC_MALLOC_ARENA_2_SIZE
	int "NEWLIB_LIBC_MALLOC_ARENA_2_SIZE"
	default 0

config NEWLIB_LIBC_MALLOC_ALIGNMENT
	int "NEWLIB_LIBC_MALLOC_ALIGNMENT"
	default 4

config NEWLIB_LIBC_MALLOC_SECTION_NAME
	string "NEWLIB_LIBC_MALLOC_SECTION_NAME"
	default ".noinit.malloc"

config NEWLIB_LIBC_MALLOC_TIMEOUT_MS
	int "NEWLIB_LIBC_MALLOC_TIMEOUT_MS"
	default 1000000

config NEWLIB_LIBC_MALLOC_PSRAM_BIG_BLOCK_SIZE
	int "NEWLIB_LIBC_MALLOC_PSRAM_BIG_BLOCK_SIZE"
	default 0

config NEWLIB_LIBC_MALLOC_PSRAM_SMALL_BLOCK_SIZE
	int "NEWLIB_LIBC_MALLOC_PSRAM_SMALL_BLOCK_SIZE"
	default 0

config NEWLIB_LIBC_MALLOC_PSRAM_BLOCK_LEVEL
	int "NEWLIB_LIBC_MALLOC_PSRAM_BLOCK_LEVEL"
	default 1024

config NEWLIB_LIBC_CALLOC
	bool "Common C library calloc"
	depends on NEWLIB_LIBC_MALLOC_LSQSH
	default n if MINIMAL_LIBC
	default y
	help
	  Enable the common C library trivial implementation of calloc,
	  which forwards to malloc and memset.

config NEWLIB_LIBC_REALLOCARRAY
	bool "Common C library reallocarray"
	depends on NEWLIB_LIBC_MALLOC_LSQSH
	default n if MINIMAL_LIBC
	default y
	help
	  Enable the common C library trivial implementation of
	  reallocarray, which forwards to realloc.

config COMMON_LIBC_MALLOC
	default n

endif

if POSIX_SINGLE_PROCESS
	config POSIX_UNAME_VERSION_LEN
		default 100
endif

config REBOOT
	default y

config PRECISE_EXCEPTION
	bool "PRECISE_EXCEPTION"
	default n

config IRQ_NESTED
	bool "PRECISE_EXCEPTION"
	default n

config THREAD_ERROR_ISOLATION
	bool "THREAD_ERROR_ISOLATION"
	default y

config QSPI1_FREQ
	int "QSPI1_FREQ"
	default 100000000

config FORCE_CLOCK_HSI
	bool "FORCE_CLOCK_HSI(25MHz)"
	default n

config SHA256_CLOCK_RESET
	bool "SHA256_CLOCK_RESET"
	default n

config SHA512_CLOCK_RESET
	bool "SHA512_CLOCK_RESET"
	default n

config SM4_CLOCK_RESET
	bool "SM4_CLOCK_RESET"
	default n

config AES_CLOCK_RESET
	bool "AES_CLOCK_RESET"
	default n

config VENDER_DEFINE_DMA_DW_LLI_POOL
	bool "VENDER_DEFINE_DMA_DW_LLI_POOL"
	default y

if DMA_DW
	config DMA_DW_LLI_POOL_SIZE
		default 8
endif

if $(dt_path_enabled,/cpus/cpu@1)
	config GPIO_CFG_LOCK
		bool "GPIO_CFG_LOCK"
		default n
		help
		GPIO_CFG_LOCK

	config GPIO_INTR_LOCK
		bool "GPIO_INTR_LOCK"
		default n
		help
		GPIO_INTR_LOCK

	config EMUL_SOFT_RESET
		bool "EMUL_SOFT_RESET"
		default n

endif

config IOPMP_WHITELIST_I2C1_I3C1
	bool "IOPMP_WHITELIST_I2C1_I3C1"
	default n
	help
	IOPMP_WHITELIST_I2C1_I3C1

config POSIX_USLEEP_WORKAROUND
	bool "POSIX_USLEEP_WORKAROUND"
	default y
	help
		POSIX_USLEEP_WORKAROUND

config SD_BUFFER_SIZE_OVERLAY
	int "SD_BUFFER_SIZE_OVERLAY"
	default 512
	help
		SD_BUFFER_SIZE_OVERLAY

config SD_BUFFER_SIZE
	int
	default SD_BUFFER_SIZE_OVERLAY

rsource "otbn/Kconfig.defconfig"
rsource "coredump/Kconfig"

if SPI_DW
	config SPI_EXTENDED_MODES
		default y
endif

if WATCHDOG
	config WDT_RESET_REASON_DETAIL
		bool "WDT_RESET_REASON_DETAIL"
		default y
endif

endif
```

## soc/linkedsemi/lsqsh/Kconfig.soc
```kconfig
config SOC_LSQSH_CPU1
    bool

config SOC_LSQSH_CPU2
    bool

config SOC_LSQSH
    bool
    select SOC_SERIES_LSQSH
    select SOC_LSQSH_CPU1 if $(dt_path_enabled,/cpus/cpu@0)
    select SOC_LSQSH_CPU2 if $(dt_path_enabled,/cpus/cpu@1)

config SOC_SERIES_LSQSH
    bool
    select SOC_FAMILY_LS_MCU

config SOC_SERIES
    default "lsqsh" if SOC_SERIES_LSQSH

config SOC
    default "lsqsh" if SOC_LSQSH
```

## soc/linkedsemi/lsqsh/coredump/Kconfig
```kconfig
# Copyright (c) 2024 LinkedSemi Semiconductor
# SPDX-License-Identifier: Apache-2.0

# config DEBUG_COREDUMP_BACKEND_EMMC
# 	bool "Use eMMC for coredump"
# 	depends on SDHCI_LINKEDSEMI
# 	help
# 	  Core dump is saved directly to eMMC storage.

if DEBUG_COREDUMP_BACKEND_EMMC

config DEBUG_COREDUMP_EMMC_SECTION_SIZE
	int "eMMC section size for coredump operations"
	default 512
	help
	  eMMC block/sector size for coredump read/write operations.
	  Default is 512 bytes (eMMC native block size).

endif # DEBUG_COREDUMP_BACKEND_EMMC

config ZEPHYR_FATFS_UNIX_MNTPOINT
	bool "Enable Unix-style mount point"
	default n
	help
	  Enable Unix-style mount point (e.g., /mnt instead of /mnt:).
	  Must also set the volume alias to match disk-name in device tree.

# Volume alias configurations for FatFs FF_VOLUME_STRS
# Allow customizing volume ID strings for Unix-style mount points

menu "FatFs Volume and Partition Configuration"

config ZEPHYR_FATFS_SD2_ALIAS_UNIX
	string "SD2 volume alias"
	default "SD2"
	help
	  Volume alias for SD2 (pdrv 4). Must match disk-name in device tree.

config ZEPHYR_FATFS_RAM_ALIAS_UNIX
	string "RAM volume alias"
	default "RAM"
	help
	  Volume alias for RAM disk (pdrv 0).

config ZEPHYR_FATFS_NAND_ALIAS_UNIX
	string "NAND volume alias"
	default "NAND"
	help
	  Volume alias for NAND disk (pdrv 1).

config ZEPHYR_FATFS_CF_ALIAS_UNIX
	string "CF volume alias"
	default "CF"
	help
	  Volume alias for CF disk (pdrv 2).

config ZEPHYR_FATFS_SD_ALIAS_UNIX
	string "SD volume alias"
	default "SD"
	help
	  Volume alias for SD card (pdrv 3).

config ZEPHYR_FATFS_USB_ALIAS_UNIX
	string "USB volume alias"
	default "USB"
	help
	  Volume alias for USB disk (pdrv 5).

config ZEPHYR_FATFS_USB2_ALIAS_UNIX
	string "USB2 volume alias"
	default "USB2"
	help
	  Volume alias for USB2 disk (pdrv 6).

config ZEPHYR_FATFS_USB3_ALIAS_UNIX
	string "USB3 volume alias"
	default "USB3"
	help
	  Volume alias for USB3 disk (pdrv 7).

endmenu
```

## soc/linkedsemi/lsqsh/otbn/Kconfig.default
```kconfig
# Common OTBN module configuration

rsource "Kconfig.wolfssl"
rsource "Kconfig.mbedtls"

module = LINKEDSEMI_OTBN
module-str = "LinkedSemi OTBN"
source "subsys/logging/Kconfig.template.log_config"

config LINKEDSEMI_OTBN
	bool
	help
	  Internal flag indicating that the OTBN hardware module is used.
	  Selected automatically when mbedtls or wolfssl OTBN support is enabled.


config LS_OTBN_DELEGATION
	bool
	help
	  Internal flag: the OTBN delegation bus (otbn_delegation.c) is built into
	  this image. Selected by either side below.

config LS_OTBN_DELEGATION_CLIENT
	bool "OTBN delegation: this core sends the requests"
	default n
	select LS_OTBN_DELEGATION
	help
	  Build the OTBN delegation channel in client mode: operations are
	  forwarded over the otbn_crypto mailbox to the peer core, which owns the
	  OTBN. The channel is crypto-library agnostic -- a library's own
	  delegation switch (mbedtls', wolfssl's) selects this one, so
	  applications normally do not set it directly. Note that the client does
	  not need this core's OTBN: only the server side drives it.

config LS_OTBN_DELEGATION_SERVER
	bool "OTBN delegation: this core executes the requests"
	default n
	select LS_OTBN_DELEGATION
	help
	  Build the OTBN delegation channel in server mode: this core answers the
	  peer's requests from its own OTBN, so it needs the local OTBN support of
	  every operation family it is expected to serve.


config LS_OTBN_OPERATION_TIMEOUT_MS
	int "OTBN operation timeout in milliseconds"
	default 15000
	help
	  Maximum time in milliseconds to wait for a non-keygen OTBN operation
	  to complete. This timeout applies to hash, ECDSA, SM2, RSA encrypt/
	  verify/sign/decrypt, and other OTBN commands. Must be large enough
	  for the slowest non-keygen operation on the target platform.

config LS_OTBN_KEYGEN_OPERATION_TIMEOUT_MS
	int "OTBN RSA keygen operation timeout in milliseconds"
	default 180000
	help
	  Maximum time in milliseconds to wait for an RSA key generation
	  operation to complete. RSA keygen involves random prime searching
	  with repeated primality tests and can take much longer than other
	  operations: RSA-2048 keygen worst case is ~72 s, RSA-4096 keygen
	  may take several minutes. This timeout is only used when the active
	  firmware is OTBN_FIRMWARE_RSA_KEYGEN.

config LS_OTBN_RSA_KEYGEN
	bool "OTBN RSA key generation module"
	default n
	select LINKEDSEMI_OTBN
	help
	  Build the OTBN-backed RSA key generation module
	  (otbn_rsa_keygen.c). Enable it for configurations that generate RSA
	  keys; the API is otbn_rsa_keygen() plus the RNG-free helpers declared
	  in otbn_rsa_keygen.h. The module references the RSA keygen firmware
	  image, so enabling it adds that image to the build.
```
