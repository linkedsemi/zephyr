## soc/linkedsemi/lsqsh/otbn/Kconfig.mbedtls
```kconfig
# TLS/DTLS related options

config MBEDTLS_CIPHER_AES_LINKEDSEMI
	bool "LINKEDSEMI's hardware AES"
	default n
	#select MBEDTLS_CIPHER_AES_ENABLED

config MBEDTLS_LINKEDSEMI_OTBN
	bool "LINKEDSEMI's otbn module enable"
	default n
	select LINKEDSEMI_OTBN

config MBEDTLS_SHA224_SHA256_LINKEDSEMI_HARDWARE_ALT
	bool "LINKEDSEMI's hardware sha224 and sha256"
	default n

config MBEDTLS_SM3_LINKEDSEMI_HARDWARE_ALT
	bool "LINKEDSEMI's hardware sm3"
	default n

config MBEDTLS_SHA224_SHA256_LINKEDSEMI_OTBN_ALT
	bool "LINKEDSEMI's otbn module calculate sha224 and sha256"
	default n
	select MBEDTLS_LINKEDSEMI_OTBN
	#select MBEDTLS_ECDSA_C

config MBEDTLS_SM3_LINKEDSEMI_OTBN_ALT
	bool "LINKEDSEMI's otbn module calculate sm3"
	default n
	select MBEDTLS_LINKEDSEMI_OTBN
	#select MBEDTLS_ECDSA_C

config MBEDTLS_ECP_DP_SM2_ENABLED
	bool "SM2 elliptic curve, implementation based on LINKEDSEMI’s OTBN moudle"

choice MBEDTLS_ECDSA_LINKEDSEMI_OTBN_ALT_MODE
	prompt "LINKEDSEMI ECDSA OTBN alternative"
	default MBEDTLS_ECDSA_LINKEDSEMI_OTBN_ALT_NONE
	help
	  Selects what the plain mbedtls_ecdsa_genkey()/sign()/verify() names
	  resolve to. The two hardware entries are mutually exclusive: a core
	  either drives its own OTBN or forwards to the peer core, never both.
	  The delegation client switch stays independent of this choice: whenever
	  it is enabled the explicit mbedtls_ls_otbn_ecdsa_* entry points exist,
	  whichever entry is selected here.

config MBEDTLS_ECDSA_LINKEDSEMI_OTBN_ALT_NONE
	bool "Off - software ECDSA (mbedtls ecdsa.c)"

config MBEDTLS_ECDSA_SECP256R1_SECP384R1_SM2_LINKEDSEMI_OTBN_ALT
	bool "This core's OTBN - P256, P384, SM2, local hardware"
	select MBEDTLS_LINKEDSEMI_OTBN
	#select MBEDTLS_ECP_DP_SECP256R1_ENABLED
	#select MBEDTLS_ECP_DP_SECP384R1_ENABLED

config MBEDTLS_ECDSA_LINKEDSEMI_OTBN_ALT_VIA_DELEGATION
	bool "The peer core's OTBN, reached through the delegation proxy"
	select MBEDTLS_LINKEDSEMI_OTBN_DELEGATION_CLIENT

endchoice

config MBEDTLS_RSA_LINKEDSEMI_OTBN_ALT
	bool "LINKEDSEMI's RSA public/private modexp and keygen using OTBN"
	default n
	select MBEDTLS_LINKEDSEMI_OTBN
	select LS_OTBN_RSA_KEYGEN
	help
	  Off-loads mbedtls_rsa_public(), mbedtls_rsa_private() and
	  mbedtls_rsa_gen_key() to the LINKEDSEMI OTBN RSA firmware.
	  Supports 2048/3072/4096-bit keys. Key generation uses fixed
	  public exponent F4 (65537); other configurations fall back to
	  the software implementation.

config MBEDTLS_LINKEDSEMI_OTBN_DELEGATION
	bool "enable linedsemi's otbn delegation"
	default n

config MBEDTLS_LINKEDSEMI_OTBN_DELEGATION_CLIENT
	bool "Use the mailbox to control the authorization server in order to execute the OTBN ECDSA function of  LINKEDSEMI Company"
	default n
	select MBEDTLS_LINKEDSEMI_OTBN_DELEGATION
	select LS_OTBN_DELEGATION_CLIENT

config MBEDTLS_LINKEDSEMI_OTBN_DELEGATION_SERVER
	bool "The specific implementation of OTBN ECDSA for the LINKEDSEMI Company"
	default n
	select MBEDTLS_LINKEDSEMI_OTBN_DELEGATION
	select LS_OTBN_DELEGATION_SERVER

config MBEDTLS_LINKEDSEMI_OTBN_ECDSA_SLOT_MBOX
	bool "ECDSA signing by private-key slot (key stays on the serving core)"
	depends on MBEDTLS
	depends on MBEDTLS_LINKEDSEMI_OTBN_DELEGATION
	depends on LS_OTBN_DELEGATION_CLIENT || LS_OTBN_DELEGATION_SERVER
	default n
	help
	  Build the slot-based ECDSA signing path. On the requesting core it
	  adds mbedtls_ls_otbn_ecdsa_sign_slot(), which sends only a slot id
	  and the hash; on the serving core it adds
	  ls_otbn_ecdsa_key_slot_register()/_unregister() and keeps the
	  borrowed key pointers in a local table. Enable the same switch on
	  both images.

config LS_OTBN_ECDSA_SLOT_MBOX_COUNT
	int "Number of ECDSA private-key slots on the serving core"
	depends on MBEDTLS_LINKEDSEMI_OTBN_ECDSA_SLOT_MBOX
	depends on LS_OTBN_DELEGATION_SERVER
	default 4
	range 1 16
	help
	  Size of the private-key slot table. Slot ids passed over the
	  delegation channel must be in [0, value - 1].

config MBEDTLS_SHA384_SHA512_LINKEDSEMI_HARDWARE_ALT
	bool "LINKEDSEMI's hardware sha384 and sha512"
	default n
	#select MBEDTLS_SHA512

config MBEDTLS_SHA384_SHA512_LINKEDSEMI_OTBN_ALT
	bool "LINKEDSEMI's otbn module calculate sha384 and sha512"
	default n
	select MBEDTLS_LINKEDSEMI_OTBN
	#select MBEDTLS_SHA512

config MBEDTLS_SM4_LINKEDSEMI_HARDWARE_ALT
	bool "LINKEDSEMI's hardware sm4"
	default n

config MBEDTLS_THREADING_LINKEDSEMI_ALT
	bool "MbedTLS runs in the Zephyr operating system."
	default n
	help
	  "When compiling this file, it will run by
	  default in the zephyr os and requires the
	  thread mode to be enabled."
```
