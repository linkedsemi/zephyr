## boards/arm/le501x_evb/Kconfig.defconfig
```kconfig
if BOARD_LE501X_EVB

config BOARD
	default "le501x_evb"

config FLASH_LOAD_OFFSET
	default 0x26000

config HEAP_MEM_POOL_SIZE
	default 4096

config BT_CTLR
	default n

config BT
	default y

config BT_HAS_HCI_VS
    default y

choice BT_HCI_BUS_TYPE
	default BT_LE501X
	depends on BT
endchoice

config BT_COMPANY_ID
	default 0x093A

endif
```

## boards/arm/le501x_evb/le501x_evb_defconfig
```kconfig
# Copyright (c) 2021 Nordic Semiconductor ASA
# SPDX-License-Identifier: Apache-2.0
CONFIG_SOC_LE5010=y
CONFIG_SOC_SERIES_LE501X=y
CONFIG_BOARD_LE501X_EVB=y
CONFIG_MINIMAL_LIBC_RAND=y
CONFIG_SERIAL=y
CONFIG_SYS_CLOCK_HW_CYCLES_PER_SEC=2000000
CONFIG_BT_NO_DRIVER=y
CONFIG_PM_POLICY_CUSTOM=y
CONFIG_BT_HCI_ACL_FLOW_CONTROL=n
```

## boards/linkedsemi/le501x_evb/Kconfig
```kconfig
if BOARD_LE501X_EVB

config SPI_SNPS_DW
    bool "synopsys designware spi driver"
    depends on SPI

if SPI_DW
config SPI_DW_ACCESS_WORD_ONLY
	default y
endif # SPI_DW

endif
```

## boards/linkedsemi/le501x_evb/Kconfig.board
```kconfig
# Copyright (c) 2021 Nordic Semiconductor ASA
# SPDX-License-Identifier: Apache-2.0

config BOARD_LE501X_EVB
	bool "LE501X EVB"
	depends on SOC_LE5010
```

## boards/linkedsemi/le501x_evb/le501x_evb_defconfig
```kconfig
# Copyright (c) 2023 Linkedsemi
# SPDX-License-Identifier: Apache-2.0


CONFIG_SYS_CLOCK_HW_CYCLES_PER_SEC=2000000
CONFIG_BT_HCI_ACL_FLOW_CONTROL=n
CONFIG_MINIMAL_LIBC=y
CONFIG_MINIMAL_LIBC_RAND=y

CONFIG_PINCTRL=y
CONFIG_GPIO=y
CONFIG_SERIAL=n
CONFIG_USE_SEGGER_RTT=y

CONFIG_CONSOLE=y
CONFIG_RTT_CONSOLE=y
CONFIG_UART_CONSOLE=n
CONFIG_OUTPUT_DISASSEMBLY=y

# Power Management
CONFIG_PM=y
CONFIG_PM_DEVICE=y
CONFIG_PM_POLICY_CUSTOM=y
```

## boards/linkedsemi/lsqsh_app_evb/Kconfig.lsqsh_app_evb
```kconfig
# Copyright (c) 2021, Teslabs Engineering S.L.
# SPDX-License-Identifier: Apache-2.0

config BOARD_LSQSH_APP_EVB
	select SOC_LSQSH
```

## boards/linkedsemi/lsqsh_app_evb/lsqsh_app_evb_defconfig
```kconfig
# Copyright (c) 2023 Linkedsemi
# SPDX-License-Identifier: Apache-2.0


CONFIG_MINIMAL_LIBC=y
CONFIG_MINIMAL_LIBC_RAND=y
CONFIG_MAIN_STACK_SIZE=2048
CONFIG_ISR_STACK_SIZE=4096

CONFIG_PINCTRL=n
CONFIG_GPIO=n

CONFIG_SERIAL=y
CONFIG_CONSOLE=y
CONFIG_UART_CONSOLE=y

CONFIG_SPI=n
CONFIG_I2C=n
CONFIG_XIP=n

CONFIG_MBOX=y
CONFIG_MBOX_LINKEDSEMI=y

CONFIG_CACHE=y
CONFIG_CACHE_MANAGEMENT=y
CONFIG_CACHE_LINKEDSEMI=y
```

## boards/linkedsemi/lsqsh_evb/lsqsh_evb_defconfig
```kconfig
# Copyright (c) 2023 Linkedsemi
# SPDX-License-Identifier: Apache-2.0


CONFIG_MINIMAL_LIBC=y
CONFIG_MINIMAL_LIBC_RAND=y
CONFIG_MAIN_STACK_SIZE=20480
CONFIG_ISR_STACK_SIZE=4096

CONFIG_PINCTRL=y
# CONFIG_GPIO=y

CONFIG_SERIAL=y
CONFIG_CONSOLE=y
CONFIG_UART_CONSOLE=y

CONFIG_SPI=n
CONFIG_XIP=n

# CONFIG_I2C=y
# CONFIG_I2C_TARGET=y
# CONFIG_I2C_EEPROM_TARGET=y
# CONFIG_ASSERT=y

# CONFIG_SMBUS=y
# CONFIG_SMBUS_LINKEDSEMI_SMBALERT=n

# CONFIG_ETH_DRIVER=y
# CONFIG_ETH_DWMAC=y
# CONFIG_NET_L2_ETHERNET=y

# CONFIG_SDHC=y

# CONFIG_PECI=y
```

## boards/riscv/ls101x_evb/Kconfig.board
```kconfig
# Copyright (c) 2021, Teslabs Engineering S.L.
# SPDX-License-Identifier: Apache-2.0

config BOARD_LS101X_EVB
	bool "LS101X EVB"
	depends on SOC_LS1010
```

## boards/riscv/ls101x_evb/Kconfig.defconfig
```kconfig
# Copyright (c) 2021 Teslabs Engineering S.L.
# SPDX-License-Identifier: Apache-2.0

if BOARD_LS101X_EVB

config BOARD
	default "ls101x_evb"

config FLASH_LOAD_OFFSET
	default 0x0

config HEAP_MEM_POOL_SIZE
	default 4096

endif
```

## boards/riscv/ls101x_evb/ls101x_evb_defconfig
```kconfig
# Copyright (c) 2023 Linkedsemi
# SPDX-License-Identifier: Apache-2.0


CONFIG_SOC_SERIES_LS101X=y
CONFIG_SOC_LS1010=y
CONFIG_BOARD_LS101X_EVB=y
CONFIG_FPU=y
CONFIG_SYS_CLOCK_HW_CYCLES_PER_SEC=144000000

CONFIG_MINIMAL_LIBC=y
CONFIG_MINIMAL_LIBC_RAND=y
CONFIG_RISCV_SOC_INTERRUPT_INIT=y
CONFIG_MAIN_STACK_SIZE=2048
CONFIG_RISCV_TRAP_HANDLER_ALIGNMENT=64
CONFIG_ISR_STACK_SIZE=4096
# CONFIG_RISCV_ALWAYS_SWITCH_THROUGH_ECALL=y
# CONFIG_PINCTRL=y
# CONFIG_GPIO=y
CONFIG_SERIAL=y
CONFIG_CONSOLE=y
CONFIG_UART_CONSOLE=y

# CONFIG_I2C_LE501X_INTERRUPT=n

# Power Management
# CONFIG_PM=y
# CONFIG_PM_DEVICE=y
# CONFIG_PM_POLICY_CUSTOM=y
```

## drivers/cache/Kconfig.linkedsemi
```kconfig
# SPDX-License-Identifier: Apache-2.0
#
# Copyright (c) 2022 LINKEDSEMI Technology Inc.

config CACHE_LINKEDSEMI
bool "LINKEDSEMI external cache driver"
	depends on SOC_LSQSH
	select CACHE_HAS_DRIVER
	help
	  This option enables the CACHE driver for LINKEDSEMI QSH series SOC.
```

## drivers/flash/Kconfig.linkedsemi
```kconfig
# Copyright (c) 2023 Linkedsemi
# SPDX-License-Identifier: Apache-2.0

config SOC_FLASH_LINKEDSEMI
	bool "linkedsemi flash driver"
	default y
	depends on DT_HAS_LINKEDSEMI_FLASH_CONTROLLER_ENABLED
	select FLASH_HAS_PAGE_LAYOUT
	select FLASH_HAS_DRIVER_ENABLED
	help
	  Enables linkedsemi flash driver.
```

## drivers/i2c/Kconfig.le501x
```kconfig
config I2C_LE501X
	bool "LE501X I2C driver"
	default y
	depends on DT_HAS_LE501X_I2C_ENABLED
	help
	  Enable support for le501x I2C driver

config I2C_LE501X_INTERRUPT
	bool "LW501X MCU I2C Interrupt Support"
	depends on I2C_LE501X
	default n
	help
	  Enable Interrupt support for the I2C Driver
```

## drivers/kcs/Kconfig
```kconfig
menuconfig KCS
    bool "KCS controller drivers"
    help
      Include KCS controller drivers in the system configuration.

if KCS

source "drivers/kcs/Kconfig.ls"

module = KCS
module-str = kcs
source "subsys/logging/Kconfig.template.log_config"

config KCS_INIT_PRIORITY
    int "KCS controller driver init priority"
    default 10
    help
       KCS controller driver initialization priority.


endif
```

## drivers/lpc/Kconfig
```kconfig
menuconfig LPC
    bool "LPC controller drivers"
    help
      Include LPC controller drivers in the system configuration.

if LPC

source "drivers/lpc/Kconfig.ls"

module = LPC
module-str = lpc
source "subsys/logging/Kconfig.template.log_config"

config LPC_INIT_PRIORITY
    int "LPC controller driver init priority"
    default 3
    help
       LPC controller driver initialization priority.


endif
```

## drivers/misc/linkedsemi/Kconfig
```kconfig
# Copyright (c) 2024 linkedsemi <htliu@linkedsemi.com>
# SPDX-License-Identifier: Apache-2.0

config SPID_LINKEDSEMI
    bool "opentitan SPI device"
    depends on DT_HAS_LINKEDSEMI_SPID_ENABLED
    help
      SPID_LINKEDSEMI.

if SPID_LINKEDSEMI
module = SPID_LINKEDSEMI
module-str = spid_linkedsemi
source "subsys/logging/Kconfig.template.log_config"
endif
```

## drivers/pinctrl/Kconfig.lsqsh
```kconfig
# Copyright (c) 2023 Linkedsemi
# SPDX-License-Identifier: Apache-2.0

config PINCTRL_LSQSH
    bool "linkedsemi lsqsh pinctrl driver"
    default y
    depends on DT_HAS_LINKEDSEMI_LSQSH_PINCTRL_ENABLED
    help
      Enable the linkedsemi ls pinctrl driver
```

## drivers/sdhc/Kconfig.linkedsemi
```kconfig
# Copyright 2022, LINKEDSEMI
# SPDX-License-Identifier: Apache-2.0

config SDHCI_LINKEDSEMI
    bool "LINKEDSEMI SDHCI Driver"
    default y
    depends on DT_HAS_LINKEDSEMI_SDHCI_ENABLED
    select SDHC_SUPPORTS_NATIVE_MODE
    select SDHCI
    select EVENTS
    help
      Enable the LINKEDSEMI SDHCI Host controller driver

if SDHCI_LINKEDSEMI

config SDHCI_LINKEDSEMI_DMA_SUPPORT
    bool "DMA support for SDHCI driver"
    default y
    help
      Enable DMA support for SDHCI driver. May be disabled to reduce
      footprint of driver.

config SDHCI_SDMA_ENABLE
    bool "SDMA support for SDHCI driver"
    depends on SDHCI_LINKEDSEMI_DMA_SUPPORT
    default y

if SDHCI_LINKEDSEMI_DMA_SUPPORT

# SDHCI DMA needs 32 bit aligned buffers
config SDHC_BUFFER_ALIGNMENT
    default 4

config SDHCI_LINKEDSEMI_DMA_BUFFER_SIZE
    int "Size of DMA descriptor buffer in bytes"
    default 512
    help
      Size of SDHCI DMA descriptor buffer in bytes

endif #SDHCI_LINKEDSEMI_DMA_SUPPORT

endif #SDHCI_LINKEDSEMI
```

## drivers/serial/Kconfig.le501x
```kconfig
config UART_LE501X
	default y
	depends on DT_HAS_LE501X_UART_ENABLED
	select SERIAL_HAS_DRIVER
	select SERIAL_SUPPORT_INTERRUPT
	bool "LE501X_EVB serial driver"
	help
	  uart1 enable.
 
```

## dts/bindings/clock/linkedsemi,ls-cctl.yaml
```yaml
# Copyright (c) 2024 LINKEDSEMI Corporation.
# SPDX-License-Identifier: Apache-2.0

description: LINKEDSEMI LS Clock Control

compatible: "linkedsemi,ls-cctl"

include: [clock-controller.yaml, base.yaml]

properties:
  reg:
    required: true

clock-cells:
  - cctl_base_addr
  - set_bit
  - clr_bit
```

## dts/bindings/cpu/linkedsemi,riscv.yaml
```yaml
# Copyright (c) 2024 Linkedsemi
# SPDX-License-Identifier: Apache-2.0

description: Linkedsemi RISC-V CPU

compatible: "linkedsemi,riscv"

include: riscv,cpus.yaml

properties:
  clock-source:
    type: int
    description: cpu clock source
```
