## boards/alibaba/fpga/Kconfig.alimoc30
```kconfig
# Copyright (c) 2024, Alibaba
# SPDX-License-Identifier: Apache-2.0

config BOARD_ALIMOC30
	select SOC_LSQSH
```

## boards/alibaba/fpga/Kconfig.defconfig
```kconfig
# Copyright (c) 2024 Alibaba
# SPDX-License-Identifier: Apache-2.0

if BOARD_ALIMOC30

config FLASH_LOAD_OFFSET
	default 0x0

config HEAP_MEM_POOL_SIZE
	default 4096

config SINGLE_CORE
	bool "Run CMU with single core configurations"
	default n

config STORAGE_MEDIA_FLASH_RW
	bool "Using flash rw partitions as storage media"
    default y

config STORAGE_MEDIA_EMMC
	bool "Using emmc device as storage media"
    default y

endif
```

## boards/alibaba/fpga/alimoc30_cmu610_cpu0_acku-xip_defconfig
```kconfig
# Copyright (c) 2024 Alibaba
# SPDX-License-Identifier: Apache-2.0

CONFIG_OUTPUT_DISASSEMBLY=y
CONFIG_COMPILER_OPT="-O0"
CONFIG_NUM_USE_CPU=2
CONFIG_NUM_OS=2
CONFIG_CPU1_BOOT_ADDR=0x8000000

CONFIG_NOCACHE_MEMORY=y
CONFIG_RISCV_PMP=y
CONFIG_PMP_GRANULARITY=4096

CONFIG_BOOT_CPU1=n

CONFIG_ASSERT=y
CONFIG_MINIMAL_LIBC=y
CONFIG_MINIMAL_LIBC_RAND=y
CONFIG_MAIN_STACK_SIZE=20480
CONFIG_ISR_STACK_SIZE=4096

CONFIG_PINCTRL=y
CONFIG_GPIO=y

CONFIG_SERIAL=y
CONFIG_CONSOLE=y
CONFIG_UART_CONSOLE=y

CONFIG_XIP=n
# CONFIG_SPI=y

# CONFIG_I2C=y
# CONFIG_I2C_TARGET=y
# CONFIG_I2C_EEPROM_TARGET=y
# CONFIG_SMBUS=y
# CONFIG_SMBUS_LINKEDSEMI_SMBALERT=n

# CONFIG_ETH_DRIVER=y
# CONFIG_ETH_DWMAC=y
# CONFIG_NET_L2_ETHERNET=y

# CONFIG_SDHC=y

# CONFIG_PECI=y

# CONFIG_JTAG=y
# CONFIG_SHELL=y

# CONFIG_CACHE=y
# CONFIG_CACHE_MANAGEMENT=y
# CONFIG_CACHE_LINKEDSEMI=y

# CONFIG_CRYPTO=y

# CONFIG_MBOX=y

# CONFIG_KCS=y
# CONFIG_IPMI=y
```

## boards/alibaba/fpga/alimoc30_cmu610_cpu1_acku-sc_defconfig
```kconfig
# Copyright (c) 2024 Linkedsemi
# SPDX-License-Identifier: Apache-2.0

CONFIG_OUTPUT_DISASSEMBLY=y
# CONFIG_COMPILER_OPT="-O0"
CONFIG_NUM_USE_CPU=1
CONFIG_NUM_OS=1

CONFIG_ASSERT=y
CONFIG_MINIMAL_LIBC=y
CONFIG_MINIMAL_LIBC_RAND=y
CONFIG_MAIN_STACK_SIZE=102400
CONFIG_ISR_STACK_SIZE=4096

CONFIG_TEST_EXTRA_STACK_SIZE=4096
# CONFIG_ZTEST_STACK_SIZE=4096
CONFIG_ZTEST_STACK_SIZE=4096
CONFIG_SYSTEM_WORKQUEUE_STACK_SIZE=4096
# CONFIG_NET_BUF_DATA_SIZE=512

CONFIG_PINCTRL=y
CONFIG_GPIO=y

CONFIG_SERIAL=y
CONFIG_CONSOLE=y
CONFIG_UART_CONSOLE=y

CONFIG_XIP=n
# CONFIG_SPI=y

# CONFIG_I2C=y
# CONFIG_I2C_TARGET=y
# CONFIG_I2C_EEPROM_TARGET=y
# CONFIG_SMBUS=y
# CONFIG_SMBUS_LINKEDSEMI_SMBALERT=n

# CONFIG_ETH_DRIVER=y
# CONFIG_ETH_DWMAC=y
# CONFIG_NET_L2_ETHERNET=y

# CONFIG_SDHC=y

# CONFIG_PECI=y

# CONFIG_JTAG=y
# CONFIG_SHELL=y

# CONFIG_CACHE=y
# CONFIG_CACHE_MANAGEMENT=y
# CONFIG_CACHE_LINKEDSEMI=y

# CONFIG_CRYPTO=y

# CONFIG_MBOX=y

# CONFIG_KCS=y
# CONFIG_IPMI=y

CONFIG_CACHE=y
CONFIG_CACHE_MANAGEMENT=y
CONFIG_CACHE_LINKEDSEMI=y
CONFIG_ICACHE_LINE_SIZE_DETECT=y
CONFIG_DCACHE_LINE_SIZE_DETECT=y
CONFIG_NOCACHE_MEMORY=y
CONFIG_RISCV_PMP=y
CONFIG_PMP_GRANULARITY=4096


CONFIG_LOG_BUFFER_SIZE=40960

CONFIG_SINGLE_CORE=y
```

## boards/alibaba/fpga/alimoc30_cmu610_cpu1_acku-xip_defconfig
```kconfig
# Copyright (c) 2024 Alibaba
# SPDX-License-Identifier: Apache-2.0

CONFIG_OUTPUT_DISASSEMBLY=y
# CONFIG_COMPILER_OPT="-O0"
CONFIG_NUM_USE_CPU=2
CONFIG_NUM_OS=2
CONFIG_CPU2_BOOT_ADDR=0x8100000

CONFIG_NOCACHE_MEMORY=y
CONFIG_RISCV_PMP=y
CONFIG_PMP_GRANULARITY=4096

CONFIG_BOOT_CPU2=n

CONFIG_ASSERT=y
CONFIG_MINIMAL_LIBC=y
CONFIG_MINIMAL_LIBC_RAND=y
CONFIG_MAIN_STACK_SIZE=20480
CONFIG_ISR_STACK_SIZE=4096

CONFIG_PINCTRL=y
CONFIG_GPIO=y

CONFIG_SERIAL=y
CONFIG_CONSOLE=y
CONFIG_UART_CONSOLE=y

CONFIG_XIP=y
# CONFIG_SPI=y

CONFIG_I2C=y
CONFIG_I2C_SHELL=y
CONFIG_I2C_LS=y
CONFIG_I2C_TARGET=y
CONFIG_I2C_EEPROM_TARGET=y

CONFIG_SMBUS=y
CONFIG_SMBUS_SHELL=y
CONFIG_SMBUS_INTEL_PCH=y
CONFIG_SMBUS_LOG_LEVEL_DBG=y
CONFIG_SMBUS_LINKEDSEMI=y
CONFIG_SMBUS_LINKEDSEMI_SMBALERT=n

# CONFIG_USERSPACE=y
CONFIG_EEPROM=y
CONFIG_EEPROM_EMULATOR=n
CONFIG_EEPROM_SIMULATOR=n

# CONFIG_ETH_DRIVER=y
# CONFIG_ETH_DWMAC=y
# CONFIG_NET_L2_ETHERNET=y

# CONFIG_SDHC=y

# CONFIG_PECI=y

# CONFIG_JTAG=y
# CONFIG_SHELL=y

# enable cache operation may lead to reset problem
CONFIG_CACHE=y
CONFIG_CACHE_MANAGEMENT=y
CONFIG_CACHE_LINKEDSEMI=y

# CONFIG_CRYPTO=y

# CONFIG_MBOX=y

# CONFIG_KCS=y
# CONFIG_IPMI=y

CONFIG_PECI_CORE=n

CONFIG_PSRAM=y

CONFIG_CLOCK_CONTROL=y
CONFIG_RESET=y

CONFIG_COMPILER_SAVE_TEMPS=y
CONFIG_FLASH_OP_DELEGATION_SERVER=y
```

## boards/alibaba/fpga/alimoc30_cmu610_cpu1_defconfig
```kconfig
# Copyright (c) 2024 Alibaba
# SPDX-License-Identifier: Apache-2.0

CONFIG_PINCTRL=y
CONFIG_GPIO=y

CONFIG_SERIAL=y
CONFIG_CONSOLE=y
CONFIG_UART_CONSOLE=y

CONFIG_SPI=n
CONFIG_I2C=n
CONFIG_XIP=n

CONFIG_I2C_LS=y
CONFIG_I2C_TARGET=y
CONFIG_I2C_EEPROM_TARGET=y
CONFIG_ASSERT=y

CONFIG_SMBUS=y
CONFIG_SMBUS_LINKEDSEMI=y
CONFIG_SMBUS_LINKEDSEMI_SMBALERT=n

CONFIG_MBOX=y
CONFIG_MBOX_LINKEDSEMI=y

CONFIG_ETH_DRIVER=y
CONFIG_ETH_DWMAC=y
CONFIG_NET_BUF_FIXED_DATA_SIZE=y
CONFIG_NET_L2_ETHERNET=y

CONFIG_OUTPUT_DISASSEMBLY=y
CONFIG_NUM_USE_CPU=2
CONFIG_NUM_OS=2
# CONFIG_COMPILER_OPT="-O0"

CONFIG_MINIMAL_LIBC=y
CONFIG_MINIMAL_LIBC_RAND=y

# CONFIG_CACHE=y
# CONFIG_CACHE_MANAGEMENT=y
# CONFIG_CACHE_LINKEDSEMI=y
```

## boards/alibaba/fpga/board.yml
```yaml
board:
  name: alimoc30
  vendor: alibaba
  socs:
  - name: cmu610
  revision:
    format: "custom"
    default: "zynq"
    revisions:
      - name: "zynq"
      - name: "acku"
```

## boards/alibaba/moc30/Kconfig.alimoc30
```kconfig
# Copyright (c) 2024, Alibaba
# SPDX-License-Identifier: Apache-2.0

config BOARD_ALIMOC30
	select SOC_LSQSH

config BOARD_LATE_INIT_HOOK
    default y
```

## boards/alibaba/smc/Kconfig.alismc
```kconfig
# Copyright (c) 2024, Alibaba
# SPDX-License-Identifier: Apache-2.0

config BOARD_ALISMC
	select SOC_LSQSH

config BOARD_LATE_INIT_HOOK
    default n
```

## boards/alibaba/smc/Kconfig.defconfig
```kconfig
# Copyright (c) 2024 Alibaba
# SPDX-License-Identifier: Apache-2.0

if BOARD_ALISMC

config FLASH_LOAD_OFFSET
	default 0x0

config HEAP_MEM_POOL_SIZE
	default 4096

config SINGLE_CORE
	bool "Run CMU with single core configurations"
	default n

config STORAGE_MEDIA_FLASH_RW
	bool "Using flash rw partitions as storage media"
    default y

config STORAGE_MEDIA_EMMC
	bool "Using emmc device as storage media"
    default y

config FS_SAMPLE_CREATE_SOME_ENTRIES
	bool "When no files are found on mounted partition create some"
	default y
	help
	  In case when no files could be listed, because there are none,
	  "some.dir" directory and "other.txt" file will be created
	  and list will run again to show them. This is useful when
	  showing how file system works on non-SD devices like internal
	  flash or (Q)SPI connected memories, where it is not possible to
	  easily add files with use of other device.

endif
```

## boards/alibaba/smc/board.yml
```yaml
board:
  name: alismc
  vendor: alibaba
  socs:
  - name: cmu610
  revision:
    format: "custom"
    default: "xip"
    revisions:
      - name: "acku"
      - name: "xip"
```

## boards/linkedsemi/le501x_evb/Kconfig.defconfig
```kconfig
if BOARD_LE501X_EVB

config BOARD
	default "le501x_evb"

config FLASH_LOAD_OFFSET
	default 0x2000

config HEAP_MEM_POOL_SIZE
	default 6144

config BT_COMPANY_ID
	default 0x093A if BT

if SPI_DW

config SPI_DW_ACCESS_WORD_ONLY
	default y
    
endif # SPI_DW

endif
```

## boards/linkedsemi/le501x_evb/Kconfig.le501x_evb
```kconfig
# Copyright (c) 2023 Linkedsemi
# SPDX-License-Identifier: Apache-2.0

config BOARD_LE501X_EVB
	select SOC_LE5010
```

## boards/linkedsemi/ls101x_evb/Kconfig.ls101x_evb
```kconfig
# Copyright (c) 2024  Linkedsemi.
# SPDX-License-Identifier: Apache-2.0

config BOARD_LS101X_EVB
	select SOC_LS1010
```

## boards/linkedsemi/ls101x_evb/ls101x_evb_defconfig
```kconfig
# Copyright (c) 2024  Linkedsemi
# SPDX-License-Identifier: Apache-2.0

CONFIG_OUTPUT_DISASSEMBLY=y
CONFIG_NEWLIB_LIBC=y
CONFIG_MAIN_STACK_SIZE=2048
CONFIG_ISR_STACK_SIZE=4096

CONFIG_PINCTRL=y
CONFIG_GPIO=y

CONFIG_SERIAL=y
CONFIG_CONSOLE=y
CONFIG_UART_CONSOLE=y

# Power Management
# CONFIG_PM=y
# CONFIG_PM_DEVICE=y
# CONFIG_PM_POLICY_CUSTOM=y

CONFIG_CLOCK_CONTROL=y

CONFIG_ADC=y
CONFIG_SPI=y
CONFIG_I2C=y
CONFIG_I2C_TARGET=y
CONFIG_I2C_EEPROM_TARGET=y
CONFIG_ESPI=n
CONFIG_ASSERT=y
CONFIG_KCS=n
CONFIG_IPMI=n
CONFIG_DMA=y

# CONFIG_COMPILER_SAVE_TEMPS=y
```

## boards/linkedsemi/ls1020_evb/board.yml
```yaml
board:
  name: ls1020_evb
  vendor: linkedsemi
  socs:
  - name: lsqsh
  revision:
    format: custom
```

## boards/linkedsemi/lsqsh_evb/Kconfig.defconfig
```kconfig
# Copyright (c) 2024, linkedsemi
# SPDX-License-Identifier: Apache-2.0

if BOARD_LSQSH_EVB

config FLASH_LOAD_OFFSET
    default 0x0

config HEAP_MEM_POOL_SIZE
    default 4096

endif
```

## boards/linkedsemi/lsqsh_evb/Kconfig.lsqsh_evb
```kconfig
# Copyright (c) 2025 linkedsemi
# SPDX-License-Identifier: Apache-2.0

config BOARD_LSQSH_EVB
    select SOC_LSQSH
```

## boards/linkedsemi/lsqsh_evb/board.yml
```yaml
board:
  name: lsqsh_evb
  vendor: linkedsemi
  socs:
  - name: lsqsh
  revision:
    format: custom
```

## boards/linkedsemi/lsqsh_evb/lsqsh_evb_cpu1_1os_defconfig
```kconfig
# Copyright (c) 2025 linkedsemi
# SPDX-License-Identifier: Apache-2.0

CONFIG_MINIMAL_LIBC=y

# CONFIG_BOOT_BANNER=n
# CONFIG_COMPILER_OPT="-O0"
CONFIG_NUM_USE_CPU=1
CONFIG_NUM_OS=1
CONFIG_PSRAM=y
CONFIG_SHA256_CLOCK_RESET=y
CONFIG_SHA512_CLOCK_RESET=y
CONFIG_SM4_CLOCK_RESET=y
CONFIG_AES_CLOCK_RESET=y
```

## boards/linkedsemi/lsqsh_evb/lsqsh_evb_cpu2_2os_xip_defconfig
```kconfig
# Copyright (c) 2025 linkedsemi
# SPDX-License-Identifier: Apache-2.0

CONFIG_MINIMAL_LIBC=y

# CONFIG_BOOT_BANNER=n
# CONFIG_COMPILER_OPT="-O0"
CONFIG_NUM_USE_CPU=2
CONFIG_NUM_OS=2
CONFIG_CPU2_BOOT_ADDR=0x8100000
```

## boards/linkedsemi/lsqsh_evb/lsqsh_evb_smp_2os_defconfig
```kconfig
# Copyright (c) 2025 linkedsemi
# SPDX-License-Identifier: Apache-2.0

CONFIG_MINIMAL_LIBC=y

# CONFIG_BOOT_BANNER=n
# CONFIG_COMPILER_OPT="-O0"

# CONFIG_NUM_USE_CPU=2
# CONFIG_NUM_OS=2
# CONFIG_CPU2_BOOT_ADDR=0x10000000
# CONFIG_BOOT_CPU2=y


CONFIG_IPI_OPTIMIZE=y
CONFIG_RISCV_PMP=n
CONFIG_SMP=y
CONFIG_PM_CPU_OPS=y
CONFIG_SCHED_CPU_MASK=y
CONFIG_FLASH_OP_DELEGATION_SERVER=n
CONFIG_XIP=n
```
