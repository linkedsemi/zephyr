/*
 * Copyright (c) 2024 Linkedsemi
 *
 * SPDX-License-Identifier: Apache-2.0
 */

#include <zephyr/dt-bindings/pinctrl/lsqsh-pinctrl.h>

&pinctrl {
    /omit-if-no-ref/keyo16_pe02: keyo16_pe02 {
        pinmux = <LS_PINMUX_KEYO16_FUNC2_PE02>;
        input-enable;
    };

    /omit-if-no-ref/keyo17_pe03: keyo17_pe03 {
        pinmux = <LS_PINMUX_KEYO17_FUNC2_PE03>;
        input-enable;
    };

    /omit-if-no-ref/ltpi_nl_gpo4_pe04: ltpi_nl_gpo4_pe04 {
        pinmux = <LS_PINMUX_LTPI_NL_GPO4_FUNC2_PE04>;
        input-enable;
    };

    /omit-if-no-ref/ltpi_nl_gpo5_pe05: ltpi_nl_gpo5_pe05 {
        pinmux = <LS_PINMUX_LTPI_NL_GPO5_FUNC2_PE05>;
        input-enable;
    };

    /omit-if-no-ref/ltpi_nl_gpo6_pe06: ltpi_nl_gpo6_pe06 {
        pinmux = <LS_PINMUX_LTPI_NL_GPO6_FUNC2_PE06>;
        input-enable;
    };

    /omit-if-no-ref/ltpi_nl_gpo7_pe07: ltpi_nl_gpo7_pe07 {
        pinmux = <LS_PINMUX_LTPI_NL_GPO7_FUNC2_PE07>;
        input-enable;
    };

    /omit-if-no-ref/fan_tach12_pe08: fan_tach12_pe08 {
        pinmux = <LS_PINMUX_FAN_TACH12_FUNC2_PE08>;
        input-enable;
    };

    /omit-if-no-ref/fan_tach11_pe09: fan_tach11_pe09 {
        pinmux = <LS_PINMUX_FAN_TACH11_FUNC2_PE09>;
        input-enable;
    };

    /omit-if-no-ref/fan_tach10_pe10: fan_tach10_pe10 {
        pinmux = <LS_PINMUX_FAN_TACH10_FUNC2_PE10>;
        input-enable;
    };

    /omit-if-no-ref/fan_tach9_pe11: fan_tach9_pe11 {
        pinmux = <LS_PINMUX_FAN_TACH9_FUNC2_PE11>;
        input-enable;
    };

    /omit-if-no-ref/fan_tach8_pe12: fan_tach8_pe12 {
        pinmux = <LS_PINMUX_FAN_TACH8_FUNC2_PE12>;
        input-enable;
    };

    /omit-if-no-ref/fan_pwm1_pe13: fan_pwm1_pe13 {
        pinmux = <LS_PINMUX_FAN_PWM1_FUNC2_PE13>;
        input-enable;
    };

    /omit-if-no-ref/fan_pwm0_pe14: fan_pwm0_pe14 {
        pinmux = <LS_PINMUX_FAN_PWM0_FUNC2_PE14>;
        input-enable;
    };

    /omit-if-no-ref/fan_tach15_pe15: fan_tach15_pe15 {
        pinmux = <LS_PINMUX_FAN_TACH15_FUNC2_PE15>;
        input-enable;
    };

    /omit-if-no-ref/ltpi_ll_gpi0_pb00: ltpi_ll_gpi0_pb00 {
        pinmux = <LS_PINMUX_LTPI_LL_GPI0_FUNC2_PB00>;
        input-enable;
    };

    /omit-if-no-ref/ltpi_ll_gpi1_pb01: ltpi_ll_gpi1_pb01 {
        pinmux = <LS_PINMUX_LTPI_LL_GPI1_FUNC2_PB01>;
        input-enable;
    };

    /omit-if-no-ref/ltpi_ll_gpi2_pb02: ltpi_ll_gpi2_pb02 {
        pinmux = <LS_PINMUX_LTPI_LL_GPI2_FUNC2_PB02>;
        input-enable;
    };

    /omit-if-no-ref/ltpi_ll_gpi3_pb03: ltpi_ll_gpi3_pb03 {
        pinmux = <LS_PINMUX_LTPI_LL_GPI3_FUNC2_PB03>;
        input-enable;
    };

    /omit-if-no-ref/ltpi_ll_gpo0_pb04: ltpi_ll_gpo0_pb04 {
        pinmux = <LS_PINMUX_LTPI_LL_GPO0_FUNC2_PB04>;
        input-enable;
    };

    /omit-if-no-ref/ltpi_ll_gpo1_pb05: ltpi_ll_gpo1_pb05 {
        pinmux = <LS_PINMUX_LTPI_LL_GPO1_FUNC2_PB05>;
        input-enable;
    };

    /omit-if-no-ref/ltpi_ll_gpo2_pb06: ltpi_ll_gpo2_pb06 {
        pinmux = <LS_PINMUX_LTPI_LL_GPO2_FUNC2_PB06>;
        input-enable;
    };

    /omit-if-no-ref/ltpi_ll_gpi8_pb07: ltpi_ll_gpi8_pb07 {
        pinmux = <LS_PINMUX_LTPI_LL_GPI8_FUNC2_PB07>;
        input-enable;
    };

    /omit-if-no-ref/ltpi_ll_gpo8_pb08: ltpi_ll_gpo8_pb08 {
        pinmux = <LS_PINMUX_LTPI_LL_GPO8_FUNC2_PB08>;
        input-enable;
    };

    /omit-if-no-ref/uart9_rxd_pb09: uart9_rxd_pb09 {
        pinmux = <LS_PINMUX_UART9_RXD_FUNC2_PB09>;
        input-enable;
    };

    /omit-if-no-ref/i2c1_mst_sda_pb10: i2c1_mst_sda_pb10 {
        pinmux = <LS_PINMUX_I2C1_MST_SDA_FUNC2_PB10>;
        input-enable;
    };

    /omit-if-no-ref/i2c1_mst_scl_pb11: i2c1_mst_scl_pb11 {
        pinmux = <LS_PINMUX_I2C1_MST_SCL_FUNC2_PB11>;
        input-enable;
    };

    /omit-if-no-ref/ltpi_ll_gpo3_pb12: ltpi_ll_gpo3_pb12 {
        pinmux = <LS_PINMUX_LTPI_LL_GPO3_FUNC2_PB12>;
        input-enable;
    };

    /omit-if-no-ref/ltpi_scm_intr_pb13: ltpi_scm_intr_pb13 {
        pinmux = <LS_PINMUX_LTPI_SCM_INTR_FUNC2_PB13>;
        input-enable;
    };

    /omit-if-no-ref/i2c3_mst_sda_pb14: i2c3_mst_sda_pb14 {
        pinmux = <LS_PINMUX_I2C3_MST_SDA_FUNC2_PB14>;
        input-enable;
    };

    /omit-if-no-ref/i2c3_mst_scl_pb15: i2c3_mst_scl_pb15 {
        pinmux = <LS_PINMUX_I2C3_MST_SCL_FUNC2_PB15>;
        input-enable;
    };

    /omit-if-no-ref/rgmii2_mdc_pi00: rgmii2_mdc_pi00 {
        pinmux = <LS_PINMUX_RGMII2_MDC_FUNC2_PI00>;
        input-enable;
    };

    /omit-if-no-ref/rgmii2_mdio_pi01: rgmii2_mdio_pi01 {
        pinmux = <LS_PINMUX_RGMII2_MDIO_FUNC2_PI01>;
        input-enable;
    };

    /omit-if-no-ref/uart3_rxd_pi02: uart3_rxd_pi02 {
        pinmux = <LS_PINMUX_UART3_RXD_FUNC2_PI02>;
        input-enable;
    };

    /omit-if-no-ref/uart3_txd_pi03: uart3_txd_pi03 {
        pinmux = <LS_PINMUX_UART3_TXD_FUNC2_PI03>;
        input-enable;
    };

    /omit-if-no-ref/uart1_rxd_pi04: uart1_rxd_pi04 {
        pinmux = <LS_PINMUX_UART1_RXD_FUNC2_PI04>;
        input-enable;
    };

    /omit-if-no-ref/uart1_txd_pi05: uart1_txd_pi05 {
        pinmux = <LS_PINMUX_UART1_TXD_FUNC2_PI05>;
        input-enable;
    };

    /omit-if-no-ref/uart4_txd_pi06: uart4_txd_pi06 {
        pinmux = <LS_PINMUX_UART4_TXD_FUNC2_PI06>;
        input-enable;
    };

    /omit-if-no-ref/uart4_rxd_pi07: uart4_rxd_pi07 {
        pinmux = <LS_PINMUX_UART4_RXD_FUNC2_PI07>;
        input-enable;
    };

    /omit-if-no-ref/ltpi_nl_gpi26_pi08: ltpi_nl_gpi26_pi08 {
        pinmux = <LS_PINMUX_LTPI_NL_GPI26_FUNC2_PI08>;
        input-enable;
    };

    /omit-if-no-ref/ltpi_nl_gpi27_pi09: ltpi_nl_gpi27_pi09 {
        pinmux = <LS_PINMUX_LTPI_NL_GPI27_FUNC2_PI09>;
        input-enable;
    };

    /omit-if-no-ref/ltpi_nl_gpi28_pi10: ltpi_nl_gpi28_pi10 {
        pinmux = <LS_PINMUX_LTPI_NL_GPI28_FUNC2_PI10>;
        input-enable;
    };

    /omit-if-no-ref/ltpi_nl_gpi29_pi11: ltpi_nl_gpi29_pi11 {
        pinmux = <LS_PINMUX_LTPI_NL_GPI29_FUNC2_PI11>;
        input-enable;
    };

    /omit-if-no-ref/ltpi_nl_gpo26_pi12: ltpi_nl_gpo26_pi12 {
        pinmux = <LS_PINMUX_LTPI_NL_GPO26_FUNC2_PI12>;
        input-enable;
    };

    /omit-if-no-ref/ltpi_nl_gpo27_pi13: ltpi_nl_gpo27_pi13 {
        pinmux = <LS_PINMUX_LTPI_NL_GPO27_FUNC2_PI13>;
        input-enable;
    };

    /omit-if-no-ref/ltpi_nl_gpo28_pi14: ltpi_nl_gpo28_pi14 {
        pinmux = <LS_PINMUX_LTPI_NL_GPO28_FUNC2_PI14>;
        input-enable;
    };

    /omit-if-no-ref/ltpi_nl_gpo29_pi15: ltpi_nl_gpo29_pi15 {
        pinmux = <LS_PINMUX_LTPI_NL_GPO29_FUNC2_PI15>;
        input-enable;
    };

    /omit-if-no-ref/ltpi_i2c1_scl_pa00: ltpi_i2c1_scl_pa00 {
        pinmux = <LS_PINMUX_LTPI_I2C1_SCL_FUNC2_PA00>;
        input-enable;
    };

    /omit-if-no-ref/ltpi_i2c1_sda_pa01: ltpi_i2c1_sda_pa01 {
        pinmux = <LS_PINMUX_LTPI_I2C1_SDA_FUNC2_PA01>;
        input-enable;
    };

    /omit-if-no-ref/ltpi_uart1_txd_pa02: ltpi_uart1_txd_pa02 {
        pinmux = <LS_PINMUX_LTPI_UART1_TXD_FUNC2_PA02>;
        input-enable;
    };

    /omit-if-no-ref/ltpi_uart1_rxd_pa03: ltpi_uart1_rxd_pa03 {
        pinmux = <LS_PINMUX_LTPI_UART1_RXD_FUNC2_PA03>;
        input-enable;
    };

    /omit-if-no-ref/ltpi_uart1_ctsn_pa04: ltpi_uart1_ctsn_pa04 {
        pinmux = <LS_PINMUX_LTPI_UART1_CTSN_FUNC2_PA04>;
        input-enable;
    };

    /omit-if-no-ref/ltpi_uart1_rtsn_pa05: ltpi_uart1_rtsn_pa05 {
        pinmux = <LS_PINMUX_LTPI_UART1_RTSN_FUNC2_PA05>;
        input-enable;
    };

    /omit-if-no-ref/keyi0_pa06: keyi0_pa06 {
        pinmux = <LS_PINMUX_KEYI0_FUNC2_PA06>;
        input-enable;
    };

    /omit-if-no-ref/keyi1_pa07: keyi1_pa07 {
        pinmux = <LS_PINMUX_KEYI1_FUNC2_PA07>;
        input-enable;
    };

    /omit-if-no-ref/keyi2_pa08: keyi2_pa08 {
        pinmux = <LS_PINMUX_KEYI2_FUNC2_PA08>;
        input-enable;
    };

    /omit-if-no-ref/keyi3_pa09: keyi3_pa09 {
        pinmux = <LS_PINMUX_KEYI3_FUNC2_PA09>;
        input-enable;
    };

    /omit-if-no-ref/keyi4_pa10: keyi4_pa10 {
        pinmux = <LS_PINMUX_KEYI4_FUNC2_PA10>;
        input-enable;
    };

    /omit-if-no-ref/keyi5_pa11: keyi5_pa11 {
        pinmux = <LS_PINMUX_KEYI5_FUNC2_PA11>;
        input-enable;
    };

    /omit-if-no-ref/keyi6_pa12: keyi6_pa12 {
        pinmux = <LS_PINMUX_KEYI6_FUNC2_PA12>;
        input-enable;
    };

    /omit-if-no-ref/keyi7_pa13: keyi7_pa13 {
        pinmux = <LS_PINMUX_KEYI7_FUNC2_PA13>;
        input-enable;
    };

    /omit-if-no-ref/rgmii1_mdc_pa14: rgmii1_mdc_pa14 {
        pinmux = <LS_PINMUX_RGMII1_MDC_FUNC2_PA14>;
        input-enable;
    };

    /omit-if-no-ref/rgmii1_mdio_pa15: rgmii1_mdio_pa15 {
        pinmux = <LS_PINMUX_RGMII1_MDIO_FUNC2_PA15>;
        input-enable;
    };

    /omit-if-no-ref/keyo14_pe00: keyo14_pe00 {
        pinmux = <LS_PINMUX_KEYO14_FUNC2_PE00>;
        input-enable;
    };

    /omit-if-no-ref/keyo15_pe01: keyo15_pe01 {
        pinmux = <LS_PINMUX_KEYO15_FUNC2_PE01>;
        input-enable;
    };

    /omit-if-no-ref/sgpio1_mst_do_pn00: sgpio1_mst_do_pn00 {
        pinmux = <LS_PINMUX_SGPIO1_MST_DO_FUNC2_PN00>;
        input-enable;
    };

    /omit-if-no-ref/sgpio1_mst_ld_pn01: sgpio1_mst_ld_pn01 {
        pinmux = <LS_PINMUX_SGPIO1_MST_LD_FUNC2_PN01>;
        input-enable;
    };

    /omit-if-no-ref/sgpio1_mck_pn02: sgpio1_mck_pn02 {
        pinmux = <LS_PINMUX_SGPIO1_MCK_FUNC2_PN02>;
        input-enable;
    };

    /omit-if-no-ref/sgpio1_mld_pn03: sgpio1_mld_pn03 {
        pinmux = <LS_PINMUX_SGPIO1_MLD_FUNC2_PN03>;
        input-enable;
    };

    /omit-if-no-ref/sgpio1_mdi0_pn04: sgpio1_mdi0_pn04 {
        pinmux = <LS_PINMUX_SGPIO1_MDI0_FUNC2_PN04>;
        input-enable;
    };

    /omit-if-no-ref/sgpio1_mdi1_pn05: sgpio1_mdi1_pn05 {
        pinmux = <LS_PINMUX_SGPIO1_MDI1_FUNC2_PN05>;
        input-enable;
    };

    /omit-if-no-ref/mjtag1_tck_pn06: mjtag1_tck_pn06 {
        pinmux = <LS_PINMUX_MJTAG1_TCK_FUNC2_PN06>;
        input-enable;
    };

    /omit-if-no-ref/mjtag1_tms_pn07: mjtag1_tms_pn07 {
        pinmux = <LS_PINMUX_MJTAG1_TMS_FUNC2_PN07>;
        input-enable;
    };

    /omit-if-no-ref/mjtag1_tdo_pn08: mjtag1_tdo_pn08 {
        pinmux = <LS_PINMUX_MJTAG1_TDO_FUNC2_PN08>;
        input-enable;
    };

    /omit-if-no-ref/mjtag1_tdi_pn09: mjtag1_tdi_pn09 {
        pinmux = <LS_PINMUX_MJTAG1_TDI_FUNC2_PN09>;
        input-enable;
    };

    /omit-if-no-ref/mjtag1_trst_pn10: mjtag1_trst_pn10 {
        pinmux = <LS_PINMUX_MJTAG1_TRST_FUNC2_PN10>;
        input-enable;
    };

    /omit-if-no-ref/mjtag2_tck_pn11: mjtag2_tck_pn11 {
        pinmux = <LS_PINMUX_MJTAG2_TCK_FUNC2_PN11>;
        input-enable;
    };

    /omit-if-no-ref/mjtag2_tms_pn12: mjtag2_tms_pn12 {
        pinmux = <LS_PINMUX_MJTAG2_TMS_FUNC2_PN12>;
        input-enable;
    };

    /omit-if-no-ref/mjtag2_tdo_pn13: mjtag2_tdo_pn13 {
        pinmux = <LS_PINMUX_MJTAG2_TDO_FUNC2_PN13>;
        input-enable;
    };

    /omit-if-no-ref/mjtag2_tdi_pn14: mjtag2_tdi_pn14 {
        pinmux = <LS_PINMUX_MJTAG2_TDI_FUNC2_PN14>;
        input-enable;
    };

    /omit-if-no-ref/mjtag2_trst_pn15: mjtag2_trst_pn15 {
        pinmux = <LS_PINMUX_MJTAG2_TRST_FUNC2_PN15>;
        input-enable;
    };

    /omit-if-no-ref/fan_tach14_pf00: fan_tach14_pf00 {
        pinmux = <LS_PINMUX_FAN_TACH14_FUNC2_PF00>;
        input-enable;
    };

    /omit-if-no-ref/ltpi_nl_gpo9_pf01: ltpi_nl_gpo9_pf01 {
        pinmux = <LS_PINMUX_LTPI_NL_GPO9_FUNC2_PF01>;
        input-enable;
    };

    /omit-if-no-ref/ltpi_nl_gpi22_pf02: ltpi_nl_gpi22_pf02 {
        pinmux = <LS_PINMUX_LTPI_NL_GPI22_FUNC2_PF02>;
        input-enable;
    };

    /omit-if-no-ref/ltpi_nl_gpo13_pf03: ltpi_nl_gpo13_pf03 {
        pinmux = <LS_PINMUX_LTPI_NL_GPO13_FUNC2_PF03>;
        input-enable;
    };

    /omit-if-no-ref/ltpi_nl_gpi20_pf04: ltpi_nl_gpi20_pf04 {
        pinmux = <LS_PINMUX_LTPI_NL_GPI20_FUNC2_PF04>;
        input-enable;
    };

    /omit-if-no-ref/ltpi_nl_gpo10_pf05: ltpi_nl_gpo10_pf05 {
        pinmux = <LS_PINMUX_LTPI_NL_GPO10_FUNC2_PF05>;
        input-enable;
    };

    /omit-if-no-ref/ltpi_nl_gpi21_pf06: ltpi_nl_gpi21_pf06 {
        pinmux = <LS_PINMUX_LTPI_NL_GPI21_FUNC2_PF06>;
        input-enable;
    };

    /omit-if-no-ref/ltpi_nl_gpo12_pf07: ltpi_nl_gpo12_pf07 {
        pinmux = <LS_PINMUX_LTPI_NL_GPO12_FUNC2_PF07>;
        input-enable;
    };

    /omit-if-no-ref/ltpi_nl_gpo15_pf08: ltpi_nl_gpo15_pf08 {
        pinmux = <LS_PINMUX_LTPI_NL_GPO15_FUNC2_PF08>;
        input-enable;
    };

    /omit-if-no-ref/ltpi_nl_gpo8_pf09: ltpi_nl_gpo8_pf09 {
        pinmux = <LS_PINMUX_LTPI_NL_GPO8_FUNC2_PF09>;
        input-enable;
    };

    /omit-if-no-ref/ltpi_nl_gpo14_pf10: ltpi_nl_gpo14_pf10 {
        pinmux = <LS_PINMUX_LTPI_NL_GPO14_FUNC2_PF10>;
        input-enable;
    };

    /omit-if-no-ref/ltpi_nl_gpo11_pf11: ltpi_nl_gpo11_pf11 {
        pinmux = <LS_PINMUX_LTPI_NL_GPO11_FUNC2_PF11>;
        input-enable;
    };

    /omit-if-no-ref/fan_pwm11_pf12: fan_pwm11_pf12 {
        pinmux = <LS_PINMUX_FAN_PWM11_FUNC2_PF12>;
        input-enable;
    };

    /omit-if-no-ref/i2c10_smba_pf13: i2c10_smba_pf13 {
        pinmux = <LS_PINMUX_I2C10_SMBA_FUNC2_PF13>;
        input-enable;
    };

    /omit-if-no-ref/fan_pwm10_pf14: fan_pwm10_pf14 {
        pinmux = <LS_PINMUX_FAN_PWM10_FUNC2_PF14>;
        input-enable;
    };

    /omit-if-no-ref/i2c9_smba_pf15: i2c9_smba_pf15 {
        pinmux = <LS_PINMUX_I2C9_SMBA_FUNC2_PF15>;
        input-enable;
    };

    /omit-if-no-ref/ltpi_nl_gpi23_pc00: ltpi_nl_gpi23_pc00 {
        pinmux = <LS_PINMUX_LTPI_NL_GPI23_FUNC2_PC00>;
        input-enable;
    };

    /omit-if-no-ref/ltpi_nl_gpi24_pc01: ltpi_nl_gpi24_pc01 {
        pinmux = <LS_PINMUX_LTPI_NL_GPI24_FUNC2_PC01>;
        input-enable;
    };

    /omit-if-no-ref/ltpi_nl_gpi25_pc02: ltpi_nl_gpi25_pc02 {
        pinmux = <LS_PINMUX_LTPI_NL_GPI25_FUNC2_PC02>;
        input-enable;
    };

    /omit-if-no-ref/ltpi_nl_gpo23_pc03: ltpi_nl_gpo23_pc03 {
        pinmux = <LS_PINMUX_LTPI_NL_GPO23_FUNC2_PC03>;
        input-enable;
    };

    /omit-if-no-ref/ltpi_i2c6_scl_pc04: ltpi_i2c6_scl_pc04 {
        pinmux = <LS_PINMUX_LTPI_I2C6_SCL_FUNC2_PC04>;
        input-enable;
    };

    /omit-if-no-ref/ltpi_i2c6_sda_pc05: ltpi_i2c6_sda_pc05 {
        pinmux = <LS_PINMUX_LTPI_I2C6_SDA_FUNC2_PC05>;
        input-enable;
    };

    /omit-if-no-ref/i2c5_smba_pc06: i2c5_smba_pc06 {
        pinmux = <LS_PINMUX_I2C5_SMBA_FUNC2_PC06>;
        input-enable;
    };

    /omit-if-no-ref/i2c6_smba_pc07: i2c6_smba_pc07 {
        pinmux = <LS_PINMUX_I2C6_SMBA_FUNC2_PC07>;
        input-enable;
    };

    /omit-if-no-ref/i2c7_smba_pc08: i2c7_smba_pc08 {
        pinmux = <LS_PINMUX_I2C7_SMBA_FUNC2_PC08>;
        input-enable;
    };

    /omit-if-no-ref/i2c8_smba_pc09: i2c8_smba_pc09 {
        pinmux = <LS_PINMUX_I2C8_SMBA_FUNC2_PC09>;
        input-enable;
    };

    /omit-if-no-ref/uart9_txd_pc10: uart9_txd_pc10 {
        pinmux = <LS_PINMUX_UART9_TXD_FUNC2_PC10>;
        input-enable;
    };

    /omit-if-no-ref/uart9_rxd_pc11: uart9_rxd_pc11 {
        pinmux = <LS_PINMUX_UART9_RXD_FUNC2_PC11>;
        input-enable;
    };

    /omit-if-no-ref/fan_pwm14_pc12: fan_pwm14_pc12 {
        pinmux = <LS_PINMUX_FAN_PWM14_FUNC2_PC12>;
        input-enable;
    };

    /omit-if-no-ref/fan_pwm15_pc13: fan_pwm15_pc13 {
        pinmux = <LS_PINMUX_FAN_PWM15_FUNC2_PC13>;
        input-enable;
    };

    /omit-if-no-ref/i2c4_smba_pc14: i2c4_smba_pc14 {
        pinmux = <LS_PINMUX_I2C4_SMBA_FUNC2_PC14>;
        input-enable;
    };

    /omit-if-no-ref/fan_tach13_pc15: fan_tach13_pc15 {
        pinmux = <LS_PINMUX_FAN_TACH13_FUNC2_PC15>;
        input-enable;
    };

    /omit-if-no-ref/uart2_ctsn_pd00: uart2_ctsn_pd00 {
        pinmux = <LS_PINMUX_UART2_CTSN_FUNC2_PD00>;
        input-enable;
    };

    /omit-if-no-ref/uart2_rtsn_pd01: uart2_rtsn_pd01 {
        pinmux = <LS_PINMUX_UART2_RTSN_FUNC2_PD01>;
        input-enable;
    };

    /omit-if-no-ref/keyo0_pd02: keyo0_pd02 {
        pinmux = <LS_PINMUX_KEYO0_FUNC2_PD02>;
        input-enable;
    };

    /omit-if-no-ref/keyo1_pd03: keyo1_pd03 {
        pinmux = <LS_PINMUX_KEYO1_FUNC2_PD03>;
        input-enable;
    };

    /omit-if-no-ref/keyo2_pd04: keyo2_pd04 {
        pinmux = <LS_PINMUX_KEYO2_FUNC2_PD04>;
        input-enable;
    };

    /omit-if-no-ref/keyo3_pd05: keyo3_pd05 {
        pinmux = <LS_PINMUX_KEYO3_FUNC2_PD05>;
        input-enable;
    };

    /omit-if-no-ref/keyo4_pd06: keyo4_pd06 {
        pinmux = <LS_PINMUX_KEYO4_FUNC2_PD06>;
        input-enable;
    };

    /omit-if-no-ref/keyo5_pd07: keyo5_pd07 {
        pinmux = <LS_PINMUX_KEYO5_FUNC2_PD07>;
        input-enable;
    };

    /omit-if-no-ref/keyo6_pd08: keyo6_pd08 {
        pinmux = <LS_PINMUX_KEYO6_FUNC2_PD08>;
        input-enable;
    };

    /omit-if-no-ref/keyo7_pd09: keyo7_pd09 {
        pinmux = <LS_PINMUX_KEYO7_FUNC2_PD09>;
        input-enable;
    };

    /omit-if-no-ref/keyo8_pd10: keyo8_pd10 {
        pinmux = <LS_PINMUX_KEYO8_FUNC2_PD10>;
        input-enable;
    };

    /omit-if-no-ref/keyo9_pd11: keyo9_pd11 {
        pinmux = <LS_PINMUX_KEYO9_FUNC2_PD11>;
        input-enable;
    };

    /omit-if-no-ref/keyo10_pd12: keyo10_pd12 {
        pinmux = <LS_PINMUX_KEYO10_FUNC2_PD12>;
        input-enable;
    };

    /omit-if-no-ref/keyo11_pd13: keyo11_pd13 {
        pinmux = <LS_PINMUX_KEYO11_FUNC2_PD13>;
        input-enable;
    };

    /omit-if-no-ref/keyo12_pd14: keyo12_pd14 {
        pinmux = <LS_PINMUX_KEYO12_FUNC2_PD14>;
        input-enable;
    };

    /omit-if-no-ref/keyo13_pd15: keyo13_pd15 {
        pinmux = <LS_PINMUX_KEYO13_FUNC2_PD15>;
        input-enable;
    };

    /omit-if-no-ref/i2c14_sda_pk12: i2c14_sda_pk12 {
        pinmux = <LS_PINMUX_I2C14_SDA_FUNC2_PK12>;
        input-enable;
    };

    /omit-if-no-ref/i2c14_scl_pk13: i2c14_scl_pk13 {
        pinmux = <LS_PINMUX_I2C14_SCL_FUNC2_PK13>;
        input-enable;
    };

    /omit-if-no-ref/i2c13_sda_pk14: i2c13_sda_pk14 {
        pinmux = <LS_PINMUX_I2C13_SDA_FUNC2_PK14>;
        input-enable;
    };

    /omit-if-no-ref/i2c13_scl_pk15: i2c13_scl_pk15 {
        pinmux = <LS_PINMUX_I2C13_SCL_FUNC2_PK15>;
        input-enable;
    };

    /omit-if-no-ref/i2c12_sda_pm00: i2c12_sda_pm00 {
        pinmux = <LS_PINMUX_I2C12_SDA_FUNC2_PM00>;
        input-enable;
    };

    /omit-if-no-ref/i2c12_scl_pm01: i2c12_scl_pm01 {
        pinmux = <LS_PINMUX_I2C12_SCL_FUNC2_PM01>;
        input-enable;
    };

    /omit-if-no-ref/i2c11_sda_pm02: i2c11_sda_pm02 {
        pinmux = <LS_PINMUX_I2C11_SDA_FUNC2_PM02>;
        input-enable;
    };

    /omit-if-no-ref/i2c11_scl_pm03: i2c11_scl_pm03 {
        pinmux = <LS_PINMUX_I2C11_SCL_FUNC2_PM03>;
        input-enable;
    };

    /omit-if-no-ref/fan_pwm9_pg00: fan_pwm9_pg00 {
        pinmux = <LS_PINMUX_FAN_PWM9_FUNC2_PG00>;
        input-enable;
    };

    /omit-if-no-ref/i2c8_smba_pg01: i2c8_smba_pg01 {
        pinmux = <LS_PINMUX_I2C8_SMBA_FUNC2_PG01>;
        input-enable;
    };

    /omit-if-no-ref/fan_pwm8_pg02: fan_pwm8_pg02 {
        pinmux = <LS_PINMUX_FAN_PWM8_FUNC2_PG02>;
        input-enable;
    };

    /omit-if-no-ref/i2c7_smba_pg03: i2c7_smba_pg03 {
        pinmux = <LS_PINMUX_I2C7_SMBA_FUNC2_PG03>;
        input-enable;
    };

    /omit-if-no-ref/i2c6_smba_pg04: i2c6_smba_pg04 {
        pinmux = <LS_PINMUX_I2C6_SMBA_FUNC2_PG04>;
        input-enable;
    };

    /omit-if-no-ref/uart4_dcdn_pg05: uart4_dcdn_pg05 {
        pinmux = <LS_PINMUX_UART4_DCDN_FUNC2_PG05>;
        input-enable;
    };

    /omit-if-no-ref/i2c5_smba_pg06: i2c5_smba_pg06 {
        pinmux = <LS_PINMUX_I2C5_SMBA_FUNC2_PG06>;
        input-enable;
    };

    /omit-if-no-ref/uart4_ctsn_pg07: uart4_ctsn_pg07 {
        pinmux = <LS_PINMUX_UART4_CTSN_FUNC2_PG07>;
        input-enable;
    };

    /omit-if-no-ref/uart10_rxd_pg08: uart10_rxd_pg08 {
        pinmux = <LS_PINMUX_UART10_RXD_FUNC2_PG08>;
        input-enable;
    };

    /omit-if-no-ref/thruout6_pg09: thruout6_pg09 {
        pinmux = <LS_PINMUX_THRUOUT6_FUNC2_PG09>;
        input-enable;
    };

    /omit-if-no-ref/uart10_txd_pg10: uart10_txd_pg10 {
        pinmux = <LS_PINMUX_UART10_TXD_FUNC2_PG10>;
        input-enable;
    };

    /omit-if-no-ref/thruin6_pg11: thruin6_pg11 {
        pinmux = <LS_PINMUX_THRUIN6_FUNC2_PG11>;
        input-enable;
    };

    /omit-if-no-ref/ltpi_nl_gpo24_pg12: ltpi_nl_gpo24_pg12 {
        pinmux = <LS_PINMUX_LTPI_NL_GPO24_FUNC2_PG12>;
        input-enable;
    };

    /omit-if-no-ref/i2c3_smba_pg13: i2c3_smba_pg13 {
        pinmux = <LS_PINMUX_I2C3_SMBA_FUNC2_PG13>;
        input-enable;
    };

    /omit-if-no-ref/i2c1_smba_pg14: i2c1_smba_pg14 {
        pinmux = <LS_PINMUX_I2C1_SMBA_FUNC2_PG14>;
        input-enable;
    };

    /omit-if-no-ref/i2c2_smba_pg15: i2c2_smba_pg15 {
        pinmux = <LS_PINMUX_I2C2_SMBA_FUNC2_PG15>;
        input-enable;
    };

    /omit-if-no-ref/fan_tach6_pq00: fan_tach6_pq00 {
        pinmux = <LS_PINMUX_FAN_TACH6_FUNC2_PQ00>;
        input-enable;
    };

    /omit-if-no-ref/fan_tach7_pq01: fan_tach7_pq01 {
        pinmux = <LS_PINMUX_FAN_TACH7_FUNC2_PQ01>;
        input-enable;
    };

    /omit-if-no-ref/ltpi_nl_gpo20_pq02: ltpi_nl_gpo20_pq02 {
        pinmux = <LS_PINMUX_LTPI_NL_GPO20_FUNC2_PQ02>;
        input-enable;
    };

    /omit-if-no-ref/ltpi_nl_gpo21_pq03: ltpi_nl_gpo21_pq03 {
        pinmux = <LS_PINMUX_LTPI_NL_GPO21_FUNC2_PQ03>;
        input-enable;
    };

    /omit-if-no-ref/ltpi_nl_gpo22_pq04: ltpi_nl_gpo22_pq04 {
        pinmux = <LS_PINMUX_LTPI_NL_GPO22_FUNC2_PQ04>;
        input-enable;
    };

    /omit-if-no-ref/i2c4_mst_scl_pq05: i2c4_mst_scl_pq05 {
        pinmux = <LS_PINMUX_I2C4_MST_SCL_FUNC2_PQ05>;
        input-enable;
    };

    /omit-if-no-ref/i2c4_mst_sda_pq06: i2c4_mst_sda_pq06 {
        pinmux = <LS_PINMUX_I2C4_MST_SDA_FUNC2_PQ06>;
        input-enable;
    };

    /omit-if-no-ref/ltpi_nl_gpi30_pq07: ltpi_nl_gpi30_pq07 {
        pinmux = <LS_PINMUX_LTPI_NL_GPI30_FUNC2_PQ07>;
        input-enable;
    };

    /omit-if-no-ref/ltpi_nl_gpi31_pq08: ltpi_nl_gpi31_pq08 {
        pinmux = <LS_PINMUX_LTPI_NL_GPI31_FUNC2_PQ08>;
        input-enable;
    };

    /omit-if-no-ref/ltpi_nl_gpo30_pq09: ltpi_nl_gpo30_pq09 {
        pinmux = <LS_PINMUX_LTPI_NL_GPO30_FUNC2_PQ09>;
        input-enable;
    };

    /omit-if-no-ref/ltpi_nl_gpo31_pq10: ltpi_nl_gpo31_pq10 {
        pinmux = <LS_PINMUX_LTPI_NL_GPO31_FUNC2_PQ10>;
        input-enable;
    };

    /omit-if-no-ref/ltpi_uart2_txd_pq11: ltpi_uart2_txd_pq11 {
        pinmux = <LS_PINMUX_LTPI_UART2_TXD_FUNC2_PQ11>;
        input-enable;
    };

    /omit-if-no-ref/ltpi_uart2_rxd_pq12: ltpi_uart2_rxd_pq12 {
        pinmux = <LS_PINMUX_LTPI_UART2_RXD_FUNC2_PQ12>;
        input-enable;
    };

    /omit-if-no-ref/ltpi_uart2_ctsn_pq13: ltpi_uart2_ctsn_pq13 {
        pinmux = <LS_PINMUX_LTPI_UART2_CTSN_FUNC2_PQ13>;
        input-enable;
    };

    /omit-if-no-ref/ltpi_uart2_rtsn_pq14: ltpi_uart2_rtsn_pq14 {
        pinmux = <LS_PINMUX_LTPI_UART2_RTSN_FUNC2_PQ14>;
        input-enable;
    };

    /omit-if-no-ref/ltpi_i2c3_scl_pq15: ltpi_i2c3_scl_pq15 {
        pinmux = <LS_PINMUX_LTPI_I2C3_SCL_FUNC2_PQ15>;
        input-enable;
    };

    /omit-if-no-ref/i2c11_smba_pm04: i2c11_smba_pm04 {
        pinmux = <LS_PINMUX_I2C11_SMBA_FUNC2_PM04>;
        input-enable;
    };

    /omit-if-no-ref/i2c12_smba_pm05: i2c12_smba_pm05 {
        pinmux = <LS_PINMUX_I2C12_SMBA_FUNC2_PM05>;
        input-enable;
    };

    /omit-if-no-ref/i2c13_smba_pm06: i2c13_smba_pm06 {
        pinmux = <LS_PINMUX_I2C13_SMBA_FUNC2_PM06>;
        input-enable;
    };

    /omit-if-no-ref/i2c14_smba_pm07: i2c14_smba_pm07 {
        pinmux = <LS_PINMUX_I2C14_SMBA_FUNC2_PM07>;
        input-enable;
    };

    /omit-if-no-ref/fan_pwm10_pm08: fan_pwm10_pm08 {
        pinmux = <LS_PINMUX_FAN_PWM10_FUNC2_PM08>;
        input-enable;
    };

    /omit-if-no-ref/fan_pwm11_pm09: fan_pwm11_pm09 {
        pinmux = <LS_PINMUX_FAN_PWM11_FUNC2_PM09>;
        input-enable;
    };

    /omit-if-no-ref/fan_pwm12_pm10: fan_pwm12_pm10 {
        pinmux = <LS_PINMUX_FAN_PWM12_FUNC2_PM10>;
        input-enable;
    };

    /omit-if-no-ref/fan_pwm13_pm11: fan_pwm13_pm11 {
        pinmux = <LS_PINMUX_FAN_PWM13_FUNC2_PM11>;
        input-enable;
    };

    /omit-if-no-ref/i2c9_smba_pm12: i2c9_smba_pm12 {
        pinmux = <LS_PINMUX_I2C9_SMBA_FUNC2_PM12>;
        input-enable;
    };

    /omit-if-no-ref/i2c10_smba_pm13: i2c10_smba_pm13 {
        pinmux = <LS_PINMUX_I2C10_SMBA_FUNC2_PM13>;
        input-enable;
    };

    /omit-if-no-ref/fan_pwm8_pm14: fan_pwm8_pm14 {
        pinmux = <LS_PINMUX_FAN_PWM8_FUNC2_PM14>;
        input-enable;
    };

    /omit-if-no-ref/fan_pwm9_pm15: fan_pwm9_pm15 {
        pinmux = <LS_PINMUX_FAN_PWM9_FUNC2_PM15>;
        input-enable;
    };

    /omit-if-no-ref/ltpi_i2c3_sda_pt00: ltpi_i2c3_sda_pt00 {
        pinmux = <LS_PINMUX_LTPI_I2C3_SDA_FUNC2_PT00>;
        input-enable;
    };

    /omit-if-no-ref/ltpi_i2c4_scl_pt01: ltpi_i2c4_scl_pt01 {
        pinmux = <LS_PINMUX_LTPI_I2C4_SCL_FUNC2_PT01>;
        input-enable;
    };

    /omit-if-no-ref/ltpi_i2c4_sda_pt02: ltpi_i2c4_sda_pt02 {
        pinmux = <LS_PINMUX_LTPI_I2C4_SDA_FUNC2_PT02>;
        input-enable;
    };

    /omit-if-no-ref/ltpi_ll_gpi10_pt03: ltpi_ll_gpi10_pt03 {
        pinmux = <LS_PINMUX_LTPI_LL_GPI10_FUNC2_PT03>;
        input-enable;
    };

    /omit-if-no-ref/ltpi_ll_gpi11_pt04: ltpi_ll_gpi11_pt04 {
        pinmux = <LS_PINMUX_LTPI_LL_GPI11_FUNC2_PT04>;
        input-enable;
    };

    /omit-if-no-ref/ltpi_ll_gpi12_pt05: ltpi_ll_gpi12_pt05 {
        pinmux = <LS_PINMUX_LTPI_LL_GPI12_FUNC2_PT05>;
        input-enable;
    };

    /omit-if-no-ref/ltpi_ll_gpi13_pt06: ltpi_ll_gpi13_pt06 {
        pinmux = <LS_PINMUX_LTPI_LL_GPI13_FUNC2_PT06>;
        input-enable;
    };

    /omit-if-no-ref/ltpi_ll_gpi14_pt07: ltpi_ll_gpi14_pt07 {
        pinmux = <LS_PINMUX_LTPI_LL_GPI14_FUNC2_PT07>;
        input-enable;
    };

    /omit-if-no-ref/ltpi_ll_gpi15_pt08: ltpi_ll_gpi15_pt08 {
        pinmux = <LS_PINMUX_LTPI_LL_GPI15_FUNC2_PT08>;
        input-enable;
    };

    /omit-if-no-ref/ltpi_ll_gpo9_pt09: ltpi_ll_gpo9_pt09 {
        pinmux = <LS_PINMUX_LTPI_LL_GPO9_FUNC2_PT09>;
        input-enable;
    };

    /omit-if-no-ref/ltpi_ll_gpo10_pt10: ltpi_ll_gpo10_pt10 {
        pinmux = <LS_PINMUX_LTPI_LL_GPO10_FUNC2_PT10>;
        input-enable;
    };

    /omit-if-no-ref/ltpi_ll_gpo11_pt11: ltpi_ll_gpo11_pt11 {
        pinmux = <LS_PINMUX_LTPI_LL_GPO11_FUNC2_PT11>;
        input-enable;
    };

    /omit-if-no-ref/ltpi_ll_gpo12_pt12: ltpi_ll_gpo12_pt12 {
        pinmux = <LS_PINMUX_LTPI_LL_GPO12_FUNC2_PT12>;
        input-enable;
    };

    /omit-if-no-ref/ltpi_ll_gpo13_pt13: ltpi_ll_gpo13_pt13 {
        pinmux = <LS_PINMUX_LTPI_LL_GPO13_FUNC2_PT13>;
        input-enable;
    };

    /omit-if-no-ref/ltpi_ll_gpo14_pt14: ltpi_ll_gpo14_pt14 {
        pinmux = <LS_PINMUX_LTPI_LL_GPO14_FUNC2_PT14>;
        input-enable;
    };

    /omit-if-no-ref/ltpi_ll_gpo15_pt15: ltpi_ll_gpo15_pt15 {
        pinmux = <LS_PINMUX_LTPI_LL_GPO15_FUNC2_PT15>;
        input-enable;
    };

    /omit-if-no-ref/ltpi_i2c5_scl_ph00: ltpi_i2c5_scl_ph00 {
        pinmux = <LS_PINMUX_LTPI_I2C5_SCL_FUNC2_PH00>;
        input-enable;
    };

    /omit-if-no-ref/thruin7_ph01: thruin7_ph01 {
        pinmux = <LS_PINMUX_THRUIN7_FUNC2_PH01>;
        input-enable;
    };

    /omit-if-no-ref/ltpi_i2c5_sda_ph02: ltpi_i2c5_sda_ph02 {
        pinmux = <LS_PINMUX_LTPI_I2C5_SDA_FUNC2_PH02>;
        input-enable;
    };

    /omit-if-no-ref/thruout7_ph03: thruout7_ph03 {
        pinmux = <LS_PINMUX_THRUOUT7_FUNC2_PH03>;
        input-enable;
    };

    /omit-if-no-ref/fan_pwm7_ph04: fan_pwm7_ph04 {
        pinmux = <LS_PINMUX_FAN_PWM7_FUNC2_PH04>;
        input-enable;
    };

    /omit-if-no-ref/fan_tach5_ph05: fan_tach5_ph05 {
        pinmux = <LS_PINMUX_FAN_TACH5_FUNC2_PH05>;
        input-enable;
    };

    /omit-if-no-ref/fan_pwm6_ph06: fan_pwm6_ph06 {
        pinmux = <LS_PINMUX_FAN_PWM6_FUNC2_PH06>;
        input-enable;
    };

    /omit-if-no-ref/fan_tach4_ph07: fan_tach4_ph07 {
        pinmux = <LS_PINMUX_FAN_TACH4_FUNC2_PH07>;
        input-enable;
    };

    /omit-if-no-ref/fan_pwm5_ph08: fan_pwm5_ph08 {
        pinmux = <LS_PINMUX_FAN_PWM5_FUNC2_PH08>;
        input-enable;
    };

    /omit-if-no-ref/fan_tach3_ph09: fan_tach3_ph09 {
        pinmux = <LS_PINMUX_FAN_TACH3_FUNC2_PH09>;
        input-enable;
    };

    /omit-if-no-ref/fan_pwm4_ph10: fan_pwm4_ph10 {
        pinmux = <LS_PINMUX_FAN_PWM4_FUNC2_PH10>;
        input-enable;
    };

    /omit-if-no-ref/fan_tach2_ph11: fan_tach2_ph11 {
        pinmux = <LS_PINMUX_FAN_TACH2_FUNC2_PH11>;
        input-enable;
    };

    /omit-if-no-ref/fan_pwm3_ph12: fan_pwm3_ph12 {
        pinmux = <LS_PINMUX_FAN_PWM3_FUNC2_PH12>;
        input-enable;
    };

    /omit-if-no-ref/fan_tach1_ph13: fan_tach1_ph13 {
        pinmux = <LS_PINMUX_FAN_TACH1_FUNC2_PH13>;
        input-enable;
    };

    /omit-if-no-ref/fan_pwm2_ph14: fan_pwm2_ph14 {
        pinmux = <LS_PINMUX_FAN_PWM2_FUNC2_PH14>;
        input-enable;
    };

    /omit-if-no-ref/fan_tach0_ph15: fan_tach0_ph15 {
        pinmux = <LS_PINMUX_FAN_TACH0_FUNC2_PH15>;
        input-enable;
    };

    /omit-if-no-ref/i2c10_scl_pj00: i2c10_scl_pj00 {
        pinmux = <LS_PINMUX_I2C10_SCL_FUNC2_PJ00>;
        input-enable;
    };

    /omit-if-no-ref/i2c10_sda_pj01: i2c10_sda_pj01 {
        pinmux = <LS_PINMUX_I2C10_SDA_FUNC2_PJ01>;
        input-enable;
    };

    /omit-if-no-ref/i2c9_scl_pj02: i2c9_scl_pj02 {
        pinmux = <LS_PINMUX_I2C9_SCL_FUNC2_PJ02>;
        input-enable;
    };

    /omit-if-no-ref/i2c9_sda_pj03: i2c9_sda_pj03 {
        pinmux = <LS_PINMUX_I2C9_SDA_FUNC2_PJ03>;
        input-enable;
    };

    /omit-if-no-ref/i2c8_scl_pj04: i2c8_scl_pj04 {
        pinmux = <LS_PINMUX_I2C8_SCL_FUNC2_PJ04>;
        input-enable;
    };

    /omit-if-no-ref/i2c8_sda_pj05: i2c8_sda_pj05 {
        pinmux = <LS_PINMUX_I2C8_SDA_FUNC2_PJ05>;
        input-enable;
    };

    /omit-if-no-ref/i2c7_scl_pj06: i2c7_scl_pj06 {
        pinmux = <LS_PINMUX_I2C7_SCL_FUNC2_PJ06>;
        input-enable;
    };

    /omit-if-no-ref/i2c7_sda_pj07: i2c7_sda_pj07 {
        pinmux = <LS_PINMUX_I2C7_SDA_FUNC2_PJ07>;
        input-enable;
    };

    /omit-if-no-ref/i2c6_scl_pj08: i2c6_scl_pj08 {
        pinmux = <LS_PINMUX_I2C6_SCL_FUNC2_PJ08>;
        input-enable;
    };

    /omit-if-no-ref/i2c6_sda_pj09: i2c6_sda_pj09 {
        pinmux = <LS_PINMUX_I2C6_SDA_FUNC2_PJ09>;
        input-enable;
    };

    /omit-if-no-ref/i2c5_scl_pj10: i2c5_scl_pj10 {
        pinmux = <LS_PINMUX_I2C5_SCL_FUNC2_PJ10>;
        input-enable;
    };

    /omit-if-no-ref/i2c5_sda_pj11: i2c5_sda_pj11 {
        pinmux = <LS_PINMUX_I2C5_SDA_FUNC2_PJ11>;
        input-enable;
    };

    /omit-if-no-ref/i2c4_scl_pj12: i2c4_scl_pj12 {
        pinmux = <LS_PINMUX_I2C4_SCL_FUNC2_PJ12>;
        input-enable;
    };

    /omit-if-no-ref/i2c4_sda_pj13: i2c4_sda_pj13 {
        pinmux = <LS_PINMUX_I2C4_SDA_FUNC2_PJ13>;
        input-enable;
    };

    /omit-if-no-ref/i2c3_scl_pj14: i2c3_scl_pj14 {
        pinmux = <LS_PINMUX_I2C3_SCL_FUNC2_PJ14>;
        input-enable;
    };

    /omit-if-no-ref/i2c3_sda_pj15: i2c3_sda_pj15 {
        pinmux = <LS_PINMUX_I2C3_SDA_FUNC2_PJ15>;
        input-enable;
    };

    /omit-if-no-ref/i2c2_scl_pk00: i2c2_scl_pk00 {
        pinmux = <LS_PINMUX_I2C2_SCL_FUNC2_PK00>;
        input-enable;
    };

    /omit-if-no-ref/i2c2_sda_pk01: i2c2_sda_pk01 {
        pinmux = <LS_PINMUX_I2C2_SDA_FUNC2_PK01>;
        input-enable;
    };

    /omit-if-no-ref/i2c1_scl_pk02: i2c1_scl_pk02 {
        pinmux = <LS_PINMUX_I2C1_SCL_FUNC2_PK02>;
        input-enable;
    };

    /omit-if-no-ref/i2c1_sda_pk03: i2c1_sda_pk03 {
        pinmux = <LS_PINMUX_I2C1_SDA_FUNC2_PK03>;
        input-enable;
    };

    /omit-if-no-ref/i2c11_scl_pk04: i2c11_scl_pk04 {
        pinmux = <LS_PINMUX_I2C11_SCL_FUNC2_PK04>;
        input-enable;
    };

    /omit-if-no-ref/i2c11_sda_pk05: i2c11_sda_pk05 {
        pinmux = <LS_PINMUX_I2C11_SDA_FUNC2_PK05>;
        input-enable;
    };

    /omit-if-no-ref/i2c12_scl_pk06: i2c12_scl_pk06 {
        pinmux = <LS_PINMUX_I2C12_SCL_FUNC2_PK06>;
        input-enable;
    };

    /omit-if-no-ref/i2c12_sda_pk07: i2c12_sda_pk07 {
        pinmux = <LS_PINMUX_I2C12_SDA_FUNC2_PK07>;
        input-enable;
    };

    /omit-if-no-ref/i2c13_scl_pk08: i2c13_scl_pk08 {
        pinmux = <LS_PINMUX_I2C13_SCL_FUNC2_PK08>;
        input-enable;
    };

    /omit-if-no-ref/i2c13_sda_pk09: i2c13_sda_pk09 {
        pinmux = <LS_PINMUX_I2C13_SDA_FUNC2_PK09>;
        input-enable;
    };

    /omit-if-no-ref/i2c14_scl_pk10: i2c14_scl_pk10 {
        pinmux = <LS_PINMUX_I2C14_SCL_FUNC2_PK10>;
        input-enable;
    };

    /omit-if-no-ref/i2c14_sda_pk11: i2c14_sda_pk11 {
        pinmux = <LS_PINMUX_I2C14_SDA_FUNC2_PK11>;
        input-enable;
    };

    /omit-if-no-ref/ltpi_nl_gpo2_pe02: ltpi_nl_gpo2_pe02 {
        pinmux = <LS_PINMUX_LTPI_NL_GPO2_FUNC3_PE02>;
        input-enable;
    };

    /omit-if-no-ref/ltpi_nl_gpo3_pe03: ltpi_nl_gpo3_pe03 {
        pinmux = <LS_PINMUX_LTPI_NL_GPO3_FUNC3_PE03>;
        input-enable;
    };

    /omit-if-no-ref/spis2_csn_pe04: spis2_csn_pe04 {
        pinmux = <LS_PINMUX_SPIS2_CSN_FUNC3_PE04>;
        input-enable;
    };

    /omit-if-no-ref/spis2_sck_pe05: spis2_sck_pe05 {
        pinmux = <LS_PINMUX_SPIS2_SCK_FUNC3_PE05>;
        input-enable;
    };

    /omit-if-no-ref/spis2_mosi_pe06: spis2_mosi_pe06 {
        pinmux = <LS_PINMUX_SPIS2_MOSI_FUNC3_PE06>;
        input-enable;
    };

    /omit-if-no-ref/spis2_miso_pe07: spis2_miso_pe07 {
        pinmux = <LS_PINMUX_SPIS2_MISO_FUNC3_PE07>;
        input-enable;
    };

    /omit-if-no-ref/ltpi_ll_gpi7_pe08: ltpi_ll_gpi7_pe08 {
        pinmux = <LS_PINMUX_LTPI_LL_GPI7_FUNC3_PE08>;
        input-enable;
    };

    /omit-if-no-ref/ltpi_ll_gpo4_pe09: ltpi_ll_gpo4_pe09 {
        pinmux = <LS_PINMUX_LTPI_LL_GPO4_FUNC3_PE09>;
        input-enable;
    };

    /omit-if-no-ref/ltpi_ll_gpo5_pe10: ltpi_ll_gpo5_pe10 {
        pinmux = <LS_PINMUX_LTPI_LL_GPO5_FUNC3_PE10>;
        input-enable;
    };

    /omit-if-no-ref/ltpi_ll_gpo6_pe11: ltpi_ll_gpo6_pe11 {
        pinmux = <LS_PINMUX_LTPI_LL_GPO6_FUNC3_PE11>;
        input-enable;
    };

    /omit-if-no-ref/ltpi_ll_gpo7_pe12: ltpi_ll_gpo7_pe12 {
        pinmux = <LS_PINMUX_LTPI_LL_GPO7_FUNC3_PE12>;
        input-enable;
    };

    /omit-if-no-ref/ltpi_ll_gpi4_pe13: ltpi_ll_gpi4_pe13 {
        pinmux = <LS_PINMUX_LTPI_LL_GPI4_FUNC3_PE13>;
        input-enable;
    };

    /omit-if-no-ref/ltpi_ll_gpi5_pe14: ltpi_ll_gpi5_pe14 {
        pinmux = <LS_PINMUX_LTPI_LL_GPI5_FUNC3_PE14>;
        input-enable;
    };

    /omit-if-no-ref/ltpi_ll_gpi6_pe15: ltpi_ll_gpi6_pe15 {
        pinmux = <LS_PINMUX_LTPI_LL_GPI6_FUNC3_PE15>;
        input-enable;
    };

    /omit-if-no-ref/uart8_rxd_pb00: uart8_rxd_pb00 {
        pinmux = <LS_PINMUX_UART8_RXD_FUNC3_PB00>;
        input-enable;
    };

    /omit-if-no-ref/uart8_txd_pb01: uart8_txd_pb01 {
        pinmux = <LS_PINMUX_UART8_TXD_FUNC3_PB01>;
        input-enable;
    };

    /omit-if-no-ref/uart7_rxd_pb02: uart7_rxd_pb02 {
        pinmux = <LS_PINMUX_UART7_RXD_FUNC3_PB02>;
        input-enable;
    };

    /omit-if-no-ref/uart7_txd_pb03: uart7_txd_pb03 {
        pinmux = <LS_PINMUX_UART7_TXD_FUNC3_PB03>;
        input-enable;
    };

    /omit-if-no-ref/uart5_txd_pb04: uart5_txd_pb04 {
        pinmux = <LS_PINMUX_UART5_TXD_FUNC3_PB04>;
        input-enable;
    };

    /omit-if-no-ref/uart5_rxd_pb05: uart5_rxd_pb05 {
        pinmux = <LS_PINMUX_UART5_RXD_FUNC3_PB05>;
        input-enable;
    };

    /omit-if-no-ref/uart9_txd_pb06: uart9_txd_pb06 {
        pinmux = <LS_PINMUX_UART9_TXD_FUNC3_PB06>;
        input-enable;
    };

    /omit-if-no-ref/sgpio1_mst_ck_pb07: sgpio1_mst_ck_pb07 {
        pinmux = <LS_PINMUX_SGPIO1_MST_CK_FUNC3_PB07>;
        input-enable;
    };

    /omit-if-no-ref/sgpio1_mst_di_pb08: sgpio1_mst_di_pb08 {
        pinmux = <LS_PINMUX_SGPIO1_MST_DI_FUNC3_PB08>;
        input-enable;
    };

    /omit-if-no-ref/uart4_rin_pb09: uart4_rin_pb09 {
        pinmux = <LS_PINMUX_UART4_RIN_FUNC3_PB09>;
        input-enable;
    };

    /omit-if-no-ref/uart2_rxd_pb12: uart2_rxd_pb12 {
        pinmux = <LS_PINMUX_UART2_RXD_FUNC3_PB12>;
        input-enable;
    };

    /omit-if-no-ref/uart2_txd_pb13: uart2_txd_pb13 {
        pinmux = <LS_PINMUX_UART2_TXD_FUNC3_PB13>;
        input-enable;
    };

    /omit-if-no-ref/uart6_rxd_pb14: uart6_rxd_pb14 {
        pinmux = <LS_PINMUX_UART6_RXD_FUNC3_PB14>;
        input-enable;
    };

    /omit-if-no-ref/uart6_txd_pb15: uart6_txd_pb15 {
        pinmux = <LS_PINMUX_UART6_TXD_FUNC3_PB15>;
        input-enable;
    };

    /omit-if-no-ref/lpc2_serirq_pi01: lpc2_serirq_pi01 {
        pinmux = <LS_PINMUX_LPC2_SERIRQ_FUNC3_PI01>;
        input-enable;
    };

    /omit-if-no-ref/lpc2_frm_pi02: lpc2_frm_pi02 {
        pinmux = <LS_PINMUX_LPC2_FRM_FUNC3_PI02>;
        input-enable;
    };

    /omit-if-no-ref/lpc2_clk_pi03: lpc2_clk_pi03 {
        pinmux = <LS_PINMUX_LPC2_CLK_FUNC3_PI03>;
        input-enable;
    };

    /omit-if-no-ref/lpc2_dat3_pi04: lpc2_dat3_pi04 {
        pinmux = <LS_PINMUX_LPC2_DAT3_FUNC3_PI04>;
        input-enable;
    };

    /omit-if-no-ref/lpc2_dat2_pi05: lpc2_dat2_pi05 {
        pinmux = <LS_PINMUX_LPC2_DAT2_FUNC3_PI05>;
        input-enable;
    };

    /omit-if-no-ref/lpc2_dat1_pi06: lpc2_dat1_pi06 {
        pinmux = <LS_PINMUX_LPC2_DAT1_FUNC3_PI06>;
        input-enable;
    };

    /omit-if-no-ref/lpc2_dat0_pi07: lpc2_dat0_pi07 {
        pinmux = <LS_PINMUX_LPC2_DAT0_FUNC3_PI07>;
        input-enable;
    };

    /omit-if-no-ref/lpc1_serirq_pi09: lpc1_serirq_pi09 {
        pinmux = <LS_PINMUX_LPC1_SERIRQ_FUNC3_PI09>;
        input-enable;
    };

    /omit-if-no-ref/lpc1_frm_pi10: lpc1_frm_pi10 {
        pinmux = <LS_PINMUX_LPC1_FRM_FUNC3_PI10>;
        input-enable;
    };

    /omit-if-no-ref/lpc1_clk_pi11: lpc1_clk_pi11 {
        pinmux = <LS_PINMUX_LPC1_CLK_FUNC3_PI11>;
        input-enable;
    };

    /omit-if-no-ref/lpc1_dat3_pi12: lpc1_dat3_pi12 {
        pinmux = <LS_PINMUX_LPC1_DAT3_FUNC3_PI12>;
        input-enable;
    };

    /omit-if-no-ref/lpc1_dat2_pi13: lpc1_dat2_pi13 {
        pinmux = <LS_PINMUX_LPC1_DAT2_FUNC3_PI13>;
        input-enable;
    };

    /omit-if-no-ref/lpc1_dat1_pi14: lpc1_dat1_pi14 {
        pinmux = <LS_PINMUX_LPC1_DAT1_FUNC3_PI14>;
        input-enable;
    };

    /omit-if-no-ref/lpc1_dat0_pi15: lpc1_dat0_pi15 {
        pinmux = <LS_PINMUX_LPC1_DAT0_FUNC3_PI15>;
        input-enable;
    };

    // /omit-if-no-ref/qspi1_sck_pa00: qspi1_sck_pa00 {
    //     pinmux = <LS_PINMUX_QSPI1_SCK_FUNC3_PA00>;
    //     input-enable;
    // };

    // /omit-if-no-ref/qspi1_csn_pa01: qspi1_csn_pa01 {
    //     pinmux = <LS_PINMUX_QSPI1_CSN_FUNC3_PA01>;
    //     input-enable;
    // };

    /omit-if-no-ref/qspi1_dat0_pa02: qspi1_dat0_pa02 {
        pinmux = <LS_PINMUX_QSPI1_DAT0_FUNC3_PA02>;
        input-enable;
    };

    /omit-if-no-ref/qspi1_dat1_pa03: qspi1_dat1_pa03 {
        pinmux = <LS_PINMUX_QSPI1_DAT1_FUNC3_PA03>;
        input-enable;
    };

    /omit-if-no-ref/qspi1_dat2_pa04: qspi1_dat2_pa04 {
        pinmux = <LS_PINMUX_QSPI1_DAT2_FUNC3_PA04>;
        input-enable;
    };

    /omit-if-no-ref/qspi1_dat3_pa05: qspi1_dat3_pa05 {
        pinmux = <LS_PINMUX_QSPI1_DAT3_FUNC3_PA05>;
        input-enable;
    };

    /omit-if-no-ref/ltpi_i2c2_sda_pa06: ltpi_i2c2_sda_pa06 {
        pinmux = <LS_PINMUX_LTPI_I2C2_SDA_FUNC3_PA06>;
        input-enable;
    };

    /omit-if-no-ref/ltpi_i2c2_scl_pa07: ltpi_i2c2_scl_pa07 {
        pinmux = <LS_PINMUX_LTPI_I2C2_SCL_FUNC3_PA07>;
        input-enable;
    };

    /omit-if-no-ref/ltpi_nl_gpi16_pa08: ltpi_nl_gpi16_pa08 {
        pinmux = <LS_PINMUX_LTPI_NL_GPI16_FUNC3_PA08>;
        input-enable;
    };

    /omit-if-no-ref/ltpi_nl_gpi17_pa09: ltpi_nl_gpi17_pa09 {
        pinmux = <LS_PINMUX_LTPI_NL_GPI17_FUNC3_PA09>;
        input-enable;
    };

    /omit-if-no-ref/ltpi_nl_gpi18_pa10: ltpi_nl_gpi18_pa10 {
        pinmux = <LS_PINMUX_LTPI_NL_GPI18_FUNC3_PA10>;
        input-enable;
    };

    /omit-if-no-ref/ltpi_nl_gpi19_pa11: ltpi_nl_gpi19_pa11 {
        pinmux = <LS_PINMUX_LTPI_NL_GPI19_FUNC3_PA11>;
        input-enable;
    };

    /omit-if-no-ref/ltpi_nl_gpo16_pa12: ltpi_nl_gpo16_pa12 {
        pinmux = <LS_PINMUX_LTPI_NL_GPO16_FUNC3_PA12>;
        input-enable;
    };

    /omit-if-no-ref/ltpi_nl_gpo17_pa13: ltpi_nl_gpo17_pa13 {
        pinmux = <LS_PINMUX_LTPI_NL_GPO17_FUNC3_PA13>;
        input-enable;
    };

    /omit-if-no-ref/ltpi_nl_gpo18_pa14: ltpi_nl_gpo18_pa14 {
        pinmux = <LS_PINMUX_LTPI_NL_GPO18_FUNC3_PA14>;
        input-enable;
    };

    /omit-if-no-ref/ltpi_nl_gpo19_pa15: ltpi_nl_gpo19_pa15 {
        pinmux = <LS_PINMUX_LTPI_NL_GPO19_FUNC3_PA15>;
        input-enable;
    };

    /omit-if-no-ref/ltpi_nl_gpo0_pe00: ltpi_nl_gpo0_pe00 {
        pinmux = <LS_PINMUX_LTPI_NL_GPO0_FUNC3_PE00>;
        input-enable;
    };

    /omit-if-no-ref/ltpi_nl_gpo1_pe01: ltpi_nl_gpo1_pe01 {
        pinmux = <LS_PINMUX_LTPI_NL_GPO1_FUNC3_PE01>;
        input-enable;
    };

    /omit-if-no-ref/paral_busy_pn00: paral_busy_pn00 {
        pinmux = <LS_PINMUX_PARAL_BUSY_FUNC3_PN00>;
        input-enable;
    };

    /omit-if-no-ref/paral_fault_pn01: paral_fault_pn01 {
        pinmux = <LS_PINMUX_PARAL_FAULT_FUNC3_PN01>;
        input-enable;
    };

    /omit-if-no-ref/i2c15_scl_pn02: i2c15_scl_pn02 {
        pinmux = <LS_PINMUX_I2C15_SCL_FUNC3_PN02>;
        input-enable;
    };

    /omit-if-no-ref/i2c15_sda_pn03: i2c15_sda_pn03 {
        pinmux = <LS_PINMUX_I2C15_SDA_FUNC3_PN03>;
        input-enable;
    };

    /omit-if-no-ref/i2c16_scl_pn04: i2c16_scl_pn04 {
        pinmux = <LS_PINMUX_I2C16_SCL_FUNC3_PN04>;
        input-enable;
    };

    /omit-if-no-ref/i2c16_sda_pn05: i2c16_sda_pn05 {
        pinmux = <LS_PINMUX_I2C16_SDA_FUNC3_PN05>;
        input-enable;
    };

    /omit-if-no-ref/uart12_txd_pn06: uart12_txd_pn06 {
        pinmux = <LS_PINMUX_UART12_TXD_FUNC3_PN06>;
        input-enable;
    };

    /omit-if-no-ref/uart12_rxd_pn07: uart12_rxd_pn07 {
        pinmux = <LS_PINMUX_UART12_RXD_FUNC3_PN07>;
        input-enable;
    };

    /omit-if-no-ref/ltpi_ll_gpi9_pn08: ltpi_ll_gpi9_pn08 {
        pinmux = <LS_PINMUX_LTPI_LL_GPI9_FUNC3_PN08>;
        input-enable;
    };

    /omit-if-no-ref/uart11_rxd_pn09: uart11_rxd_pn09 {
        pinmux = <LS_PINMUX_UART11_RXD_FUNC3_PN09>;
        input-enable;
    };

    /omit-if-no-ref/uart11_txd_pn10: uart11_txd_pn10 {
        pinmux = <LS_PINMUX_UART11_TXD_FUNC3_PN10>;
        input-enable;
    };

    /omit-if-no-ref/thruin3_pf00: thruin3_pf00 {
        pinmux = <LS_PINMUX_THRUIN3_FUNC3_PF00>;
        input-enable;
    };

    /omit-if-no-ref/spi3_mst_csn_pf01: spi3_mst_csn_pf01 {
        pinmux = <LS_PINMUX_SPI3_MST_CSN_FUNC3_PF01>;
        input-enable;
    };

    /omit-if-no-ref/thruout3_pf02: thruout3_pf02 {
        pinmux = <LS_PINMUX_THRUOUT3_FUNC3_PF02>;
        input-enable;
    };

    /omit-if-no-ref/spi3_mst_io1_pf03: spi3_mst_io1_pf03 {
        pinmux = <LS_PINMUX_SPI3_MST_IO1_FUNC3_PF03>;
        input-enable;
    };

    /omit-if-no-ref/i2c13_smba_pf04: i2c13_smba_pf04 {
        pinmux = <LS_PINMUX_I2C13_SMBA_FUNC3_PF04>;
        input-enable;
    };

    /omit-if-no-ref/spi3_mst_io0_pf05: spi3_mst_io0_pf05 {
        pinmux = <LS_PINMUX_SPI3_MST_IO0_FUNC3_PF05>;
        input-enable;
    };

    /omit-if-no-ref/i2c14_smba_pf06: i2c14_smba_pf06 {
        pinmux = <LS_PINMUX_I2C14_SMBA_FUNC3_PF06>;
        input-enable;
    };

    /omit-if-no-ref/spi3_mst_io3_pf07: spi3_mst_io3_pf07 {
        pinmux = <LS_PINMUX_SPI3_MST_IO3_FUNC3_PF07>;
        input-enable;
    };

    /omit-if-no-ref/i2c12_smba_pf08: i2c12_smba_pf08 {
        pinmux = <LS_PINMUX_I2C12_SMBA_FUNC3_PF08>;
        input-enable;
    };

    /omit-if-no-ref/spi3_mst_clk_pf09: spi3_mst_clk_pf09 {
        pinmux = <LS_PINMUX_SPI3_MST_CLK_FUNC3_PF09>;
        input-enable;
    };

    /omit-if-no-ref/i2c11_smba_pf10: i2c11_smba_pf10 {
        pinmux = <LS_PINMUX_I2C11_SMBA_FUNC3_PF10>;
        input-enable;
    };

    /omit-if-no-ref/spi3_mst_io2_pf11: spi3_mst_io2_pf11 {
        pinmux = <LS_PINMUX_SPI3_MST_IO2_FUNC3_PF11>;
        input-enable;
    };

    /omit-if-no-ref/i2c4_smba_pf12: i2c4_smba_pf12 {
        pinmux = <LS_PINMUX_I2C4_SMBA_FUNC3_PF12>;
        input-enable;
    };

    /omit-if-no-ref/spi1_mst_io1_pf13: spi1_mst_io1_pf13 {
        pinmux = <LS_PINMUX_SPI1_MST_IO1_FUNC3_PF13>;
        input-enable;
    };

    /omit-if-no-ref/i2c3_smba_pf14: i2c3_smba_pf14 {
        pinmux = <LS_PINMUX_I2C3_SMBA_FUNC3_PF14>;
        input-enable;
    };

    /omit-if-no-ref/spi1_mst_io0_pf15: spi1_mst_io0_pf15 {
        pinmux = <LS_PINMUX_SPI1_MST_IO0_FUNC3_PF15>;
        input-enable;
    };

    /omit-if-no-ref/spis1_mosi_pc00: spis1_mosi_pc00 {
        pinmux = <LS_PINMUX_SPIS1_MOSI_FUNC3_PC00>;
        input-enable;
    };

    /omit-if-no-ref/spis1_miso_pc01: spis1_miso_pc01 {
        pinmux = <LS_PINMUX_SPIS1_MISO_FUNC3_PC01>;
        input-enable;
    };

    /omit-if-no-ref/spis1_csn_pc02: spis1_csn_pc02 {
        pinmux = <LS_PINMUX_SPIS1_CSN_FUNC3_PC02>;
        input-enable;
    };

    /omit-if-no-ref/spis1_sck_pc03: spis1_sck_pc03 {
        pinmux = <LS_PINMUX_SPIS1_SCK_FUNC3_PC03>;
        input-enable;
    };

    /omit-if-no-ref/qspi2_sck_pc04: qspi2_sck_pc04 {
        pinmux = <LS_PINMUX_QSPI2_SCK_FUNC3_PC04>;
        input-enable;
    };

    /omit-if-no-ref/qspi2_csn_pc05: qspi2_csn_pc05 {
        pinmux = <LS_PINMUX_QSPI2_CSN_FUNC3_PC05>;
        input-enable;
    };

    /omit-if-no-ref/wdtrst1_pc06: wdtrst1_pc06 {
        pinmux = <LS_PINMUX_WDTRST1_FUNC3_PC06>;
        input-enable;
    };

    /omit-if-no-ref/wdtrst2_pc07: wdtrst2_pc07 {
        pinmux = <LS_PINMUX_WDTRST2_FUNC3_PC07>;
        input-enable;
    };

    /omit-if-no-ref/wdtrst3_pc08: wdtrst3_pc08 {
        pinmux = <LS_PINMUX_WDTRST3_FUNC3_PC08>;
        input-enable;
    };

    /omit-if-no-ref/wdtrst4_pc09: wdtrst4_pc09 {
        pinmux = <LS_PINMUX_WDTRST4_FUNC3_PC09>;
        input-enable;
    };

    /omit-if-no-ref/mjtag3_tdi_pc10: mjtag3_tdi_pc10 {
        pinmux = <LS_PINMUX_MJTAG3_TDI_FUNC3_PC10>;
        input-enable;
    };

    /omit-if-no-ref/mjtag3_tdo_pc11: mjtag3_tdo_pc11 {
        pinmux = <LS_PINMUX_MJTAG3_TDO_FUNC3_PC11>;
        input-enable;
    };

    /omit-if-no-ref/mjtag3_tck_pc12: mjtag3_tck_pc12 {
        pinmux = <LS_PINMUX_MJTAG3_TCK_FUNC3_PC12>;
        input-enable;
    };

    /omit-if-no-ref/mjtag3_tms_pc13: mjtag3_tms_pc13 {
        pinmux = <LS_PINMUX_MJTAG3_TMS_FUNC3_PC13>;
        input-enable;
    };

    /omit-if-no-ref/ltpi_nl_gpo25_pc14: ltpi_nl_gpo25_pc14 {
        pinmux = <LS_PINMUX_LTPI_NL_GPO25_FUNC3_PC14>;
        input-enable;
    };

    /omit-if-no-ref/ulpi_dir_pc15: ulpi_dir_pc15 {
        pinmux = <LS_PINMUX_ULPI_DIR_FUNC3_PC15>;
        input-enable;
    };

    /omit-if-no-ref/ltpi_nl_gpi0_pd00: ltpi_nl_gpi0_pd00 {
        pinmux = <LS_PINMUX_LTPI_NL_GPI0_FUNC3_PD00>;
        input-enable;
    };

    /omit-if-no-ref/ltpi_nl_gpi1_pd01: ltpi_nl_gpi1_pd01 {
        pinmux = <LS_PINMUX_LTPI_NL_GPI1_FUNC3_PD01>;
        input-enable;
    };

    /omit-if-no-ref/ltpi_nl_gpi2_pd02: ltpi_nl_gpi2_pd02 {
        pinmux = <LS_PINMUX_LTPI_NL_GPI2_FUNC3_PD02>;
        input-enable;
    };

    /omit-if-no-ref/ltpi_nl_gpi3_pd03: ltpi_nl_gpi3_pd03 {
        pinmux = <LS_PINMUX_LTPI_NL_GPI3_FUNC3_PD03>;
        input-enable;
    };

    /omit-if-no-ref/ltpi_nl_gpi4_pd04: ltpi_nl_gpi4_pd04 {
        pinmux = <LS_PINMUX_LTPI_NL_GPI4_FUNC3_PD04>;
        input-enable;
    };

    /omit-if-no-ref/ltpi_nl_gpi5_pd05: ltpi_nl_gpi5_pd05 {
        pinmux = <LS_PINMUX_LTPI_NL_GPI5_FUNC3_PD05>;
        input-enable;
    };

    /omit-if-no-ref/ltpi_nl_gpi6_pd06: ltpi_nl_gpi6_pd06 {
        pinmux = <LS_PINMUX_LTPI_NL_GPI6_FUNC3_PD06>;
        input-enable;
    };

    /omit-if-no-ref/ltpi_nl_gpi7_pd07: ltpi_nl_gpi7_pd07 {
        pinmux = <LS_PINMUX_LTPI_NL_GPI7_FUNC3_PD07>;
        input-enable;
    };

    /omit-if-no-ref/ltpi_nl_gpi8_pd08: ltpi_nl_gpi8_pd08 {
        pinmux = <LS_PINMUX_LTPI_NL_GPI8_FUNC3_PD08>;
        input-enable;
    };

    /omit-if-no-ref/ltpi_nl_gpi9_pd09: ltpi_nl_gpi9_pd09 {
        pinmux = <LS_PINMUX_LTPI_NL_GPI9_FUNC3_PD09>;
        input-enable;
    };

    /omit-if-no-ref/ltpi_nl_gpi10_pd10: ltpi_nl_gpi10_pd10 {
        pinmux = <LS_PINMUX_LTPI_NL_GPI10_FUNC3_PD10>;
        input-enable;
    };

    /omit-if-no-ref/ltpi_nl_gpi11_pd11: ltpi_nl_gpi11_pd11 {
        pinmux = <LS_PINMUX_LTPI_NL_GPI11_FUNC3_PD11>;
        input-enable;
    };

    /omit-if-no-ref/ltpi_nl_gpi12_pd12: ltpi_nl_gpi12_pd12 {
        pinmux = <LS_PINMUX_LTPI_NL_GPI12_FUNC3_PD12>;
        input-enable;
    };

    /omit-if-no-ref/ltpi_nl_gpi13_pd13: ltpi_nl_gpi13_pd13 {
        pinmux = <LS_PINMUX_LTPI_NL_GPI13_FUNC3_PD13>;
        input-enable;
    };

    /omit-if-no-ref/ltpi_nl_gpi14_pd14: ltpi_nl_gpi14_pd14 {
        pinmux = <LS_PINMUX_LTPI_NL_GPI14_FUNC3_PD14>;
        input-enable;
    };

    /omit-if-no-ref/ltpi_nl_gpi15_pd15: ltpi_nl_gpi15_pd15 {
        pinmux = <LS_PINMUX_LTPI_NL_GPI15_FUNC3_PD15>;
        input-enable;
    };

    /omit-if-no-ref/i3c14_sda_pk12: i3c14_sda_pk12 {
        pinmux = <LS_PINMUX_I3C14_SDA_FUNC3_PK12>;
        input-enable;
    };

    /omit-if-no-ref/i3c14_scl_pk13: i3c14_scl_pk13 {
        pinmux = <LS_PINMUX_I3C14_SCL_FUNC3_PK13>;
        input-enable;
    };

    /omit-if-no-ref/i3c13_sda_pk14: i3c13_sda_pk14 {
        pinmux = <LS_PINMUX_I3C13_SDA_FUNC3_PK14>;
        input-enable;
    };

    /omit-if-no-ref/i3c13_scl_pk15: i3c13_scl_pk15 {
        pinmux = <LS_PINMUX_I3C13_SCL_FUNC3_PK15>;
        input-enable;
    };

    /omit-if-no-ref/i3c12_sda_pm00: i3c12_sda_pm00 {
        pinmux = <LS_PINMUX_I3C12_SDA_FUNC3_PM00>;
        input-enable;
    };

    /omit-if-no-ref/i3c12_scl_pm01: i3c12_scl_pm01 {
        pinmux = <LS_PINMUX_I3C12_SCL_FUNC3_PM01>;
        input-enable;
    };

    /omit-if-no-ref/i3c11_sda_pm02: i3c11_sda_pm02 {
        pinmux = <LS_PINMUX_I3C11_SDA_FUNC3_PM02>;
        input-enable;
    };

    /omit-if-no-ref/i3c11_scl_pm03: i3c11_scl_pm03 {
        pinmux = <LS_PINMUX_I3C11_SCL_FUNC3_PM03>;
        input-enable;
    };

    /omit-if-no-ref/i2c2_smba_pg00: i2c2_smba_pg00 {
        pinmux = <LS_PINMUX_I2C2_SMBA_FUNC3_PG00>;
        input-enable;
    };

    /omit-if-no-ref/spi1_mst_clk_pg01: spi1_mst_clk_pg01 {
        pinmux = <LS_PINMUX_SPI1_MST_CLK_FUNC3_PG01>;
        input-enable;
    };

    /omit-if-no-ref/i2c1_smba_pg02: i2c1_smba_pg02 {
        pinmux = <LS_PINMUX_I2C1_SMBA_FUNC3_PG02>;
        input-enable;
    };

    /omit-if-no-ref/spi1_mst_csn_pg03: spi1_mst_csn_pg03 {
        pinmux = <LS_PINMUX_SPI1_MST_CSN_FUNC3_PG03>;
        input-enable;
    };

    /omit-if-no-ref/fan_pwm13_pg04: fan_pwm13_pg04 {
        pinmux = <LS_PINMUX_FAN_PWM13_FUNC3_PG04>;
        input-enable;
    };

    /omit-if-no-ref/spi1_mst_io3_pg05: spi1_mst_io3_pg05 {
        pinmux = <LS_PINMUX_SPI1_MST_IO3_FUNC3_PG05>;
        input-enable;
    };

    /omit-if-no-ref/fan_pwm12_pg06: fan_pwm12_pg06 {
        pinmux = <LS_PINMUX_FAN_PWM12_FUNC3_PG06>;
        input-enable;
    };

    /omit-if-no-ref/spi1_mst_io2_pg07: spi1_mst_io2_pg07 {
        pinmux = <LS_PINMUX_SPI1_MST_IO2_FUNC3_PG07>;
        input-enable;
    };

    /omit-if-no-ref/uart4_rtsn_pg08: uart4_rtsn_pg08 {
        pinmux = <LS_PINMUX_UART4_RTSN_FUNC3_PG08>;
        input-enable;
    };

    /omit-if-no-ref/spi2_mst_clk_pg09: spi2_mst_clk_pg09 {
        pinmux = <LS_PINMUX_SPI2_MST_CLK_FUNC3_PG09>;
        input-enable;
    };

    /omit-if-no-ref/uart4_dtrn_pg10: uart4_dtrn_pg10 {
        pinmux = <LS_PINMUX_UART4_DTRN_FUNC3_PG10>;
        input-enable;
    };

    /omit-if-no-ref/spi2_mst_csn_pg11: spi2_mst_csn_pg11 {
        pinmux = <LS_PINMUX_SPI2_MST_CSN_FUNC3_PG11>;
        input-enable;
    };

    /omit-if-no-ref/thruout5_pg12: thruout5_pg12 {
        pinmux = <LS_PINMUX_THRUOUT5_FUNC3_PG12>;
        input-enable;
    };

    /omit-if-no-ref/spi2_mst_io3_pg13: spi2_mst_io3_pg13 {
        pinmux = <LS_PINMUX_SPI2_MST_IO3_FUNC3_PG13>;
        input-enable;
    };

    /omit-if-no-ref/thruin5_pg14: thruin5_pg14 {
        pinmux = <LS_PINMUX_THRUIN5_FUNC3_PG14>;
        input-enable;
    };

    /omit-if-no-ref/spi2_mst_io2_pg15: spi2_mst_io2_pg15 {
        pinmux = <LS_PINMUX_SPI2_MST_IO2_FUNC3_PG15>;
        input-enable;
    };

    /omit-if-no-ref/paral_autofd_pq00: paral_autofd_pq00 {
        pinmux = <LS_PINMUX_PARAL_AUTOFD_FUNC3_PQ00>;
        input-enable;
    };

    /omit-if-no-ref/ltpi_hpm_intr_pq01: ltpi_hpm_intr_pq01 {
        pinmux = <LS_PINMUX_LTPI_HPM_INTR_FUNC3_PQ01>;
        input-enable;
    };

    /omit-if-no-ref/uart5_ctsn_pq07: uart5_ctsn_pq07 {
        pinmux = <LS_PINMUX_UART5_CTSN_FUNC3_PQ07>;
        input-enable;
    };

    /omit-if-no-ref/uart5_dcdn_pq08: uart5_dcdn_pq08 {
        pinmux = <LS_PINMUX_UART5_DCDN_FUNC3_PQ08>;
        input-enable;
    };

    /omit-if-no-ref/uart5_dsrn_pq09: uart5_dsrn_pq09 {
        pinmux = <LS_PINMUX_UART5_DSRN_FUNC3_PQ09>;
        input-enable;
    };

    /omit-if-no-ref/uart5_rin_pq10: uart5_rin_pq10 {
        pinmux = <LS_PINMUX_UART5_RIN_FUNC3_PQ10>;
        input-enable;
    };

    /omit-if-no-ref/uart5_dtrn_pq11: uart5_dtrn_pq11 {
        pinmux = <LS_PINMUX_UART5_DTRN_FUNC3_PQ11>;
        input-enable;
    };

    /omit-if-no-ref/uart5_rtsn_pq12: uart5_rtsn_pq12 {
        pinmux = <LS_PINMUX_UART5_RTSN_FUNC3_PQ12>;
        input-enable;
    };

    /omit-if-no-ref/uart6_ctsn_pq13: uart6_ctsn_pq13 {
        pinmux = <LS_PINMUX_UART6_CTSN_FUNC3_PQ13>;
        input-enable;
    };

    /omit-if-no-ref/uart6_dcdn_pq14: uart6_dcdn_pq14 {
        pinmux = <LS_PINMUX_UART6_DCDN_FUNC3_PQ14>;
        input-enable;
    };

    /omit-if-no-ref/uart6_dsrn_pq15: uart6_dsrn_pq15 {
        pinmux = <LS_PINMUX_UART6_DSRN_FUNC3_PQ15>;
        input-enable;
    };

    /omit-if-no-ref/uart7_txd_pm04: uart7_txd_pm04 {
        pinmux = <LS_PINMUX_UART7_TXD_FUNC3_PM04>;
        input-enable;
    };

    /omit-if-no-ref/uart7_rxd_pm05: uart7_rxd_pm05 {
        pinmux = <LS_PINMUX_UART7_RXD_FUNC3_PM05>;
        input-enable;
    };

    /omit-if-no-ref/uart8_txd_pm06: uart8_txd_pm06 {
        pinmux = <LS_PINMUX_UART8_TXD_FUNC3_PM06>;
        input-enable;
    };

    /omit-if-no-ref/uart8_rxd_pm07: uart8_rxd_pm07 {
        pinmux = <LS_PINMUX_UART8_RXD_FUNC3_PM07>;
        input-enable;
    };

    /omit-if-no-ref/sd2_dat0_pm08: sd2_dat0_pm08 {
        pinmux = <LS_PINMUX_SD2_DAT0_FUNC3_PM08>;
        input-enable;
    };

    /omit-if-no-ref/sd2_dat1_pm09: sd2_dat1_pm09 {
        pinmux = <LS_PINMUX_SD2_DAT1_FUNC3_PM09>;
        input-enable;
    };

    /omit-if-no-ref/sd2_dat2_pm10: sd2_dat2_pm10 {
        pinmux = <LS_PINMUX_SD2_DAT2_FUNC3_PM10>;
        input-enable;
    };

    /omit-if-no-ref/sd2_dat3_pm11: sd2_dat3_pm11 {
        pinmux = <LS_PINMUX_SD2_DAT3_FUNC3_PM11>;
        input-enable;
    };

    /omit-if-no-ref/uart6_txd_pm12: uart6_txd_pm12 {
        pinmux = <LS_PINMUX_UART6_TXD_FUNC3_PM12>;
        input-enable;
    };

    /omit-if-no-ref/uart6_rxd_pm13: uart6_rxd_pm13 {
        pinmux = <LS_PINMUX_UART6_RXD_FUNC3_PM13>;
        input-enable;
    };

    /omit-if-no-ref/mjtag3_trst_pm14: mjtag3_trst_pm14 {
        pinmux = <LS_PINMUX_MJTAG3_TRST_FUNC3_PM14>;
        input-enable;
    };

    /omit-if-no-ref/sd2_cmd_pm15: sd2_cmd_pm15 {
        pinmux = <LS_PINMUX_SD2_CMD_FUNC3_PM15>;
        input-enable;
    };

    /omit-if-no-ref/uart6_rin_pt00: uart6_rin_pt00 {
        pinmux = <LS_PINMUX_UART6_RIN_FUNC3_PT00>;
        input-enable;
    };

    /omit-if-no-ref/uart6_dtrn_pt01: uart6_dtrn_pt01 {
        pinmux = <LS_PINMUX_UART6_DTRN_FUNC3_PT01>;
        input-enable;
    };

    /omit-if-no-ref/uart6_rtsn_pt02: uart6_rtsn_pt02 {
        pinmux = <LS_PINMUX_UART6_RTSN_FUNC3_PT02>;
        input-enable;
    };

    // /omit-if-no-ref/rgmii1_txck_pt03: rgmii1_txck_pt03 {
    //     pinmux = <LS_PINMUX_RGMII1_TXCK_FUNC3_PT03>;
    //     input-enable;
    // };

    // /omit-if-no-ref/rgmii1_txctl_pt04: rgmii1_txctl_pt04 {
    //     pinmux = <LS_PINMUX_RGMII1_TXCTL_FUNC3_PT04>;
    //     input-enable;
    // };

    // /omit-if-no-ref/rgmii1_txd0_pt05: rgmii1_txd0_pt05 {
    //     pinmux = <LS_PINMUX_RGMII1_TXD0_FUNC3_PT05>;
    //     input-enable;
    // };

    // /omit-if-no-ref/rgmii1_txd1_pt06: rgmii1_txd1_pt06 {
    //     pinmux = <LS_PINMUX_RGMII1_TXD1_FUNC3_PT06>;
    //     input-enable;
    // };

    // /omit-if-no-ref/rgmii1_txd2_pt07: rgmii1_txd2_pt07 {
    //     pinmux = <LS_PINMUX_RGMII1_TXD2_FUNC3_PT07>;
    //     input-enable;
    // };

    // /omit-if-no-ref/rgmii1_txd3_pt08: rgmii1_txd3_pt08 {
    //     pinmux = <LS_PINMUX_RGMII1_TXD3_FUNC3_PT08>;
    //     input-enable;
    // };

    // /omit-if-no-ref/rgmii_ref_clk_pt09: rgmii_ref_clk_pt09 {
    //     pinmux = <LS_PINMUX_RGMII_REF_CLK_FUNC3_PT09>;
    //     input-enable;
    // };

    // /omit-if-no-ref/rgmii1_rxck_pt10: rgmii1_rxck_pt10 {
    //     pinmux = <LS_PINMUX_RGMII1_RXCK_FUNC3_PT10>;
    //     input-enable;
    // };

    // /omit-if-no-ref/rgmii1_rxctl_pt11: rgmii1_rxctl_pt11 {
    //     pinmux = <LS_PINMUX_RGMII1_RXCTL_FUNC3_PT11>;
    //     input-enable;
    // };

    // /omit-if-no-ref/rgmii1_rxd0_pt12: rgmii1_rxd0_pt12 {
    //     pinmux = <LS_PINMUX_RGMII1_RXD0_FUNC3_PT12>;
    //     input-enable;
    // };

    // /omit-if-no-ref/rgmii1_rxd1_pt13: rgmii1_rxd1_pt13 {
    //     pinmux = <LS_PINMUX_RGMII1_RXD1_FUNC3_PT13>;
    //     input-enable;
    // };

    // /omit-if-no-ref/rgmii1_rxd2_pt14: rgmii1_rxd2_pt14 {
    //     pinmux = <LS_PINMUX_RGMII1_RXD2_FUNC3_PT14>;
    //     input-enable;
    // };

    // /omit-if-no-ref/rgmii1_rxd3_pt15: rgmii1_rxd3_pt15 {
    //     pinmux = <LS_PINMUX_RGMII1_RXD3_FUNC3_PT15>;
    //     input-enable;
    // };

    /omit-if-no-ref/thruin4_ph00: thruin4_ph00 {
        pinmux = <LS_PINMUX_THRUIN4_FUNC3_PH00>;
        input-enable;
    };

    /omit-if-no-ref/spi2_mst_io0_ph01: spi2_mst_io0_ph01 {
        pinmux = <LS_PINMUX_SPI2_MST_IO0_FUNC3_PH01>;
        input-enable;
    };

    /omit-if-no-ref/thruout4_ph02: thruout4_ph02 {
        pinmux = <LS_PINMUX_THRUOUT4_FUNC3_PH02>;
        input-enable;
    };

    /omit-if-no-ref/spi2_mst_io1_ph03: spi2_mst_io1_ph03 {
        pinmux = <LS_PINMUX_SPI2_MST_IO1_FUNC3_PH03>;
        input-enable;
    };

    /omit-if-no-ref/thruin0_ph04: thruin0_ph04 {
        pinmux = <LS_PINMUX_THRUIN0_FUNC3_PH04>;
        input-enable;
    };

    /omit-if-no-ref/spi4_mst_io3_ph05: spi4_mst_io3_ph05 {
        pinmux = <LS_PINMUX_SPI4_MST_IO3_FUNC3_PH05>;
        input-enable;
    };

    /omit-if-no-ref/thruout0_ph06: thruout0_ph06 {
        pinmux = <LS_PINMUX_THRUOUT0_FUNC3_PH06>;
        input-enable;
    };

    /omit-if-no-ref/spi4_mst_io2_ph07: spi4_mst_io2_ph07 {
        pinmux = <LS_PINMUX_SPI4_MST_IO2_FUNC3_PH07>;
        input-enable;
    };

    /omit-if-no-ref/thruin1_ph08: thruin1_ph08 {
        pinmux = <LS_PINMUX_THRUIN1_FUNC3_PH08>;
        input-enable;
    };

    /omit-if-no-ref/spi4_mst_io1_ph09: spi4_mst_io1_ph09 {
        pinmux = <LS_PINMUX_SPI4_MST_IO1_FUNC3_PH09>;
        input-enable;
    };

    /omit-if-no-ref/thruout1_ph10: thruout1_ph10 {
        pinmux = <LS_PINMUX_THRUOUT1_FUNC3_PH10>;
        input-enable;
    };

    /omit-if-no-ref/spi4_mst_io0_ph11: spi4_mst_io0_ph11 {
        pinmux = <LS_PINMUX_SPI4_MST_IO0_FUNC3_PH11>;
        input-enable;
    };

    /omit-if-no-ref/thruin2_ph12: thruin2_ph12 {
        pinmux = <LS_PINMUX_THRUIN2_FUNC3_PH12>;
        input-enable;
    };

    /omit-if-no-ref/spi4_mst_clk_ph13: spi4_mst_clk_ph13 {
        pinmux = <LS_PINMUX_SPI4_MST_CLK_FUNC3_PH13>;
        input-enable;
    };

    /omit-if-no-ref/thruout2_ph14: thruout2_ph14 {
        pinmux = <LS_PINMUX_THRUOUT2_FUNC3_PH14>;
        input-enable;
    };

    /omit-if-no-ref/spi4_mst_csn_ph15: spi4_mst_csn_ph15 {
        pinmux = <LS_PINMUX_SPI4_MST_CSN_FUNC3_PH15>;
        input-enable;
    };

    /omit-if-no-ref/i3c10_scl_pj00: i3c10_scl_pj00 {
        pinmux = <LS_PINMUX_I3C10_SCL_FUNC3_PJ00>;
        input-enable;
    };

    /omit-if-no-ref/i3c10_sda_pj01: i3c10_sda_pj01 {
        pinmux = <LS_PINMUX_I3C10_SDA_FUNC3_PJ01>;
        input-enable;
    };

    /omit-if-no-ref/i3c9_scl_pj02: i3c9_scl_pj02 {
        pinmux = <LS_PINMUX_I3C9_SCL_FUNC3_PJ02>;
        input-enable;
    };

    /omit-if-no-ref/i3c9_sda_pj03: i3c9_sda_pj03 {
        pinmux = <LS_PINMUX_I3C9_SDA_FUNC3_PJ03>;
        input-enable;
    };

    /omit-if-no-ref/i3c8_scl_pj04: i3c8_scl_pj04 {
        pinmux = <LS_PINMUX_I3C8_SCL_FUNC3_PJ04>;
        input-enable;
    };

    /omit-if-no-ref/i3c8_sda_pj05: i3c8_sda_pj05 {
        pinmux = <LS_PINMUX_I3C8_SDA_FUNC3_PJ05>;
        input-enable;
    };

    /omit-if-no-ref/i3c7_scl_pj06: i3c7_scl_pj06 {
        pinmux = <LS_PINMUX_I3C7_SCL_FUNC3_PJ06>;
        input-enable;
    };

    /omit-if-no-ref/i3c7_sda_pj07: i3c7_sda_pj07 {
        pinmux = <LS_PINMUX_I3C7_SDA_FUNC3_PJ07>;
        input-enable;
    };

    /omit-if-no-ref/i3c6_scl_pj08: i3c6_scl_pj08 {
        pinmux = <LS_PINMUX_I3C6_SCL_FUNC3_PJ08>;
        input-enable;
    };

    /omit-if-no-ref/i3c6_sda_pj09: i3c6_sda_pj09 {
        pinmux = <LS_PINMUX_I3C6_SDA_FUNC3_PJ09>;
        input-enable;
    };

    /omit-if-no-ref/i3c5_scl_pj10: i3c5_scl_pj10 {
        pinmux = <LS_PINMUX_I3C5_SCL_FUNC3_PJ10>;
        input-enable;
    };

    /omit-if-no-ref/i3c5_sda_pj11: i3c5_sda_pj11 {
        pinmux = <LS_PINMUX_I3C5_SDA_FUNC3_PJ11>;
        input-enable;
    };

    /omit-if-no-ref/i3c4_scl_pj12: i3c4_scl_pj12 {
        pinmux = <LS_PINMUX_I3C4_SCL_FUNC3_PJ12>;
        input-enable;
    };

    /omit-if-no-ref/i3c4_sda_pj13: i3c4_sda_pj13 {
        pinmux = <LS_PINMUX_I3C4_SDA_FUNC3_PJ13>;
        input-enable;
    };

    /omit-if-no-ref/i3c3_scl_pj14: i3c3_scl_pj14 {
        pinmux = <LS_PINMUX_I3C3_SCL_FUNC3_PJ14>;
        input-enable;
    };

    /omit-if-no-ref/i3c3_sda_pj15: i3c3_sda_pj15 {
        pinmux = <LS_PINMUX_I3C3_SDA_FUNC3_PJ15>;
        input-enable;
    };

    /omit-if-no-ref/i3c2_scl_pk00: i3c2_scl_pk00 {
        pinmux = <LS_PINMUX_I3C2_SCL_FUNC3_PK00>;
        input-enable;
    };

    /omit-if-no-ref/i3c2_sda_pk01: i3c2_sda_pk01 {
        pinmux = <LS_PINMUX_I3C2_SDA_FUNC3_PK01>;
        input-enable;
    };

    /omit-if-no-ref/i3c1_scl_pk02: i3c1_scl_pk02 {
        pinmux = <LS_PINMUX_I3C1_SCL_FUNC3_PK02>;
        input-enable;
    };

    /omit-if-no-ref/i3c1_sda_pk03: i3c1_sda_pk03 {
        pinmux = <LS_PINMUX_I3C1_SDA_FUNC3_PK03>;
        input-enable;
    };

    /omit-if-no-ref/i3c11_scl_pk04: i3c11_scl_pk04 {
        pinmux = <LS_PINMUX_I3C11_SCL_FUNC3_PK04>;
        input-enable;
    };

    /omit-if-no-ref/i3c11_sda_pk05: i3c11_sda_pk05 {
        pinmux = <LS_PINMUX_I3C11_SDA_FUNC3_PK05>;
        input-enable;
    };

    /omit-if-no-ref/i3c12_scl_pk06: i3c12_scl_pk06 {
        pinmux = <LS_PINMUX_I3C12_SCL_FUNC3_PK06>;
        input-enable;
    };

    /omit-if-no-ref/i3c12_sda_pk07: i3c12_sda_pk07 {
        pinmux = <LS_PINMUX_I3C12_SDA_FUNC3_PK07>;
        input-enable;
    };

    /omit-if-no-ref/i3c13_scl_pk08: i3c13_scl_pk08 {
        pinmux = <LS_PINMUX_I3C13_SCL_FUNC3_PK08>;
        input-enable;
    };

    /omit-if-no-ref/i3c13_sda_pk09: i3c13_sda_pk09 {
        pinmux = <LS_PINMUX_I3C13_SDA_FUNC3_PK09>;
        input-enable;
    };

    /omit-if-no-ref/i3c14_scl_pk10: i3c14_scl_pk10 {
        pinmux = <LS_PINMUX_I3C14_SCL_FUNC3_PK10>;
        input-enable;
    };

    /omit-if-no-ref/i3c14_sda_pk11: i3c14_sda_pk11 {
        pinmux = <LS_PINMUX_I3C14_SDA_FUNC3_PK11>;
        input-enable;
    };

    /omit-if-no-ref/psram_clk_pe02: psram_clk_pe02 {
        pinmux = <LS_PINMUX_PSRAM_CLK_FUNC4_PE02>;
        input-enable;
    };

    /omit-if-no-ref/psram_dat3_pe03: psram_dat3_pe03 {
        pinmux = <LS_PINMUX_PSRAM_DAT3_FUNC4_PE03>;
        input-enable;
    };

    /omit-if-no-ref/psram_dat4_pe08: psram_dat4_pe08 {
        pinmux = <LS_PINMUX_PSRAM_DAT4_FUNC4_PE08>;
        input-enable;
    };

    /omit-if-no-ref/psram_dat5_pe09: psram_dat5_pe09 {
        pinmux = <LS_PINMUX_PSRAM_DAT5_FUNC4_PE09>;
        input-enable;
    };

    /omit-if-no-ref/psram_dat6_pe10: psram_dat6_pe10 {
        pinmux = <LS_PINMUX_PSRAM_DAT6_FUNC4_PE10>;
        input-enable;
    };

    /omit-if-no-ref/psram_dat7_pe11: psram_dat7_pe11 {
        pinmux = <LS_PINMUX_PSRAM_DAT7_FUNC4_PE11>;
        input-enable;
    };

    /omit-if-no-ref/psram_csn0_pe12: psram_csn0_pe12 {
        pinmux = <LS_PINMUX_PSRAM_CSN0_FUNC4_PE12>;
        input-enable;
    };

    /omit-if-no-ref/psram_dat0_pe13: psram_dat0_pe13 {
        pinmux = <LS_PINMUX_PSRAM_DAT0_FUNC4_PE13>;
        input-enable;
    };

    /omit-if-no-ref/psram_dat1_pe14: psram_dat1_pe14 {
        pinmux = <LS_PINMUX_PSRAM_DAT1_FUNC4_PE14>;
        input-enable;
    };

    /omit-if-no-ref/psram_dat2_pe15: psram_dat2_pe15 {
        pinmux = <LS_PINMUX_PSRAM_DAT2_FUNC4_PE15>;
        input-enable;
    };

    /omit-if-no-ref/uart3_ctsn_pb00: uart3_ctsn_pb00 {
        pinmux = <LS_PINMUX_UART3_CTSN_FUNC4_PB00>;
        input-enable;
    };

    /omit-if-no-ref/uart3_dsrn_pb01: uart3_dsrn_pb01 {
        pinmux = <LS_PINMUX_UART3_DSRN_FUNC4_PB01>;
        input-enable;
    };

    /omit-if-no-ref/uart3_rin_pb02: uart3_rin_pb02 {
        pinmux = <LS_PINMUX_UART3_RIN_FUNC4_PB02>;
        input-enable;
    };

    /omit-if-no-ref/uart3_dtrn_pb03: uart3_dtrn_pb03 {
        pinmux = <LS_PINMUX_UART3_DTRN_FUNC4_PB03>;
        input-enable;
    };

    /omit-if-no-ref/uart3_rtsn_pb04: uart3_rtsn_pb04 {
        pinmux = <LS_PINMUX_UART3_RTSN_FUNC4_PB04>;
        input-enable;
    };

    /omit-if-no-ref/uart3_dcdn_pb05: uart3_dcdn_pb05 {
        pinmux = <LS_PINMUX_UART3_DCDN_FUNC4_PB05>;
        input-enable;
    };

    /omit-if-no-ref/uart4_dsrn_pb06: uart4_dsrn_pb06 {
        pinmux = <LS_PINMUX_UART4_DSRN_FUNC4_PB06>;
        input-enable;
    };

    /omit-if-no-ref/paral_perror_pb07: paral_perror_pb07 {
        pinmux = <LS_PINMUX_PARAL_PERROR_FUNC4_PB07>;
        input-enable;
    };

    /omit-if-no-ref/paral_xflag_pb08: paral_xflag_pb08 {
        pinmux = <LS_PINMUX_PARAL_XFLAG_FUNC4_PB08>;
        input-enable;
    };

    /omit-if-no-ref/psram_csn1_pb09: psram_csn1_pb09 {
        pinmux = <LS_PINMUX_PSRAM_CSN1_FUNC4_PB09>;
        input-enable;
    };

    /omit-if-no-ref/uart1_ctsn_pb10: uart1_ctsn_pb10 {
        pinmux = <LS_PINMUX_UART1_CTSN_FUNC4_PB10>;
        input-enable;
    };

    /omit-if-no-ref/uart1_rtsn_pb11: uart1_rtsn_pb11 {
        pinmux = <LS_PINMUX_UART1_RTSN_FUNC4_PB11>;
        input-enable;
    };

    /omit-if-no-ref/espi2_alert_n_pi01: espi2_alert_n_pi01 {
        pinmux = <LS_PINMUX_ESPI2_ALERT_N_FUNC4_PI01>;
        input-enable;
    };

    /omit-if-no-ref/espi2_csn_pi02: espi2_csn_pi02 {
        pinmux = <LS_PINMUX_ESPI2_CSN_FUNC4_PI02>;
        input-enable;
    };

    /omit-if-no-ref/espi2_sck_pi03: espi2_sck_pi03 {
        pinmux = <LS_PINMUX_ESPI2_SCK_FUNC4_PI03>;
        input-enable;
    };

    /omit-if-no-ref/espi2_dat3_pi04: espi2_dat3_pi04 {
        pinmux = <LS_PINMUX_ESPI2_DAT3_FUNC4_PI04>;
        input-enable;
    };

    /omit-if-no-ref/espi2_dat2_pi05: espi2_dat2_pi05 {
        pinmux = <LS_PINMUX_ESPI2_DAT2_FUNC4_PI05>;
        input-enable;
    };

    /omit-if-no-ref/espi2_dat1_pi06: espi2_dat1_pi06 {
        pinmux = <LS_PINMUX_ESPI2_DAT1_FUNC4_PI06>;
        input-enable;
    };

    /omit-if-no-ref/espi2_dat0_pi07: espi2_dat0_pi07 {
        pinmux = <LS_PINMUX_ESPI2_DAT0_FUNC4_PI07>;
        input-enable;
    };

    /omit-if-no-ref/espi1_alert_n_pi09: espi1_alert_n_pi09 {
        pinmux = <LS_PINMUX_ESPI1_ALERT_N_FUNC4_PI09>;
        input-enable;
    };

    /omit-if-no-ref/espi1_csn_pi10: espi1_csn_pi10 {
        pinmux = <LS_PINMUX_ESPI1_CSN_FUNC4_PI10>;
        input-enable;
    };

    /omit-if-no-ref/espi1_sck_pi11: espi1_sck_pi11 {
        pinmux = <LS_PINMUX_ESPI1_SCK_FUNC4_PI11>;
        input-enable;
    };

    /omit-if-no-ref/espi1_dat3_pi12: espi1_dat3_pi12 {
        pinmux = <LS_PINMUX_ESPI1_DAT3_FUNC4_PI12>;
        input-enable;
    };

    /omit-if-no-ref/espi1_dat2_pi13: espi1_dat2_pi13 {
        pinmux = <LS_PINMUX_ESPI1_DAT2_FUNC4_PI13>;
        input-enable;
    };

    /omit-if-no-ref/espi1_dat1_pi14: espi1_dat1_pi14 {
        pinmux = <LS_PINMUX_ESPI1_DAT1_FUNC4_PI14>;
        input-enable;
    };

    /omit-if-no-ref/espi1_dat0_pi15: espi1_dat0_pi15 {
        pinmux = <LS_PINMUX_ESPI1_DAT0_FUNC4_PI15>;
        input-enable;
    };

    /omit-if-no-ref/psram_rxds_pa06: psram_rxds_pa06 {
        pinmux = <LS_PINMUX_PSRAM_RXDS_FUNC4_PA06>;
        input-enable;
    };

    /omit-if-no-ref/spi3_sck_pa07: spi3_sck_pa07 {
        pinmux = <LS_PINMUX_SPI3_SCK_FUNC4_PA07>;
        input-enable;
    };

    /omit-if-no-ref/spi3_csn0_pa08: spi3_csn0_pa08 {
        pinmux = <LS_PINMUX_SPI3_CSN0_FUNC4_PA08>;
        input-enable;
    };

    /omit-if-no-ref/spi3_csn1_pa09: spi3_csn1_pa09 {
        pinmux = <LS_PINMUX_SPI3_CSN1_FUNC4_PA09>;
        input-enable;
    };

    /omit-if-no-ref/spi3_dat0_pa10: spi3_dat0_pa10 {
        pinmux = <LS_PINMUX_SPI3_DAT0_FUNC4_PA10>;
        input-enable;
    };

    /omit-if-no-ref/spi3_dat1_pa11: spi3_dat1_pa11 {
        pinmux = <LS_PINMUX_SPI3_DAT1_FUNC4_PA11>;
        input-enable;
    };

    /omit-if-no-ref/spi3_dat2_pa12: spi3_dat2_pa12 {
        pinmux = <LS_PINMUX_SPI3_DAT2_FUNC4_PA12>;
        input-enable;
    };

    /omit-if-no-ref/spi3_dat3_pa13: spi3_dat3_pa13 {
        pinmux = <LS_PINMUX_SPI3_DAT3_FUNC4_PA13>;
        input-enable;
    };

    /omit-if-no-ref/paral_ack_pn02: paral_ack_pn02 {
        pinmux = <LS_PINMUX_PARAL_ACK_FUNC4_PN02>;
        input-enable;
    };

    /omit-if-no-ref/paral_strobe_pn03: paral_strobe_pn03 {
        pinmux = <LS_PINMUX_PARAL_STROBE_FUNC4_PN03>;
        input-enable;
    };

    /omit-if-no-ref/paral_data0_pn04: paral_data0_pn04 {
        pinmux = <LS_PINMUX_PARAL_DATA0_FUNC4_PN04>;
        input-enable;
    };

    /omit-if-no-ref/paral_data1_pn05: paral_data1_pn05 {
        pinmux = <LS_PINMUX_PARAL_DATA1_FUNC4_PN05>;
        input-enable;
    };

    /omit-if-no-ref/jtag_tck_pn06: jtag_tck_pn06 {
        pinmux = <LS_PINMUX_JTAG_TCK_FUNC4_PN06>;
        input-enable;
    };

    /omit-if-no-ref/jtag_tms_pn07: jtag_tms_pn07 {
        pinmux = <LS_PINMUX_JTAG_TMS_FUNC4_PN07>;
        input-enable;
    };

    /omit-if-no-ref/paral_data2_pn08: paral_data2_pn08 {
        pinmux = <LS_PINMUX_PARAL_DATA2_FUNC4_PN08>;
        input-enable;
    };

    /omit-if-no-ref/paral_data3_pn09: paral_data3_pn09 {
        pinmux = <LS_PINMUX_PARAL_DATA3_FUNC4_PN09>;
        input-enable;
    };

    /omit-if-no-ref/paral_data4_pn10: paral_data4_pn10 {
        pinmux = <LS_PINMUX_PARAL_DATA4_FUNC4_PN10>;
        input-enable;
    };

    /omit-if-no-ref/paral_data5_pn11: paral_data5_pn11 {
        pinmux = <LS_PINMUX_PARAL_DATA5_FUNC4_PN11>;
        input-enable;
    };

    /omit-if-no-ref/paral_data6_pn12: paral_data6_pn12 {
        pinmux = <LS_PINMUX_PARAL_DATA6_FUNC4_PN12>;
        input-enable;
    };

    /omit-if-no-ref/i2c2_mst_sda_pn13: i2c2_mst_sda_pn13 {
        pinmux = <LS_PINMUX_I2C2_MST_SDA_FUNC4_PN13>;
        input-enable;
    };

    /omit-if-no-ref/i2c2_mst_scl_pn14: i2c2_mst_scl_pn14 {
        pinmux = <LS_PINMUX_I2C2_MST_SCL_FUNC4_PN14>;
        input-enable;
    };

    /omit-if-no-ref/paral_data7_pn15: paral_data7_pn15 {
        pinmux = <LS_PINMUX_PARAL_DATA7_FUNC4_PN15>;
        input-enable;
    };

    /omit-if-no-ref/qspi2_dat0_pc06: qspi2_dat0_pc06 {
        pinmux = <LS_PINMUX_QSPI2_DAT0_FUNC4_PC06>;
        input-enable;
    };

    /omit-if-no-ref/qspi2_dat1_pc07: qspi2_dat1_pc07 {
        pinmux = <LS_PINMUX_QSPI2_DAT1_FUNC4_PC07>;
        input-enable;
    };

    /omit-if-no-ref/qspi2_dat2_pc08: qspi2_dat2_pc08 {
        pinmux = <LS_PINMUX_QSPI2_DAT2_FUNC4_PC08>;
        input-enable;
    };

    /omit-if-no-ref/qspi2_dat3_pc09: qspi2_dat3_pc09 {
        pinmux = <LS_PINMUX_QSPI2_DAT3_FUNC4_PC09>;
        input-enable;
    };

    /omit-if-no-ref/i2c15_smba_pc10: i2c15_smba_pc10 {
        pinmux = <LS_PINMUX_I2C15_SMBA_FUNC4_PC10>;
        input-enable;
    };

    /omit-if-no-ref/i2c16_smba_pc11: i2c16_smba_pc11 {
        pinmux = <LS_PINMUX_I2C16_SMBA_FUNC4_PC11>;
        input-enable;
    };

    /omit-if-no-ref/paral_int_pc12: paral_int_pc12 {
        pinmux = <LS_PINMUX_PARAL_INT_FUNC4_PC12>;
        input-enable;
    };

    /omit-if-no-ref/paral_selectin_pc13: paral_selectin_pc13 {
        pinmux = <LS_PINMUX_PARAL_SELECTIN_FUNC4_PC13>;
        input-enable;
    };

    /omit-if-no-ref/ulpi_nxt_pc14: ulpi_nxt_pc14 {
        pinmux = <LS_PINMUX_ULPI_NXT_FUNC4_PC14>;
        input-enable;
    };

    /omit-if-no-ref/ulpi_dat0_pd00: ulpi_dat0_pd00 {
        pinmux = <LS_PINMUX_ULPI_DAT0_FUNC4_PD00>;
        input-enable;
    };

    /omit-if-no-ref/ulpi_dat1_pd01: ulpi_dat1_pd01 {
        pinmux = <LS_PINMUX_ULPI_DAT1_FUNC4_PD01>;
        input-enable;
    };

    /omit-if-no-ref/ulpi_dat2_pd02: ulpi_dat2_pd02 {
        pinmux = <LS_PINMUX_ULPI_DAT2_FUNC4_PD02>;
        input-enable;
    };

    /omit-if-no-ref/ulpi_dat3_pd03: ulpi_dat3_pd03 {
        pinmux = <LS_PINMUX_ULPI_DAT3_FUNC4_PD03>;
        input-enable;
    };

    /omit-if-no-ref/ulpi_dat4_pd04: ulpi_dat4_pd04 {
        pinmux = <LS_PINMUX_ULPI_DAT4_FUNC4_PD04>;
        input-enable;
    };

    /omit-if-no-ref/ulpi_dat5_pd05: ulpi_dat5_pd05 {
        pinmux = <LS_PINMUX_ULPI_DAT5_FUNC4_PD05>;
        input-enable;
    };

    /omit-if-no-ref/ulpi_dat6_pd06: ulpi_dat6_pd06 {
        pinmux = <LS_PINMUX_ULPI_DAT6_FUNC4_PD06>;
        input-enable;
    };

    /omit-if-no-ref/ulpi_dat7_pd07: ulpi_dat7_pd07 {
        pinmux = <LS_PINMUX_ULPI_DAT7_FUNC4_PD07>;
        input-enable;
    };

    /omit-if-no-ref/ulpi_clk_pd08: ulpi_clk_pd08 {
        pinmux = <LS_PINMUX_ULPI_CLK_FUNC4_PD08>;
        input-enable;
    };

    /omit-if-no-ref/ulpi_stp_pd09: ulpi_stp_pd09 {
        pinmux = <LS_PINMUX_ULPI_STP_FUNC4_PD09>;
        input-enable;
    };

    /omit-if-no-ref/spi4_sck_pq00: spi4_sck_pq00 {
        pinmux = <LS_PINMUX_SPI4_SCK_FUNC4_PQ00>;
        input-enable;
    };

    /omit-if-no-ref/spi4_csn1_pq01: spi4_csn1_pq01 {
        pinmux = <LS_PINMUX_SPI4_CSN1_FUNC4_PQ01>;
        input-enable;
    };

    /omit-if-no-ref/spi4_csn0_pq02: spi4_csn0_pq02 {
        pinmux = <LS_PINMUX_SPI4_CSN0_FUNC4_PQ02>;
        input-enable;
    };

    /omit-if-no-ref/spi4_dat0_pq03: spi4_dat0_pq03 {
        pinmux = <LS_PINMUX_SPI4_DAT0_FUNC4_PQ03>;
        input-enable;
    };

    /omit-if-no-ref/spi4_dat1_pq04: spi4_dat1_pq04 {
        pinmux = <LS_PINMUX_SPI4_DAT1_FUNC4_PQ04>;
        input-enable;
    };

    /omit-if-no-ref/spi4_dat2_pq05: spi4_dat2_pq05 {
        pinmux = <LS_PINMUX_SPI4_DAT2_FUNC4_PQ05>;
        input-enable;
    };

    /omit-if-no-ref/spi4_dat3_pq06: spi4_dat3_pq06 {
        pinmux = <LS_PINMUX_SPI4_DAT3_FUNC4_PQ06>;
        input-enable;
    };

    /omit-if-no-ref/rgmii2_txck_pq07: rgmii2_txck_pq07 {
        pinmux = <LS_PINMUX_RGMII2_TXCK_FUNC4_PQ07>;
        input-enable;
    };

    /omit-if-no-ref/rgmii2_txctl_pq08: rgmii2_txctl_pq08 {
        pinmux = <LS_PINMUX_RGMII2_TXCTL_FUNC4_PQ08>;
        input-enable;
    };

    /omit-if-no-ref/rgmii2_txd0_pq09: rgmii2_txd0_pq09 {
        pinmux = <LS_PINMUX_RGMII2_TXD0_FUNC4_PQ09>;
        input-enable;
    };

    /omit-if-no-ref/rgmii2_txd1_pq10: rgmii2_txd1_pq10 {
        pinmux = <LS_PINMUX_RGMII2_TXD1_FUNC4_PQ10>;
        input-enable;
    };

    /omit-if-no-ref/rgmii2_txd2_pq11: rgmii2_txd2_pq11 {
        pinmux = <LS_PINMUX_RGMII2_TXD2_FUNC4_PQ11>;
        input-enable;
    };

    /omit-if-no-ref/rgmii2_txd3_pq12: rgmii2_txd3_pq12 {
        pinmux = <LS_PINMUX_RGMII2_TXD3_FUNC4_PQ12>;
        input-enable;
    };

    /omit-if-no-ref/rgmii2_rxck_pq13: rgmii2_rxck_pq13 {
        pinmux = <LS_PINMUX_RGMII2_RXCK_FUNC4_PQ13>;
        input-enable;
    };

    /omit-if-no-ref/rgmii2_rxctl_pq14: rgmii2_rxctl_pq14 {
        pinmux = <LS_PINMUX_RGMII2_RXCTL_FUNC4_PQ14>;
        input-enable;
    };

    /omit-if-no-ref/rgmii2_rxd0_pq15: rgmii2_rxd0_pq15 {
        pinmux = <LS_PINMUX_RGMII2_RXD0_FUNC4_PQ15>;
        input-enable;
    };

    // /omit-if-no-ref/emmc_dat0_pm04: emmc_dat0_pm04 {
    //     pinmux = <LS_PINMUX_EMMC_DAT0_FUNC4_PM04>;
    //     input-enable;
    // };

    // /omit-if-no-ref/emmc_dat1_pm05: emmc_dat1_pm05 {
    //     pinmux = <LS_PINMUX_EMMC_DAT1_FUNC4_PM05>;
    //     input-enable;
    // };

    // /omit-if-no-ref/emmc_dat2_pm06: emmc_dat2_pm06 {
    //     pinmux = <LS_PINMUX_EMMC_DAT2_FUNC4_PM06>;
    //     input-enable;
    // };

    // /omit-if-no-ref/emmc_dat3_pm07: emmc_dat3_pm07 {
    //     pinmux = <LS_PINMUX_EMMC_DAT3_FUNC4_PM07>;
    //     input-enable;
    // };

    // /omit-if-no-ref/emmc_dat4_pm08: emmc_dat4_pm08 {
    //     pinmux = <LS_PINMUX_EMMC_DAT4_FUNC4_PM08>;
    //     input-enable;
    // };

    // /omit-if-no-ref/emmc_dat5_pm09: emmc_dat5_pm09 {
    //     pinmux = <LS_PINMUX_EMMC_DAT5_FUNC4_PM09>;
    //     input-enable;
    // };

    // /omit-if-no-ref/emmc_dat6_pm10: emmc_dat6_pm10 {
    //     pinmux = <LS_PINMUX_EMMC_DAT6_FUNC4_PM10>;
    //     input-enable;
    // };

    // /omit-if-no-ref/emmc_dat7_pm11: emmc_dat7_pm11 {
    //     pinmux = <LS_PINMUX_EMMC_DAT7_FUNC4_PM11>;
    //     input-enable;
    // };

    // /omit-if-no-ref/emmc_clk_pm12: emmc_clk_pm12 {
    //     pinmux = <LS_PINMUX_EMMC_CLK_FUNC4_PM12>;
    //     input-enable;
    // };

    // /omit-if-no-ref/emmc_cmd_pm13: emmc_cmd_pm13 {
    //     pinmux = <LS_PINMUX_EMMC_CMD_FUNC4_PM13>;
    //     input-enable;
    // };

    // /omit-if-no-ref/sd2_clk_pm14: sd2_clk_pm14 {
    //     pinmux = <LS_PINMUX_SD2_CLK_FUNC4_PM14>;
    //     input-enable;
    // };

    // /omit-if-no-ref/rgmii2_rxd1_pt00: rgmii2_rxd1_pt00 {
    //     pinmux = <LS_PINMUX_RGMII2_RXD1_FUNC4_PT00>;
    //     input-enable;
    // };

    // /omit-if-no-ref/rgmii2_rxd2_pt01: rgmii2_rxd2_pt01 {
    //     pinmux = <LS_PINMUX_RGMII2_RXD2_FUNC4_PT01>;
    //     input-enable;
    // };

    // /omit-if-no-ref/rgmii2_rxd3_pt02: rgmii2_rxd3_pt02 {
    //     pinmux = <LS_PINMUX_RGMII2_RXD3_FUNC4_PT02>;
    //     input-enable;
    // };

    /omit-if-no-ref/sgpio2_mck_pk04: sgpio2_mck_pk04 {
        pinmux = <LS_PINMUX_SGPIO2_MCK_FUNC4_PK04>;
        input-enable;
    };

    /omit-if-no-ref/sgpio2_mld_pk05: sgpio2_mld_pk05 {
        pinmux = <LS_PINMUX_SGPIO2_MLD_FUNC4_PK05>;
        input-enable;
    };

    /omit-if-no-ref/sgpio2_mdi0_pk06: sgpio2_mdi0_pk06 {
        pinmux = <LS_PINMUX_SGPIO2_MDI0_FUNC4_PK06>;
        input-enable;
    };

    /omit-if-no-ref/sgpio2_mdi1_pk07: sgpio2_mdi1_pk07 {
        pinmux = <LS_PINMUX_SGPIO2_MDI1_FUNC4_PK07>;
        input-enable;
    };

    /omit-if-no-ref/sgpio2_mst_ck_pk08: sgpio2_mst_ck_pk08 {
        pinmux = <LS_PINMUX_SGPIO2_MST_CK_FUNC4_PK08>;
        input-enable;
    };

    /omit-if-no-ref/sgpio2_mst_ld_pk09: sgpio2_mst_ld_pk09 {
        pinmux = <LS_PINMUX_SGPIO2_MST_LD_FUNC4_PK09>;
        input-enable;
    };

    /omit-if-no-ref/sgpio2_mst_do_pk10: sgpio2_mst_do_pk10 {
        pinmux = <LS_PINMUX_SGPIO2_MST_DO_FUNC4_PK10>;
        input-enable;
    };

    /omit-if-no-ref/sgpio2_mst_di_pk11: sgpio2_mst_di_pk11 {
        pinmux = <LS_PINMUX_SGPIO2_MST_DI_FUNC4_PK11>;
        input-enable;
    };

    /* RGMII1 */
    /omit-if-no-ref/rmii_mdc_pa14: rmii_mdc_pa14 {
        pinmux = <LS_PINMUX_RGMII1_MDC_FUNC2_PA14>;
        drive-strength = "quarter max driver";
    };
    /omit-if-no-ref/rmii_mdio_pa15: rmii_mdio_pa15 {
        pinmux = <LS_PINMUX_RGMII1_MDIO_FUNC2_PA15>;
        drive-strength = "quarter max driver";
        input-enable;
    };
    /omit-if-no-ref/rgmii_txck_pt03: rgmii_txck_pt03 {
        pinmux = <LS_PINMUX_RGMII1_TXCK_FUNC3_PT03>;
        drive-strength = "quarter max driver";
        input-enable;
    };
    /omit-if-no-ref/rmii_txen_pt04: rmii_txen_pt04 {
        pinmux = <LS_PINMUX_RGMII1_TXCTL_FUNC3_PT04>;
        drive-strength = "quarter max driver";
        input-enable;
    };
    /omit-if-no-ref/rmii_txd0_pt05: rmii_txd0_pt05 {
        pinmux = <LS_PINMUX_RGMII1_TXD0_FUNC3_PT05>;
        drive-strength = "quarter max driver";
        input-enable;
    };
    /omit-if-no-ref/rmii_txd1_pt06: rmii_txd1_pt06 {
        pinmux = <LS_PINMUX_RGMII1_TXD1_FUNC3_PT06>;
        drive-strength = "quarter max driver";
        input-enable;
    };
    /omit-if-no-ref/rgmii_txd2_pt07: rgmii_txd2_pt07 {
        pinmux = <LS_PINMUX_RGMII1_TXD2_FUNC3_PT07>;
        drive-strength = "quarter max driver";
        input-enable;
    };
    /omit-if-no-ref/rgmii_txd3_pt08: rgmii_txd3_pt08 {
        pinmux = <LS_PINMUX_RGMII1_TXD3_FUNC3_PT08>;
        drive-strength = "quarter max driver";
        input-enable;
    };
    /omit-if-no-ref/rmii_rxc_pt10: rmii_rxc_pt10 {
        pinmux = <LS_PINMUX_RGMII1_RXCK_FUNC3_PT10>;
        drive-strength = "quarter max driver";
        input-enable;
    };
    /omit-if-no-ref/rmii_crsdv_pt11: rmii_crsdv_pt11 {
        pinmux = <LS_PINMUX_RGMII1_RXCTL_FUNC3_PT11>;
        drive-strength = "quarter max driver";
        input-enable;
    };
    /omit-if-no-ref/rmii_rxd0_pt12: rmii_rxd0_pt12 {
        pinmux = <LS_PINMUX_RGMII1_RXD0_FUNC3_PT12>;
        drive-strength = "quarter max driver";
        input-enable;
    };
    /omit-if-no-ref/rmii_rxd1_pt13: rmii_rxd1_pt13 {
        pinmux = <LS_PINMUX_RGMII1_RXD1_FUNC3_PT13>;
        drive-strength = "quarter max driver";
        input-enable;
    };
    /omit-if-no-ref/rgmii_rxd2_pt14: rgmii_rxd2_pt14 {
        pinmux = <LS_PINMUX_RGMII1_RXD2_FUNC3_PT14>;
        drive-strength = "quarter max driver";
        input-enable;
    };
    /omit-if-no-ref/rgmii_rxd3_pt15: rgmii_rxd3_pt15 {
        pinmux = <LS_PINMUX_RGMII1_RXD3_FUNC3_PT15>;
        drive-strength = "quarter max driver";
        input-enable;
    };

    /* SDHC1 */
    /omit-if-no-ref/sdhc_d0_pm04: sdhc_d0_pm04 {
        pinmux = <LS_PINMUX_EMMC_DAT0_FUNC4_PM04>;
        drive-strength = "quarter max driver";
        input-enable;
    };
    /omit-if-no-ref/sdhc_d1_pm05: sdhc_d1_pm05 {
        pinmux = <LS_PINMUX_EMMC_DAT1_FUNC4_PM05>;
        drive-strength = "quarter max driver";
        input-enable;
    };
    /omit-if-no-ref/sdhc_d2_pm06: sdhc_d2_pm06 {
        pinmux = <LS_PINMUX_EMMC_DAT2_FUNC4_PM06>;
        drive-strength = "quarter max driver";
        input-enable;
    };
    /omit-if-no-ref/sdhc_d3_pm07: sdhc_d3_pm07 {
        pinmux = <LS_PINMUX_EMMC_DAT3_FUNC4_PM07>;
        drive-strength = "quarter max driver";
        input-enable;
    };
    /omit-if-no-ref/sdhc_d4_pm08: sdhc_d4_pm08 {
        pinmux = <LS_PINMUX_EMMC_DAT4_FUNC4_PM08>;
        drive-strength = "quarter max driver";
        input-enable;
    };
    /omit-if-no-ref/sdhc_d5_pm09: sdhc_d5_pm09 {
        pinmux = <LS_PINMUX_EMMC_DAT5_FUNC4_PM09>;
        drive-strength = "quarter max driver";
        input-enable;
    };
    /omit-if-no-ref/sdhc_d6_pm10: sdhc_d6_pm10 {
        pinmux = <LS_PINMUX_EMMC_DAT6_FUNC4_PM10>;
        drive-strength = "quarter max driver";
        input-enable;
    };
    /omit-if-no-ref/sdhc_d7_pm11: sdhc_d7_pm11 {
        pinmux = <LS_PINMUX_EMMC_DAT7_FUNC4_PM11>;
        drive-strength = "quarter max driver";
        input-enable;
    };
    /omit-if-no-ref/sdhc_clk_pm12: sdhc_clk_pm12 {
        pinmux = <LS_PINMUX_EMMC_CLK_FUNC4_PM12>;
        drive-strength = "quarter max driver";
    };
    /omit-if-no-ref/sdhc_cmd_pm13: sdhc_cmd_pm13 {
        pinmux = <LS_PINMUX_EMMC_CMD_FUNC4_PM13>;
        drive-strength = "quarter max driver";
        input-enable;
    };

    /* QSPI1 */
    /omit-if-no-ref/qspi1_sck_pa00: qspi1_sck_pa00 {
        pinmux = <LS_PINMUX_QSPI1_SCK_FUNC3_PA00>;
        output-enable;
    };
    /omit-if-no-ref/qspi1_csn_pa01: qspi1_csn_pa01 {
        pinmux = <LS_PINMUX_QSPI1_CSN_FUNC3_PA01>;
        output-enable;
        input-enable;
    };
    /omit-if-no-ref/qspi1_dq0_pa02: qspi1_dq0_pa02 {
        pinmux = <LS_PINMUX_QSPI1_DAT0_FUNC3_PA02>;
        input-enable;
    };
    /omit-if-no-ref/qspi1_dq1_pa03: qspi1_dq1_pa03 {
        pinmux = <LS_PINMUX_QSPI1_DAT1_FUNC3_PA03>;
        input-enable;
    };
    /omit-if-no-ref/qspi1_dq2_pa04: qspi1_dq2_pa04 {
        pinmux = <LS_PINMUX_QSPI1_DAT2_FUNC3_PA04>;
        input-enable;
    };
    /omit-if-no-ref/qspi1_dq3_pa05: qspi1_dq3_pa05 {
        pinmux = <LS_PINMUX_QSPI1_DAT3_FUNC3_PA05>;
        input-enable;
    };

    // /* eSPI */
    // /omit-if-no-ref/espi1_alertn_pi09: espi1_alertn_pi09 {
    //     pinmux = <LS_PINMUX_SET(PI09,  LSFUNC(PINMUX_FUNC2))>;
    // };
    // /omit-if-no-ref/espi1_csn_pi10: espi1_csn_pi10 {
    //     pinmux = <LS_PINMUX_SET(PI10,  LSFUNC(PINMUX_FUNC2))>;
    //     input-enable;
    // };
    // /omit-if-no-ref/espi1_sck_pi11: espi1_sck_pi11 {
    //     pinmux = <LS_PINMUX_SET(PI11,  LSFUNC(PINMUX_FUNC2))>;
    //     input-enable;
    // };
    // /omit-if-no-ref/espi1_dat3_pi12: espi1_dat3_pi12 {
    //     pinmux = <LS_PINMUX_SET(PI12,  LSFUNC(PINMUX_FUNC2))>;
    //     input-enable;
    // };
    // /omit-if-no-ref/espi1_dat2_pi13: espi1_dat2_pi13 {
    //     pinmux = <LS_PINMUX_SET(PI13,  LSFUNC(PINMUX_FUNC2))>;
    //     input-enable;
    // };
    // /omit-if-no-ref/espi1_dat1_pi14: espi1_dat1_pi14 {
    //     pinmux = <LS_PINMUX_SET(PI14,  LSFUNC(PINMUX_FUNC2))>;
    //     input-enable;
    // };
    // /omit-if-no-ref/espi1_dat0_pi15: espi1_dat0_pi15 {
    //     pinmux = <LS_PINMUX_SET(PI15,  LSFUNC(PINMUX_FUNC2))>;
    //     input-enable;
    // };

    // /* eSPI */
    // /omit-if-no-ref/espi2_alertn_ph04: espi2_alertn_ph04 {
    //     pinmux = <LS_PINMUX_SET(PH04,  LSFUNC(PINMUX_FUNC2))>;
    // };
    // /omit-if-no-ref/espi2_csn_ph05: espi2_csn_ph05 {
    //     pinmux = <LS_PINMUX_SET(PH05,  LSFUNC(PINMUX_FUNC2))>;
    //     input-enable;
    // };
    // /omit-if-no-ref/espi2_sck_ph06: espi2_sck_ph06 {
    //     pinmux = <LS_PINMUX_SET(PH06,  LSFUNC(PINMUX_FUNC2))>;
    //     input-enable;
    // };
    // /omit-if-no-ref/espi2_dat3_ph07: espi2_dat3_ph07 {
    //     pinmux = <LS_PINMUX_SET(PH07,  LSFUNC(PINMUX_FUNC2))>;
    //     input-enable;
    // };
    // /omit-if-no-ref/espi2_dat2_ph08: espi2_dat2_ph08 {
    //     pinmux = <LS_PINMUX_SET(PH08,  LSFUNC(PINMUX_FUNC2))>;
    //     input-enable;
    // };
    // /omit-if-no-ref/espi2_dat1_ph09: espi2_dat1_ph09 {
    //     pinmux = <LS_PINMUX_SET(PH09,  LSFUNC(PINMUX_FUNC2))>;
    //     input-enable;
    // };
    // /omit-if-no-ref/espi2_dat0_ph10: espi2_dat0_ph10 {
    //     pinmux = <LS_PINMUX_SET(PH10,  LSFUNC(PINMUX_FUNC2))>;
    //     input-enable;
    // };

    // /* LPC */
    // /omit-if-no-ref/lpc_serirq_pi09: lpc_serirq_pi09 {
    //     pinmux = <LS_PINMUX_SET(PI09,  LSFUNC(PINMUX_FUNC3))>;
    //     input-enable;
    // };
    // /omit-if-no-ref/lpc_frm_pi10: lpc_frm_pi10 {
    //     pinmux = <LS_PINMUX_SET(PI10,  LSFUNC(PINMUX_FUNC3))>;
    //     input-enable;
    // };
    // /omit-if-no-ref/lpc_clk_pi11: lpc_clk_pi11 {
    //     pinmux = <LS_PINMUX_SET(PI11,  LSFUNC(PINMUX_FUNC3))>;
    //     input-enable;
    // };
    // /omit-if-no-ref/lpc_dat3_pi12: lpc_dat3_pi12 {
    //     pinmux = <LS_PINMUX_SET(PI12,  LSFUNC(PINMUX_FUNC3))>;
    //     input-enable;
    // };
    // /omit-if-no-ref/lpc_dat2_pi13: lpc_dat2_pi13 {
    //     pinmux = <LS_PINMUX_SET(PI13,  LSFUNC(PINMUX_FUNC3))>;
    //     input-enable;
    // };
    // /omit-if-no-ref/lpc_dat1_pi14: lpc_dat1_pi14 {
    //     pinmux = <LS_PINMUX_SET(PI14,  LSFUNC(PINMUX_FUNC3))>;
    //     input-enable;
    // };
    // /omit-if-no-ref/lpc_dat0_pi15: lpc_dat0_pi15 {
    //     pinmux = <LS_PINMUX_SET(PI15,  LSFUNC(PINMUX_FUNC3))>;
    //     input-enable;
    // };

    // /* SGPIOM */
    // /omit-if-no-ref/sgpiom_clk_pe06: sgpiom_clk_pe06 {
    //     pinmux = <LS_PINMUX_SET(PE06, LSFUNC(PINMUX_FUNC2))>;
    //     drive-strength = "quarter max driver";
    // };
    // /omit-if-no-ref/sgpiom_di_pe07: sgpiom_di_pe07 {
    //     pinmux = <LS_PINMUX_SET(PE07, LSFUNC(PINMUX_FUNC2))>;
    //     drive-strength = "quarter max driver";
    //     input-enable;
    // };
    // /omit-if-no-ref/sgpiom_do_pe08: sgpiom_do_pe08 {
    //     pinmux = <LS_PINMUX_SET(PE08, LSFUNC(PINMUX_FUNC2))>;
    //     drive-strength = "quarter max driver";
    //     input-enable;
    // };
    // /omit-if-no-ref/sgpiom_ld_pe09: sgpiom_ld_pe09 {
    //     pinmux = <LS_PINMUX_SET(PE09, LSFUNC(PINMUX_FUNC2))>;
    //     drive-strength = "quarter max driver";
    // };
};
