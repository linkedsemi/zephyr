## boards/linkedsemi/lsqsh_evb/lsqsh_evb_smp_smp_xip_defconfig
```kconfig
# Copyright (c) 2025 linkedsemi
# SPDX-License-Identifier: Apache-2.0

CONFIG_MINIMAL_LIBC=y

# CONFIG_BOOT_BANNER=n
# CONFIG_COMPILER_OPT="-O0"

CONFIG_NUM_USE_CPU=2
CONFIG_NUM_OS=1
# CONFIG_CPU2_BOOT_ADDR=0x10000000



CONFIG_IPI_OPTIMIZE=y
CONFIG_RISCV_PMP=n
CONFIG_SMP=y
CONFIG_PM_CPU_OPS=y
CONFIG_SCHED_CPU_MASK=y
CONFIG_FLASH_OP_DELEGATION_SERVER=n
CONFIG_XIP=y

CONFIG_SOC_LSQSH_BUILD_OUTPUT_BRAM_BIN=y
CONFIG_SOC_LSQSH_BUILD_OUTPUT_HEADER_BIN=y
```

## boards/linkedsemi/lsraptor_evb/Kconfig.defconfig
```kconfig
# Copyright (c) 2024  Linkedsemi.
# SPDX-License-Identifier: Apache-2.0

if BOARD_LSRAPTOR_EVB

config BOARD
	default "lsraptor_evb"

config FLASH_LOAD_OFFSET
	default 0x0

config HEAP_MEM_POOL_SIZE
	default 4096


endif
```

## boards/linkedsemi/lsraptor_evb/Kconfig.lsraptor_evb
```kconfig
# Copyright (c) 2024  Linkedsemi.
# SPDX-License-Identifier: Apache-2.0

config BOARD_LSRAPTOR_EVB
	select SOC_LSRAPTOR_E906
```

## boards/linkedsemi/lsraptor_evb/board.yml
```yaml
board:
  name: lsraptor_evb
  vendor: linkedsemi
  socs:
  - name: lsraptor_e906
```

## boards/linkedsemi/lsraptor_evb/lsraptor_evb_defconfig
```kconfig
# Copyright (c) 2024  Linkedsemi
# SPDX-License-Identifier: Apache-2.0

CONFIG_OUTPUT_DISASSEMBLY=y
CONFIG_NEWLIB_LIBC=y
CONFIG_MAIN_STACK_SIZE=2048
CONFIG_ISR_STACK_SIZE=4096
CONFIG_SERIAL=y
CONFIG_CONSOLE=y
CONFIG_UART_CONSOLE=y
```

## boards/linkedsemi/zephyr_bmc_moc30/Kconfig.defconfig
```kconfig
# Copyright (c) 2024 Alibaba
# SPDX-License-Identifier: Apache-2.0

if BOARD_ZEPHYR_BMC_MOC30

config BOARD
	default "zephyr_bmc_moc30"

config FLASH_LOAD_OFFSET
	default 0x0

config HEAP_MEM_POOL_SIZE
	default 4096

if SPI

config SPI_DW
	default y

endif # SPI

if SPI_DW

config SPI_DW_ACCESS_WORD_ONLY
	default y

endif # SPI_DW

endif
```

## boards/linkedsemi/zephyr_bmc_moc30/Kconfig.zephyr_bmc_moc30
```kconfig
# Copyright (c) 2024, Alibaba
# SPDX-License-Identifier: Apache-2.0

config BOARD_ZEPHYR_BMC_MOC30
	select SOC_LSQSH
```

## boards/linkedsemi/zephyr_secure_moc30/Kconfig.zephyr_secure_moc30
```kconfig
# Copyright (c) 2024, Alibaba
# SPDX-License-Identifier: Apache-2.0

config BOARD_ZEPHYR_SECURE_MOC30
	select SOC_LSQSH
```

## drivers/crypto/Kconfig.linkedsemi
```kconfig
# Copyright (c) 2024 linkedsemi
# SPDX-License-Identifier: Apache-2.0

config CRYPTO_LINKEDSEMI_SHA256
    bool "linkedsemi SHA256 driver"
    depends on DT_HAS_LINKEDSEMI_SHA256_ENABLED
    default y
    help
      Enable linkedsemi SHA256 driver.

config CRYPTO_LINKEDSEMI_SHA512
    bool "linkedsemi SHA512 driver"
    depends on DT_HAS_LINKEDSEMI_SHA512_ENABLED
    default y
    help
      Enable linkedsemi SHA512 driver.

config SHA512_LINKEDSEMI_NO_CLOCK_RESET
	bool "Skip SHA512 CCTL/RCTL access in driver init"
	depends on CRYPTO_LINKEDSEMI_SHA512
	help
	  Skip clock_control and reset_line_toggle in sha512_linkedsemi_init.
	  Use when CCTL/RCTL is blocked by IOPMP.
	  Clock/reset must be handled elsewhere if this is enabled.
	  The clock/reset must then be handled on CPU1, for example with
	  ls_crypto_clock_prepare(LS_CRYPTO_CLK_SHA512) before CPU2 boots.

config SHA256_LINKEDSEMI_NO_CLOCK_RESET
	bool "Skip SHA256 CCTL/RCTL access in driver init"
	depends on CRYPTO_LINKEDSEMI_SHA256
	help
	  Skip clock_control and reset_line_toggle in sha256_linkedsemi_init.
	  Use when the SEC_SYSC_CPU clock/reset registers are owned by the
	  peer (security) core and are not accessible from this core.
	  The clock/reset must then be handled on CPU1, for example with
	  ls_crypto_clock_prepare(LS_CRYPTO_CLK_SHA256) before CPU2 boots.

config AES256_LINKEDSEMI_NO_CLOCK_RESET
	bool "Skip AES256 CCTL/RCTL access in driver init"
	depends on CRYPTO_LINKEDSEMI_AES256
	help
	  Skip clock_control and reset_line_toggle in
	  crypto_linkedsemi_aes256_init. Use when the SEC_SYSC_CPU
	  clock/reset registers are owned by the peer (security) core and
	  are not accessible from this core. The clock/reset must then be
	  handled on CPU1, for example with
	  ls_crypto_clock_prepare(LS_CRYPTO_CLK_AES256) before CPU2 boots.

config SM4_LINKEDSEMI_NO_CLOCK_RESET
	bool "Skip SM4 CCTL/RCTL access in driver init"
	depends on CRYPTO_LINKEDSEMI_SM4
	help
	  Skip clock_control and reset_line_toggle in sm4_linkedsemi_init.
	  Use when the SEC_SYSC_CPU clock/reset registers are owned by the
	  peer (security) core and are not accessible from this core.
	  The clock/reset must then be handled on CPU1, for example with
	  ls_crypto_clock_prepare(LS_CRYPTO_CLK_SM4) before CPU2 boots.

config CRYPTO_LINKEDSEMI_SM4
    bool "linkedsemi SM4 driver"
    depends on DT_HAS_LINKEDSEMI_SM4_ENABLED
    default y
    help
      Enable linkedsemi SM4 driver.

config CRYPTO_LINKEDSEMI_AES256
    bool "linkedsemi AES256 driver"
    default y
    depends on DT_HAS_LINKEDSEMI_AES256_ENABLED
    help
      Enable linkedsemi CRYPTO driver.

config CRYPTO_LINKEDSEMI_MAX_SESSION
    int "Maximum of sessions linkedsemi crypto driver can handle"
    default 1
    depends on CRYPTO_LINKEDSEMI
    help
      This can be used to tweak the amount of sessions the driver
      can handle in parallel.


config CRYPTO_LINKEDSEMI_OTBN
  bool "linkedsemi otbn driver"
  depends on DT_HAS_LINKEDSEMI_OTBN_CRYPTO_ENABLED

config CRYPTO_LINKEDSEMI_OTBN_SM2
  bool "linkedsemi otbn driver"
  select CRYPTO_LINKEDSEMI_OTBN
  default y
  depends on DT_HAS_LINKEDSEMI_OTBN_SM2_ENABLED

config CRYPTO_LINKEDSEMI_OTBN_ECC_P256
  bool "linkedsemi otbn driver"
  select CRYPTO_LINKEDSEMI_OTBN
  default y
  depends on DT_HAS_LINKEDSEMI_OTBN_ECC_P256_ENABLED

config CRYPTO_LINKEDSEMI_OTBN_ECC_P384
  bool "linkedsemi otbn driver"
  select CRYPTO_LINKEDSEMI_OTBN
  default y
  depends on DT_HAS_LINKEDSEMI_OTBN_ECC_P384_ENABLED
```

## drivers/disk/Kconfig.vm
```kconfig
config DISK_DRIVER_VIRTUAL_MEDIA
	bool "Virtual Media"
	depends on DT_HAS_ZEPHYR_VIRTUAL_MEDIA_ENABLED
	default y
	help
	  virtual media

if DISK_DRIVER_VIRTUAL_MEDIA

module = VIRTUAL_MEDIA
module-str = virtual_media
source "subsys/logging/Kconfig.template.log_config"

endif # DISK_DRIVER_VIRTUAL_MEDIA
```

## drivers/dma/Kconfig.dw
```kconfig
# DesignWare DMA configuration options

# Copyright (c) 2018 Intel Corporation
# SPDX-License-Identifier: Apache-2.0

config DMA_DW
	bool "DesignWare DMA driver"
	default y
	depends on DT_HAS_SNPS_DESIGNWARE_DMA_ENABLED
	help
	  DesignWare DMA driver.

config DMA_DW_2_20A
	bool "DesignWare DMA driver"
	default y
	depends on DT_HAS_SNPS_DESIGNWARE_DMA_2_20A_ENABLED
	help
	  DesignWare DMA driver.

config DMA_LINKEDSEMI
	bool "linkedsemi DMA driver"
	default y
	depends on DT_HAS_LINKEDSEMI_DMA_ENABLED
	help
	  DesignWare DMA driver.

if DMA_DW || DMA_DW_2_20A || DMA_LINKEDSEMI

source "drivers/dma/Kconfig.dw_common"

endif
```

## drivers/entropy/Kconfig.ls_apb_trng
```kconfig
# SPDX-License-Identifier: Apache-2.0

config ENTROPY_LS_APB_TRNG
	bool "Linkedsemi APB TRNG entropy driver"
	default y
	depends on DT_HAS_LINKEDSEMI_LS_APB_TRNG_ENABLED
	select ENTROPY_HAS_DRIVER
	select PIPES
	help
	  Enable Linkedsemi APB ring-oscillator TRNG driver.
	  Polling-based; each 16-bit sample waits for FSM match,
	  then FSM_RST advances to next search.

config ENTROPY_LS_APB_TRNG_POOL_SIZE
	int "APB TRNG entropy pipe pool size (bytes)"
	default 64
	range 16 256
	depends on ENTROPY_LS_APB_TRNG
	help
	  Size in bytes of the static k_pipe buffer used by the APB TRNG
	  entropy driver.  Each hardware sample is 2 bytes.  64 bytes =
	  32 samples.
```

## drivers/entropy/Kconfig.ls_trng
```kconfig
# SPDX-License-Identifier: Apache-2.0

config ENTROPY_LS_DWTRNG
	bool "linkedsemi DWTRNG entropy driver"
	default y
	depends on DT_HAS_LINKEDSEMI_LS_DWTRNG_ENABLED
	select ENTROPY_HAS_DRIVER
	select PIPES
	help
	  Enable linkedsemi DWTRNG driver.
	  HW produces 128-bit per command; driver caches 16 bytes and
	  serves byte-wise; after ~524k bits the state is advanced.
```

## drivers/ethernet/Kconfig.dwmac
```kconfig
# Synopsys DesignWare MAC configuration options

# Copyright (c) 2021 BayLibre SAS
# SPDX-License-Identifier: Apache-2.0

menuconfig ETH_DWMAC
	bool "Synopsys DesignWare MAC driver"
	default y
	depends on NET_BUF_FIXED_DATA_SIZE
	depends on (SOC_SERIES_STM32H7X && !ETH_STM32_HAL) || MMU || SOC_LSQSH
	depends on DT_HAS_SNPS_DESIGNWARE_ETHERNET_ENABLED
	help
	  This is a driver for the Synopsys DesignWare MAC, also referred to
	  as "DesignWare Cores Ethernet Quality-of-Service". Hardware versions
	  4.x and 5.x are supported.

	  Platform specific glue support is also required. This driver is
	  currently available on targets using the STM32H7X series as an
	  alternative to the eth_stm32_hal driver. Support for a generic DT
	  and MMU based platform is also provided.

	  Not yet implemented:
	  - MDIO (currently relying on default PHY config)
	  - PTP support
	  - VLAN support
	  - various hardware offloads (when available)

if ETH_DWMAC

config ETH_DWMAC_STM32H7X
	bool
	depends on SOC_SERIES_STM32H7X
	select NOCACHE_MEMORY if ARCH_HAS_NOCACHE_MEMORY_SUPPORT
	default y

config ETH_DWMAC_MMU
	bool
	depends on MMU
	default y

config ETH_DWMAC_LINKEDSEMI
	bool
	depends on SOC_LSQSH
	default y

config DWMAC_NB_TX_DESCS
	int "Number of entries in the transmit descriptor ring"
	default 16
	help
	  A higher number allows for more packets to be queued which may
	  improve throughput, but that requires more transient memory.
	  However there must be enough descriptors to hold all fragments
	  of a full-size packet to be transmitted or the packet will be
	  dropped.

	  Fragment size is influenced by CONFIG_NET_BUF_DATA_SIZE.

config DWMAC_NB_RX_DESCS
	int "Number of entries in the receive descriptor ring"
	default 16
	help
	  Received packets are spread across the required number of fragment
	  buffers. Each RX fragment has a size of CONFIG_NET_BUF_DATA_SIZE.
	  There is one descriptor entry per fragment.

	  A higher number allows for more packets to be received without
	  immediate intervention from the CPU but requires more transient
	  memory. A smaller number increases the risk of an overflow and
	  dropped packets.

config RX_REFILL_STACK_SIZE
	int "stack size for RX refill thread"
	default 1024
	help
	  stack size for RX refill thread

config DWMAC_RX_COALESCE_DESC
	int "RX interrupt coalesce descriptor count"
	default 1
	range 1 500
	help
	  Number of RX descriptors to aggregate before asserting a receive
	  interrupt (RDES3 IOC bit). A value of 1 disables coalescing.

	  When N > 1, the RX IRQ Watchdog Timer (RIWT) is also enabled as a
	  timeout fallback for trailing packets in a burst.

config DWMAC_RX_COALESCE_RIWT
	int "RX IRQ watchdog timer count (RIWT)"
	default 234
	range 16 255
	help
	  RWT field (bits[7:0]) written to DMA_CHn_RX_IRQ_WATCHDOG_TIMER.
	  Only used when DWMAC_RX_COALESCE_DESC > 1. The watchdog expires
	  after (RIWT * RWTU multiplier) CSR clock cycles when a packet
	  completes on a descriptor without IOC.

config DWMAC_RX_COALESCE_RIWTU
	int "RX IRQ watchdog timer unit (CSR cycles per RIWT count)"
	default 256
	help
	  RWTU multiplier for DMA_CHn_RX_IRQ_WATCHDOG_TIMER bits[13:12].
	  Only used when DWMAC_RX_COALESCE_DESC > 1. Set to one of:
	  256, 512, 1024, or 2048. The driver maps these to the hardware
	  encoding 0, 1, 2, 3. Watchdog timeout is:

	    RIWT * DWMAC_RX_COALESCE_RIWTU / CSR_clock

config MDIO_RESET_MAC
	bool "MDIO_RESET_MAC"
	default y
	help
	  MDIO_RESET_MAC

endif # ETH_DWMAC
```

## drivers/flash/Kconfig.ls_mbox_cpu0
```kconfig
# Copyright (c) 2023 Linkedsemi
# SPDX-License-Identifier: Apache-2.0

config SOC_FLASH_LS_MBOX_CPU0
	bool "linkedsemi ls flash driver"
	default y
	depends on DT_HAS_LINKEDSEMI_MBOX_CPU0_FLASH_CONTROLLER_ENABLED
	select FLASH_HAS_PAGE_LAYOUT
	select FLASH_HAS_DRIVER_ENABLED
	select FLASH_JESD216
	select FLASH_HAS_EXPLICIT_ERASE
	select MBOX
	help
	  Enables linkedsemi ls flash driver.
```

## drivers/flash/Kconfig.ls_mbox_cpu2
```kconfig
# Copyright (c) 2025 Linkedsemi
# SPDX-License-Identifier: Apache-2.0

config SOC_FLASH_LS_MBOX_CPU2
	bool "linkedsemi ls flash driver"
	default y
	depends on DT_HAS_LINKEDSEMI_MBOX_CPU2_FLASH_CONTROLLER_ENABLED
	select FLASH_HAS_PAGE_LAYOUT
	select FLASH_HAS_DRIVER_ENABLED
	select FLASH_JESD216
	select FLASH_HAS_EXPLICIT_ERASE
	select MBOX
	help
	  Enables linkedsemi ls flash driver.
```

## drivers/gpio/Kconfig.lsqsh
```kconfig
# Linkedsemi LS GPIO configuration options

# Copyright (c) 2024 Linkedsemi
# SPDX-License-Identifier: Apache-2.0

config GPIO_LSQSH
    bool "Linkedsemi lsqsh GPIO driver"
    default y
    depends on DT_HAS_LINKEDSEMI_LSQSH_GPIO_ENABLED
    help
      Enable the Linkedsemi ls GPIO driver.

config GPIO_LINKEDSEMI_SGPIOM
    bool "LINKEDSEMI SGPIOM Controllers"
    default n
    depends on DT_HAS_LINKEDSEMI_SGPIOM_ENABLED
    select DYNAMIC_INTERRUPTS
    help
      Enable config options to support the LINKEDSEMI SGPIOM controllers.
```

## drivers/i2c/target/Kconfig.ipmb
```kconfig
config I2C_IPMB_TARGET
	bool "I2C Target IPMB driver"
	help
	  Enable IPMB driver
```

## drivers/ipmi/Kconfig
```kconfig
menuconfig IPMI
    bool "IPMI drivers"
    help
      Includes IPMI drivers in the system configuration.

if IPMI

source "drivers/ipmi/Kconfig.ls"

module = IPMI
module-str = ipmi
source "subsys/logging/Kconfig.template.log_config"


config IPMI_INIT_PRIORITY
    int "IPMI driver init priority"
    default 11
    help
       IPMI driver initialization priority.
endif
```

## drivers/led/Kconfig.corelynx
```kconfig
config LED_GPIO_CORELYNX
	bool "CoreLynx GPIO LED driver"
	default y
	help
	  Enable driver for CoreLynx GPIO LEDs.
```

## drivers/mbox/Kconfig.linkedsemi
```kconfig
# Copyright (c) 2025 linkedsemi
# SPDX-License-Identifier: Apache-2.0

config MBOX_LINKEDSEMI
	bool "MBOX LINKEDSEMI driver"
	depends on DT_HAS_LINKEDSEMI_MBOX_ENABLED
	default y
	help
	  MBOX Driver for LINKEDSEMI SOC

config MBOX_LINKEDSEMI_LAYOUT_CHECK
	bool "MBOX layout check"
	depends on MBOX_LINKEDSEMI
	default y
	help
	  Check the mbox layout in shared memory.  The initiator publishes
	  the shared info (magic, channel count and per-channel fifo config)
	  and both cores validate it against their own build-time layout at
	  init.

	  Both core images must set this option identically.  If the
	  initiator image disables it while the peer keeps it enabled, the
	  peer fails to initialize with -ENODEV because the shared info is
	  never published.

	  Disabling the check skips the cross-image validation, so a
	  devicetree mismatch between the two images (channel count, fifo
	  width/depth or shared region placement) is no longer detected.

config MBOX_LINKEDSEMI_TX_FIFO_INIT_LEGACY
	bool "Legacy TX fifo initialization on the peer core"
	depends on MBOX_LINKEDSEMI
	default y if !MBOX_LINKEDSEMI_LAYOUT_CHECK
	help
	  Initialize the local TX fifo environment on the non-initiator core
	  during driver init (legacy behavior).

	  Enabled by default when CONFIG_MBOX_LINKEDSEMI_LAYOUT_CHECK is
	  disabled.  When the layout check is enabled, the peer core adopts
	  the initiator-published shared memory layout, so re-initializing
	  the TX fifo here is not needed and is disabled by default.
```

## drivers/pcc/Kconfig
```kconfig
# PCC (post code capture) configuration options

# Copyright (c) 2026 Linkedsemi
# SPDX-License-Identifier: Apache-2.0

menuconfig PCC
    bool "PCC (post code capture) drivers"
    help
      Include PCC post code capture drivers in the system configuration.

if PCC

source "drivers/pcc/Kconfig.ls"

module = PCC
module-str = pcc
source "subsys/logging/Kconfig.template.log_config"

config PCC_INIT_PRIORITY
    int "PCC driver init priority"
    default 10
    help
       PCC driver initialization priority.

endif
```

## drivers/pcc/Kconfig.ls
```kconfig
config PCC_LS
    bool "Linkedsemi PCC driver"
    default y
    depends on DT_HAS_LINKEDSEMI_LS_PCC_ENABLED
    help
      Enable support for linkedsemi PCC driver
```
