## boards/linkedsemi/le501x_evb/board.yml
```yaml
board:
  name: le501x_evb
  full_name: LinkSemi 501X Evaluation Board
  vendor: linkedsemi
  socs:
  - name: le5010
```

## boards/linkedsemi/ls101x_evb/board.yml
```yaml
board:
  name: ls101x_evb
  full_name: LinkSemi 101X Evaluation Board
  vendor: linkedsemi
  socs:
  - name: ls1010
```

## boards/linkedsemi/ls1020_evb/board.yml
```yaml
board:
  name: ls1020_evb
  full_name: LinkSemi 1020 Evaluation Board
  vendor: linkedsemi
  socs:
  - name: lsqsh
  revision:
    format: custom
```

## boards/linkedsemi/lsqsh_evb/board.yml
```yaml
board:
  name: lsqsh_evb
  full_name: LinkSemi QSH Evaluation Board
  vendor: linkedsemi
  socs:
  - name: lsqsh
  revision:
    format: custom
```

## drivers/entropy/Kconfig.ls_apb_trng
```kconfig
# SPDX-License-Identifier: Apache-2.0

config ENTROPY_LS_APB_TRNG
	bool "Linkedsemi APB TRNG entropy driver"
	default y
	depends on DT_HAS_LINKEDSEMI_LS_APB_TRNG_ENABLED
	select ENTROPY_HAS_DRIVER
	select PIPES
	help
	  Enable Linkedsemi APB ring-oscillator TRNG driver.
	  Polling-based; each 16-bit sample waits for FSM match,
	  then FSM_RST advances to next search.

config APB_TRNG_LINKEDSEMI_NO_CLOCK_RESET
	bool "Skip APB TRNG CCTL/RCTL access in the driver"
	depends on ENTROPY_LS_APB_TRNG
	help
	  When enabled, the linkedsemi APB TRNG driver does not run
	  clock_control_off/on or reset_line_toggle in trng_power_cycle().
	  This covers both ls_apb_trng_init() and the trng_hw_recover()
	  path. Use this on cores that cannot access SEC_PER (for example
	  CPU2 when IOPMP blocks it); the clock must then be brought up by
	  the core that owns it.

config ENTROPY_LS_APB_TRNG_POOL_SIZE
	int "APB TRNG entropy pipe pool size (bytes)"
	default 64
	range 16 256
	depends on ENTROPY_LS_APB_TRNG
	help
	  Size in bytes of the static k_pipe buffer used by the APB TRNG
	  entropy driver.  Each hardware sample is 2 bytes.  64 bytes =
	  32 samples.
```

## drivers/serial/Kconfig.linkedsemi
```kconfig
config UART_LINKEDSEMI
	default y
	depends on DT_HAS_LINKEDSEMI_LS_UART_ENABLED
	select SERIAL_HAS_DRIVER
	select SERIAL_SUPPORT_INTERRUPT
	bool "LINKEDSEMI serial driver"
	help
	  uart1 enable.
 
config VIRTUAL_UART_LINKEDSEMI
	default y
	depends on DT_HAS_LINKEDSEMI_LS_VUART_ENABLED
	select SERIAL_HAS_DRIVER
	select SERIAL_SUPPORT_INTERRUPT
	bool "LINKEDSEMI virtual uart driver"
	help
	  virtual uart enable.

config VUART_IRQ_THREAD_PRIORITY
    int "VUART IRQ thread priority"
    default -2

config VUART_IRQ_THREAD_STACK_SIZE
    int "ESPI VUART driver irq thread stack size"
    default 2048
    help
      Driver irq thread stack size.
```

## dts/bindings/ethernet/mdio/snps,dwmac-mdio.yaml
```yaml
# Copyright (c) 2026
# SPDX-License-Identifier: Apache-2.0

description: SNPS DWMAC MDIO Features

compatible: "snps,dwmac-mdio"

include: [mdio-controller.yaml, pinctrl-device.yaml, reset-device.yaml]

properties:
  reset-hold-ms:
    type: int
    default: 0
    description: |
      delay time (in ms)

  circuits-set-ms:
    type: int
    default: 0
    description: |
      delay time (in ms)
```

## dts/bindings/hwmon/linkedsemi,hwmon.yaml
```yaml
# Copyright (c) 2021, linkedsemi
# SPDX-License-Identifier: Apache-2.0

description: linkedsemi Hwmon

compatible: "linkedsemi,hwmon"

include: [base.yaml, hwmon-controller.yaml]

properties:
  class:
    type: int
    required: true
  sensor-type:
    type: string
    required: false
    enum:
      - temp
      - pmbus
      - intrusion
      - peci_cputemp
    # NOTE: `sensor-type` is only a label (used for the hwmon `name` file).
    # It does NOT decide which <chan>_input files are created.
    # `peci_cputemp` is matched by IntelCPUSensorMain (name == "peci_cputemp"
    # filter, same string the upstream Linux xeon-pci-sensors driver emits).
  meas:
    type: string-array
    required: false
    description: >
      List of hwmon ABI files to expose for this node. Each entry is
      "<chan><n>_input" with an OPTIONAL ":<label>" suffix, e.g.
      "in1_input:vin1", "in3_input:vout1", "curr2_input:iout1",
      "power2_input:pout1", "temp1_input", "fan1_input",
      "intrusion1_input".

      At read time hwmon_i2c parses the filename part (before ':'): the prefix
      (in/curr/power/temp/fan/intrusion) selects the sensor_channel, and the
      number (minus 1) is passed as val2 (the rail/sub-channel selector the
      driver's channel_get expects).

      The OPTIONAL part after ':' becomes the content of a companion
      "<chan><n>_label" file (input->label). This lets dbus-sensors tell
      vin/vout, iin/iout, pin/pout apart (label heads such as vin1, vout1,
      iin1, iout1, pin, pout1, should pick from labelMatch in PSUSensorMain). 
      If ":<label>" is omitted no label file is
      created and dbus-sensors falls back to the generic "output" property.
  attr-set:
    type: string
    required: false
    description: >
      Name of a code-side attribute set in hwmon_general.c ("pmbus"), used
      instead of listing every file in `meas`. A set is a table of hwmon ABI
      file names for a conventional chip layout, so a device with dozens of
      files needs one line here rather than dozens of `meas` entries.
      Precedence: `meas` wins when both are present.
  channels:
    type: int
    required: false
    description: >
      Optional cut-off for `attr-set`: entries whose file name carries a number
      greater than `channels` are not created. Omit it to keep the whole set.
      The number in a hwmon file name is the sensor driver's sub-channel
      selector (val2 = number - 1), so this is a per-prefix limit (e.g.
      channels = 2 keeps in1/in2 but drops in3), not a "number of output
      rails" knob.
  hwmon-ins:
    type: phandle-array
  hwmon-outs:
    type: phandle-array
```

## dts/bindings/serial/linkedsemi,uart-agent.yaml
```yaml
description: Linkedsemi uart agent
compatible: "linkedsemi,uart-agent"

include: [base.yaml]

properties:
  fifo_base:
    type: int
    required: true
    description: Virtual UART FIFO Base Addr

  mbox:
    type: phandle

  uart:
    type: phandles
    required: true
    description: |
      Phandles to the physical UART controllers. Every backend receives the
      data written by the host on the shared virtual UART FIFO, and the data
      received on all of them is merged into that same FIFO.
```

## soc/linkedsemi/lsqsh/uart_agent/Kconfig
```kconfig
config UART_AGENT
	bool "uart agent"
	default y
	depends on DT_HAS_LINKEDSEMI_UART_AGENT_ENABLED

config UART_AGENT_MAX_BACKENDS
	int "Maximum number of uart agent backends"
	default 4
	range 1 8
	depends on UART_AGENT
	help
	  Maximum number of UART devices a single uart agent instance can
	  forward data to. All backends share the same virtual UART FIFO
	  and the same mbox channel.
```
