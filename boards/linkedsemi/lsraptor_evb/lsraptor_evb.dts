
/dts-v1/;
#include <riscv/linkedsemi/lsraptor.dtsi>

/ {
	model = "linkedsemi LSRAPTOR_EVB";
	compatible = "linkedsemi,lsraptor_evb";

	chosen {
		zephyr,sram = &sram0;
		zephyr,shell-uart = &dwuart8;
		zephyr,console = &dwuart8;
	};

};

&dwuart8 {
	status = "okay";
	current-speed = <250000>;
};