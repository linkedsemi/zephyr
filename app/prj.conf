## CMakeLists.txt
```
# SPDX-License-Identifier: Apache-2.0

cmake_minimum_required(VERSION 3.20.0)

find_package(Zephyr REQUIRED HINTS $ENV{ZEPHYR_BASE})
project(libpeci-test)

set(CMAKE_BUILD_TYPE Debug)
if(CMAKE_BUILD_TYPE STREQUAL "Debug")
       set(CMAKE_C_FLAGS "${CMAKE_C_FLAGS} -g")
       set(CMAKE_CXX_FLAGS "${CMAKE_CXX_FLAGS} -g")
endif()

set(common_path ${CMAKE_CURRENT_LIST_DIR})
FILE(GLOB app_sources ${common_path}/libpeci/peci.c)

target_sources(app PRIVATE ${app_sources})
target_sources(app PRIVATE src/main.c)

target_include_directories(app PRIVATE ${common_path}/libpeci)
```

## prj.conf
```kconfig
CONFIG_STDOUT_CONSOLE=y
CONFIG_PRINTK=y
CONFIG_PECI=y
CONFIG_PM_DEVICE=y
CONFIG_CRC=y
CONFIG_PECI_CORE=y
CONFIG_POSIX_API=y
CONFIG_XSI_SYSTEM_LOGGING=y
CONFIG_STATIC_INIT_GNU=y

CONFIG_LOG=y
CONFIG_LOG_CMDS=y
CONFIG_LOG_BUFFER_SIZE=16384
CONFIG_LOG_PROCESS_THREAD_STACK_SIZE=4096

CONFIG_COMMON_LIBC_MALLOC=y
CONFIG_COMMON_LIBC_MALLOC_ARENA_SIZE=4096
```

## src/main.c
```c
/*
 * Copyright (c) 2012-2014 Wind River Systems, Inc.
 *
 * SPDX-License-Identifier: Apache-2.0
 */

#include <stdio.h>
#include <peci.h>
#include <zephyr/kernel.h>

#ifndef ABS
#define ABS(_v_) (((_v_) > 0) ? (_v_) : -(_v_))
#endif


/* PECI Target address */
#define PECI_TARGET_ADDR          0x30u

int main(void)
{
    EPECIStatus ret = PECI_CC_SUCCESS;
    printf("Hello World from APP! %s\n", CONFIG_BOARD);
    uint64_t dib;
    short temperature;
    int n = 0;

    while(1){
        printf("Debug: In true loop!\n");
        // ret = peci_Ping(PECI_TARGET_ADDR);
        // printf("PECI Ping: %d\n", ret);

        ret = peci_GetDIB(PECI_TARGET_ADDR, &dib);
        printf("   0x%" PRIx64 "\n", dib);

        // ret = peci_GetTemp(PECI_TARGET_ADDR, &temperature);
        // printf("   %04xh (%c%d.%02dC)\n",
        //                    (int)(unsigned int)(unsigned short)temperature,
        //                    (0 > temperature) ? '-' : '+',
        //                    (int)((unsigned int)ABS(temperature) / 64),
        //                    (int)(((unsigned int)ABS(temperature) % 64) * 100) /
        //                        64);
            
        printf("Debug in %s: Times = %d\n", __func__, n++);

        k_sleep(K_SECONDS(1));    
    }

    return 0;
}
```
