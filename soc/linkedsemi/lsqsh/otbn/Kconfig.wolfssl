## soc/linkedsemi/lsqsh/otbn/Kconfig.wolfssl
```kconfig
if WOLFSSL

config WOLFSSL_LINKEDSEMI_OTBN_DELEGATION
    bool "delegation based on otbn for wolfssl"
    default n

config WOLFSSL_LINKEDSEMI_OTBN_DELEGATION_CLIENT
    bool "otbn moudule can be excuted in delegation server."
    default n
    select WOLFSSL_LINKEDSEMI_OTBN_DELEGATION
    select WOLFSSL_LINKEDSEMI_OTBN_ECC_ALT

config WOLFSSL_LINKEDSEMI_OTBN_DELEGATION_SERVER
    bool "otbn moudule can be excuted locally."
    default n
    select WOLFSSL_LINKEDSEMI_OTBN_DELEGATION

config WOLFSSL_LINKEDSEMI_OTBN_ECC_ALT
    bool "Replace the original software encryption function with the ECC encryption provided by OTBN. However, it only supports SM2, P256, and P384."
    select WOLFSSL_LINKEDSEMI_OTBN_ENABLE
    default n

config WOLFSSL_LINKEDSEMI_HARDWARE_SHA224_SHA256_SM3_ALT
    bool "Replace the software sha224、 sha256 and sm3 hash calculate of wolfssl with the hardware hash of linkedsemi"
    default n

config WOLFSSL_LINKEDSEMI_HARDWARE_SHA384_SHA512_ALT
    bool "Replace the software sha512 and sha384 hash calculate of wolfssl with the hardware hash of linkedsemi"
    default n

config WOLFSSL_LINKEDSEMI_HARDWARE_SM4_ALT
    bool "Replace the software SM4 of wolfssl with the hardware sm4 of linkedsemi"
    default n

config WOLFSSL_LINKEDSEMI_HARDWARE_AES_ALT
    bool "Replace the software aes of wolfssl with the hardware aes of linkedsemi"

config WOLFSSL_LINKEDSEMI_OTBN_RSA_ALT
    bool "Replace the software rsa of wolfssl with the otbn's rsa of linkedsemi"
    select WOLFSSL_LINKEDSEMI_OTBN_ENABLE
    default n

config WOLFSSL_LINKEDSEMI_OTBN_ENABLE
    bool "enable otbn moudule"
    default n
    select LINKEDSEMI_OTBN

endif
```

## soc/linkedsemi/lsqsh/uart_agent/Kconfig
```kconfig
config UART_AGENT
	bool "uart agent"
	default y
	depends on DT_HAS_LINKEDSEMI_UART_AGENT_ENABLED
```

## soc/linkedsemi/lsraptor/Kconfig
```kconfig
config SOC_SERIES_LSRAPTOR
    select RISCV
    select TICKLESS_CAPABLE
    select INCLUDE_RESET_VECTOR
    select RISCV_PRIVILEGED
    select BUILD_OUTPUT_HEX
    select CPU_HAS_FPU
    select FPU
    select ARCH_HAS_RAMFUNC_SUPPORT
  	select RISCV_ISA_RV32I
    select RISCV_ISA_EXT_M
    select RISCV_ISA_EXT_A
    select RISCV_ISA_EXT_C
    select RISCV_ISA_EXT_F
    select RISCV_ISA_EXT_D
    select RISCV_HAS_CLIC
    select RISCV_GP
    select RISCV_ALWAYS_SWITCH_THROUGH_ECALL
    select RISCV_SOC_INTERRUPT_INIT
    select ARCH_HAS_USERSPACE
    select CPU_HAS_DCACHE
    select CPU_HAS_ICACHE
    select TOOLCHAIN_SUPPORTS_THREAD_LOCAL_STORAGE
    select RISCV_SOC_HAS_CUSTOM_IRQ_HANDLING
```

## soc/linkedsemi/lsraptor/Kconfig.soc
```kconfig
config SOC_LSRAPTOR_E906
    bool
    select SOC_SERIES_LSRAPTOR

config SOC_SERIES_LSRAPTOR
    bool
    select SOC_FAMILY_LS_MCU

config SOC_SERIES
    default "lsraptor" if SOC_SERIES_LSRAPTOR

config SOC
    default "lsraptor_e906" if SOC_LSRAPTOR_E906
```

## subsys/dbroker/Kconfig
```kconfig
# SPDX-License-Identifier: Apache-2.0

menuconfig DBROKER
	bool "D-Bus Broker support"
	default n
	help
		Enable D-Bus broker support for inter-process communication.

if DBROKER

choice
	prompt "D-Bus broker connection type"
	default DBUS_BROKER_INET

config DBUS_BROKER_INET
	bool "Use INET sockets"
	help
		Use AF_INET sockets for client connections.
		This requires network stack and uses more resources.

config DBUS_BROKER_SOCKETPOOL
	bool "Use socketpool"
	select NET_SOCKETPAIR
	help
		Use a pool of pre-allocated socketpairs for client connections.
		This is more efficient than INET sockets and uses less resources.

endchoice

config DBUS_BROKER_PORT
	int "D-Bus broker listening port"
	depends on DBUS_BROKER_INET
	default 55555
	help
		Port number for D-Bus broker listener.

config DBUS_BROKER_SOCKETPOOL_SIZE
	int "Number of socketpairs in pool"
	depends on DBUS_BROKER_SOCKETPOOL
	default 16
	help
		Number of pre-allocated socketpairs in the pool.
		Each socketpair uses 2 file descriptors.

config DBUS_BROKER_SOCKETPOOL_BUFFER_SIZE
	int "Socketpair buffer size in bytes"
	depends on DBUS_BROKER_SOCKETPOOL
	default 4096
	help
		Buffer size for each socketpair in the pool.
		This is the size of the socket send/receive buffer for each
		end of the socketpair. A larger buffer allows larger messages
		to be sent without blocking, but uses more memory.

		Total memory usage = SOCKETPOOL_SIZE * 2 * SOCKETPOOL_BUFFER_SIZE

		Examples:
		- 16 pairs * 2 * 4KB = 128KB
		- 16 pairs * 2 * 8KB = 256KB
		- 16 pairs * 2 * 16KB = 512KB

		For most D-Bus use cases, 4KB-8KB is sufficient.

config DBUS_BROKER_STACK_SIZE
	int "D-Bus broker thread stack size"
	default 8192
	help
		Stack size for D-Bus broker thread.

config DBUS_BROKER_PRIORITY
	int "D-Bus broker thread priority"
	default 7
	help
		Priority for D-Bus broker thread.

endif # DBROKER
```

## subsys/fs/sysfs/Kconfig
```kconfig
#Copyright (c) 2024 BayLibre SAS

#SPDX-License-Identifier: Apache-2.0

config SYSFS
	bool "Sys Filesystem"
	help
	  Enable support of Sys Filesystem.

if SYSFS

config SYSFS_FILE_NUM_MAX
	int "maximum number of files supported by sysfs"
	default 256
	range 1 512

module = SYSFS
module-str = sysfs
source "subsys/logging/Kconfig.template.log_config"

endif # SYSFS
```
