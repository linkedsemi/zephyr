## soc/arm/linkedsemi_arm/le501x/Kconfig.defconfig.series
```kconfig
if SOC_SERIES_LE501X

source "soc/arm/linkedsemi_arm/le501x/Kconfig.defconfig.le5010"

config SOC_SERIES
    default "le501x"

endif
```

## soc/arm/linkedsemi_arm/le501x/Kconfig.series
```kconfig
config SOC_SERIES_LE501X
    bool "Linkedsemi LE501X series Cortex-M0 MCU"
    select ARM
    select CPU_CORTEX_M0
  	select XIP
    select TICKLESS_CAPABLE
    select SOC_FAMILY_LINKEDSEMI_ARM
    select BUILD_OUTPUT_HEX
    select PM
    select HAS_SEGGER_RTT 
```

## soc/linkedsemi/Kconfig.soc
```kconfig
config SOC_FAMILY_LS_MCU
	bool

config SOC_FAMILY
	default "ls_mcu" if SOC_FAMILY_LS_MCU

rsource "*/Kconfig.soc"
```

## soc/linkedsemi/le501x/Kconfig
```kconfig
config SOC_SERIES_LE501X
    bool
    select ARM
    select CPU_CORTEX_M0
  	select XIP
    select TICKLESS_CAPABLE
    select BUILD_OUTPUT_HEX
    select HAS_PM
    select HAS_SEGGER_RTT 
```

## soc/linkedsemi/le501x/Kconfig.defconfig.le5010
```kconfig
if SOC_LE5010

config SOC
    default "LE5010"

config NUM_IRQS
    default 32

endif
```

## soc/linkedsemi/le501x/Kconfig.soc
```kconfig
config SOC_LE5010
    bool
    select SOC_SERIES_LE501X

config SOC_SERIES_LE501X
    bool
    select SOC_FAMILY_LS_MCU

config SOC_SERIES
    default "le501x" if SOC_SERIES_LE501X

config SOC
    default "le5010" if SOC_LE5010

    
```

## soc/linkedsemi/ls101x/Kconfig.soc
```kconfig
config SOC_LS1010
    bool
    select SOC_SERIES_LS101X

config SOC_SERIES_LS101X
    bool
    select SOC_FAMILY_LS_MCU

config SOC_SERIES
    default "ls101x" if SOC_SERIES_LS101X

config SOC
    default "ls1010" if SOC_LS1010
```

## soc/riscv/riscv-privileged/ls101x/Kconfig.defconfig.ls1010
```kconfig
if SOC_LS1010

config SOC
    default "LS1010"

config RISCV_HAS_PLIC
	default n

config RISCV_HAS_CLIC
	default y

config RISCV_SOC_MCAUSE_EXCEPTION_MASK
	hex
	default 0x1f

endif
```

## soc/riscv/riscv-privileged/ls101x/Kconfig.defconfig.series
```kconfig
if SOC_SERIES_LS101X

source "soc/riscv/riscv-privileged/ls101x/Kconfig.defconfig.ls1010"

config SOC_SERIES
    default "ls101x"

config SYS_CLOCK_HW_CYCLES_PER_SEC
	default 24000000

config NUM_IRQS
	default 64

config RISCV_GP
	bool
	default y

config MAIN_STACK_SIZE
	default 2048

config RISCV_HAS_CPU_IDLE
	default y

config RISCV_HAS_PLIC
	default n


endif
```

## soc/riscv/riscv-privileged/ls101x/Kconfig.series
```kconfig
config SOC_SERIES_LS101X
    bool "Linkedsemi LS1010 series risc-v MCU"
    select RISCV
  	select XIP
    select TICKLESS_CAPABLE
    select INCLUDE_RESET_VECTOR
    select SOC_FAMILY_RISCV_PRIVILEGED
    select BUILD_OUTPUT_HEX
    select CPU_HAS_FPU
    select ARCH_HAS_RAMFUNC_SUPPORT
  	select RISCV_ISA_RV32I
    select RISCV_ISA_EXT_M
    select RISCV_ISA_EXT_A
    select RISCV_ISA_EXT_C
    select RISCV_HAS_CLIC
    select RISCV_SOC_HAS_ISR_STACKING
    
```

## soc/riscv/riscv-privileged/ls101x/Kconfig.soc
```kconfig
choice
    prompt "Linkedsemi LS1010 MCU Selection"
    depends on SOC_SERIES_LS101X

config SOC_LS1010
    bool "LS1010"



endchoice
```
