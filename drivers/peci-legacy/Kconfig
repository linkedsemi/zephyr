## drivers/peci-legacy/Kconfig
```kconfig
source "subsys/logging/Kconfig.template.log_config"

config PECI_CORE
	bool "peci core support libpeci"
	default y
	help
	  Enable libpeci in zephyr.
```

## drivers/pwm/Kconfig.linkedsemi
```kconfig
# Copyright (c) 2024 Linkedsemi
# SPDX-License-Identifier: Apache-2.0

config PWM_LS
	bool "Linkedsemi 101x PWM driver"
	default y
	depends on DT_HAS_LINKEDSEMI_LS_PWM_ENABLED
	depends on CLOCK_CONTROL
	select PINCTRL
	help
	  Enable 101x PWM driver.

if PWM_LS

config PWM_LS_V2
    bool "Enable PWM V2 mode support"
	default y
	depends on SOC_SERIES_LSQSH
	help
	  Enable this option to add support for the newer QSH hardware variant of the Linkedsemi PWM. Leave disabled if using older hardware.

endif # PWM_LS
```

## drivers/reset/Kconfig.linkedsemi
```kconfig
# Copyright (c) 2025 linkedsemi
# SPDX-License-Identifier: Apache-2.0

config RESET_LINKEDSEMI
	bool "LINKEDSEMI Reset Controller Driver"
	default y
	depends on DT_HAS_LINKEDSEMI_RCTL_ENABLED
```

## drivers/rtc/Kconfig.au1901c
```kconfig
# Copyright (c) 2026 Linkedsemi Corporation
# SPDX-License-Identifier: Apache-2.0

config RTC_AU1901C
	bool "Aurasemi AU1901C I2C RTC driver"
	default y
	depends on DT_HAS_AURASEMI_AU1901C_ENABLED
	select I2C
	help
	  Enable the Aurasemi AU1901C I2C RTC driver.
```

## drivers/rtc/Kconfig.ins5710c
```kconfig
# SPDX-License-Identifier: Apache-2.0
# Copyright (c) 2026 Zou Wei
# Author: Zou Wei <wzou@linkedsemi.com>

config RTC_INS5710C
	bool "DAPU INS5710C I2C RTC driver"
	default y
	depends on DT_HAS_DAPU_INS5710C_ENABLED
	select I2C
	help
	  Enable the DAPU INS5710C RTC driver.
```

## drivers/sensor/alipsu/Kconfig
```kconfig
# ALIPSU Sensor Driver Configuration

config ALIPSU
    bool "ALIPSU Sensor Driver"
    depends on SMBUS && SENSOR
    select LS_PMBUS
    help
      Enable driver for ALIPSU sensor.
```

## drivers/sensor/linkedsemi/Kconfig
```kconfig
# Linkedsemi CAP Sensor Driver Configuration

config CAP_LS
    bool "Linkedsemi CAP sensor driver"
    default y
    depends on SENSOR && PINCTRL
    depends on DT_HAS_LINKEDSEMI_LS_CAP_ENABLED
    help
      Enable the Linkedsemi CAP function sensor driver.

if CAP_LS


config CAP_V2
	bool "Enable CAP V2 mode support"
	default n
	help
	  Enable this option to add support for the newer QSH hardware variant
	  of the Linkedsemi CAP sensor. Leave disabled if using older hardware.

config CAP_LS_FETCH_TIMEOUT_MS
	int "CAP sample_fetch wait timeout in milliseconds"
	default 1000
	range 1 60000
	help
	  How long cap_sample_fetch waits for a capture-complete interrupt.
	  CAP does not raise an IRQ if the pin stays at a fixed level, so
	  this must not be infinite. Timed-out fetch returns -EAGAIN.

endif # CAP_LS
```

## drivers/sensor/ls_pmbus/Kconfig
```kconfig
# LS PMBus Common Library

config LS_PMBUS
    bool "LS PMBus Common Library"
    help
      Enable common LS PMBus library.
```

## drivers/sensor/mp5023/Kconfig
```kconfig
# MP5023 PMBus Sensor Driver Configuration

config MP5023
    bool "MP5023 PMBus Sensor Driver"
    depends on SMBUS && SENSOR
    select LS_PMBUS
    help
      Enable driver for MP5023 PMBus sensor.

if MP5023

config MP5023_TRIGGER
    bool "Enable trigger support for MP5023"
    depends on MP5023
    help
      Enable trigger support for the MP5023 PMBus sensor.

config MP5023_DEFAULT_PAGE
    int "Default PMBus page for MP5023"
    default 0
    depends on MP5023
    help
      Default PMBus page to use for MP5023 operations.

config MP5023_TIMEOUT_MS
    int "Timeout for MP5023 operations in milliseconds"
    default 100
    depends on MP5023
    help
      Timeout value for MP5023 PMBus operations.

config MP5023_PEC_EN
    bool "Enable PEC (Packet Error Checking) for MP5023"
    default n
    depends on MP5023
    help
      Enable Packet Error Checking for MP5023 PMBus communication.

endif # MP5023
```

## drivers/sensor/pmbus/Kconfig
```kconfig
# PMBus Common Library

config PMBUS
    bool "PMBus Common Library"
    help
      Enable common PMBus library.
```

## drivers/serial/Kconfig.linkedsemi
```kconfig
config UART_LINKEDSEMI
	default y
	depends on DT_HAS_LINKEDSEMI_LS_UART_ENABLED
	select SERIAL_HAS_DRIVER
	select SERIAL_SUPPORT_INTERRUPT
	bool "LINKEDSEMI serial driver"
	help
	  uart1 enable.
 
config VIRTUAL_UART_LINKEDSEMI
	default y
	depends on DT_HAS_LINKEDSEMI_LS_VUART_ENABLED
	select SERIAL_HAS_DRIVER
	select SERIAL_SUPPORT_INTERRUPT
	bool "LINKEDSEMI virtual uart driver"
	help
	  virtual uart enable.

config VUART_IRQ_THREAD_PRIORITY
    int "VUART IRQ thread priority"
    default -2
```

## drivers/serial/Kconfig.vuart
```kconfig
 # drivers/serial/Kconfig
config VIRTUAL_UART
	  default y
    bool "Virtual  UART Device"
	  depends on DT_HAS_LINKEDSEMI_VUART_ENABLED
    help
      Enable the virtual  UART driver which emulates a UART device with no 
      physical UART hardware. This can be used in conjunction with an eSPI host 
      bridge to provide a host-visible serial port.
config VUART_INIT_PRIORITY
	int "Vuart driver initialization priority"
	default 1
	help
	  Driver initialization priority for eSPI driver.
```

## drivers/usb/udc/Kconfig.dwc3
```kconfig
# Copyright (c) 2023 Nordic Semiconductor ASA
# SPDX-License-Identifier: Apache-2.0

config UDC_DWC3
	bool "DWC3 USB device controller driver"
	default y
	depends on DT_HAS_SNPS_DWC3_ENABLED
	select EVENTS
	help
	  DWC3 USB device controller driver.

config UDC_DWC3_DEBUG
	bool "DWC3 USB DEBUG"
	default n
	depends on UDC_DWC3
	help
	  DWC3 USB debug.

config UDC_DWC3_STACK_SIZE
	int "UDC DWC3 driver internal thread stack size"
	depends on UDC_DWC3
	default 2048
	help
	  DWC3 driver internal thread stack size.

config UDC_DWC3_THREAD_PRIORITY
	int "UDC DWC3 driver thread priority"
	depends on UDC_DWC3
	default 8
	help
	  DWC3 driver thread priority.
```

## drivers/usb/udc/Kconfig.ls_fs
```kconfig
# Copyright (c) 2025 Linkedsemi
# SPDX-License-Identifier: Apache-2.0

config UDC_LS_FS
    bool "Driver for an Linkedsemi USB device controller"
    depends on DT_HAS_LINKEDSEMI_LS_FS_USB_ENABLED
    select PINCTRL
    default y
    help
      Linkedsemi USB device controller driver.

if UDC_LS_FS

config UDC_LS_FS_THREAD_STACK_SIZE
  int "UDC controller driver internal thread stack size"
  default 1024
  help
    Device controller driver internal thread stack size.

config UDC_LS_FS_THREAD_PRIORITY
  int "UDC controller driver thread priority"
  default 8
  help
    Device controller driver thread priority.

endif # UDC_LS_FS
```

## dts/bindings/adc/linkedsemi,ls-adc.yaml
```yaml
description: LINKEDSEMI LS ADC

compatible: "linkedsemi,ls-adc"

include: [base.yaml,pinctrl-device.yaml, reset-device.yaml,hwmon-controller.yaml]

properties:
  clock-source:
    type: int
    required: true
    description: "System clock source"

  conversion_mode:
    type: int
    required: true
    description: "Specifies ADC conversion mode"

  data_align:
    type: int
    required: true
    description: "Specifies ADC data alignment"

  continuous_conv_mode:
    type: int
    required: true
    description: "Specifies whether the conversion is performed in single mode (one conversion) or continuous mode for regular group"

  nbr_of_conversion:
    type: int
    required: true
    description: "Continuous capture item number for every capture start trigger in regular mode or injection mode"

  discontinuous_conv_mode:
    type: int
    required: true
    description: "Specifies whether the conversions sequence of regular group is performed in Complete-sequence/Discontinuous-sequence (main sequence subdivided in successive parts)."

  nbr_of_disc_conversion:
    type: int
    required: true
    description: "Specify the number of discontinuous transitions that occur in the main sequences of the regular group and the injection group. If the parameter 'DiscontinuousConvMode' is disabled, this parameter will be ignored."

  trig_type:
    type: int
    required: true
    description: "Selects the external event used to trigger the conversion start of regular group."

  adc_drive_type:
    type: int
    required: true
    description: " Select ADC Driving mode"

  adc_clk_div:
    type: int
    required: true
    description: "ADC division coefficient ranges from 1 to 0x1FFFF"

  clk_cfg:
    type: int
    required: true
    description: "ADC Clock Division"

  injected_offset:
    type: int
    required: true
    description: "Only valid in the injection mode"

  fif_ctrl1:
    type: int
    required: true
    description: "Only valid in the loop mode"
```

## dts/bindings/bluetooth/linkedsemi,bt-hci.yaml
```yaml
description: Bluetooth HCI on linkedsemi boards

compatible: "linkedsemi,bt-hci"

include: bt-hci.yaml

properties:
  bt-hci-name:
    default: "LINKEDSEMI BT"
  bt-hci-bus:
    default: "virtual"
  bt-hci-quirks:
    default: ["no-auto-dle"]
```

## dts/bindings/cap/linkedsemi,ls-cap.yaml
```yaml
description: CAP controller for Linkedsemi

compatible: "linkedsemi,ls-cap"

include: [base.yaml, pinctrl-device.yaml, reset-device.yaml]

properties:
  reg:
    required: true
    description: "Register address and size"
  clock-frequency:
    type: int
    required: true
    description: "Input clock frequency of the CAP module (unit: Hz)"
  prescaler:
    type: int
    required: true
    description: "Prescaler value for the CAP timer"
  channels:
    type: array
    required: true
    description: "CAP channels config"
  clocks:
    required: true
    description: "CAP module clock"
```

## dts/bindings/clock/linkedsemi,le501x-cctl.yaml
```yaml
# Copyright (c) 2024 LINKEDSEMI Corporation.
# SPDX-License-Identifier: Apache-2.0

description: LINKEDSEMI LE501X Clock Control

compatible: "linkedsemi,le501x-cctl"

include: [clock-controller.yaml, base.yaml]

properties:
  reg:
    required: true

clock-cells:
  - bus
  - reset
  - pos
```

## dts/bindings/clock/linkedsemi,ls-rtc.yaml
```yaml
# SPDX-License-Identifier: Apache-2.0

description: Linkedsemi LS101x RTC controller

compatible: "linkedsemi,ls-rtc"

include: base.yaml

properties:
  reg:
    required: true

  clocks:
    type: phandle-array
    required: true
    description: |
      Clock controller phandle with 3 cell values:
        - <cctl_addr_offest>
        - <set_bit>
        - <clr_bit>

  clock-frequency:
    type: int
    description: Internal or external RTC clock frequency

  #属性名要与 DTS 中一致：cyc-1hz、calib-cyc、calib-en  类型分别是 int（整型）和 boolean（布尔）
  cyc-1hz:
    type: int
    required: false
    description: |
      This value defines the number of base cycles for 1Hz, minus 1.
      Used for RTC calibration.

  calib-cyc:
    type: int
    required: false
    description: |
      Extra calibration cycles for 60s-period correction.

  calib-enable:
    type: boolean
    required: false
    description: |
      Enable RTC calibration mode.
```

## dts/bindings/crypto/linkedsemi,aes256.yaml
```yaml
# Copyright (c) 2024, linkedsemi
# SPDX-License-Identifier: Apache-2.0

description: linkedsemi aes256

compatible: "linkedsemi,aes256"

include: [base.yaml]
```

## dts/bindings/crypto/linkedsemi,otbn-crypto.yaml
```yaml
description: LINKEDSEMI OTBN MODULE

compatible: "linkedsemi,otbn-crypto"

include: [base.yaml, reset-device.yaml]
```

## dts/bindings/crypto/linkedsemi,otbn-ecc-p256.yaml
```yaml
description: LINKEDSEMI OTBN MODULE

compatible: "linkedsemi,otbn-ecc-p256"

include: [base.yaml, reset-device.yaml]


properties:
  otbn-parent:
    type: phandle
    description: phandle to otbn module node
```

## dts/bindings/crypto/linkedsemi,otbn-ecc-p384.yaml
```yaml
description: LINKEDSEMI OTBN MODULE

compatible: "linkedsemi,otbn-ecc-p384"

include: [base.yaml, reset-device.yaml]


properties:
  otbn-parent:
    type: phandle
    description: phandle to otbn module node
```

## dts/bindings/crypto/linkedsemi,otbn-p384-ecdsa.yaml
```yaml
description: LINKEDSEMI OTBN MODULE

compatible: "linkedsemi,otbn-p384-ecdsa"

include: [base.yaml, reset-device.yaml]


properties:
  otbn-parent:
    type: phandle
    description: phandle to otbn module node
```

## dts/bindings/crypto/linkedsemi,otbn-sm2.yaml
```yaml
description: LINKEDSEMI OTBN MODULE

compatible: "linkedsemi,otbn-sm2"

include: [base.yaml, reset-device.yaml]


properties:
  otbn-parent:
    type: phandle
    description: phandle to otbn module node
```
