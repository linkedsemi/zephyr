&spi1 {
	status = "okay";
	pinctrl-0 = <&spi1_sck_pe00
	&spi1_mosi_pe02 &spi1_miso_pe03>;
	pinctrl-names = "default";
    
	cs-gpios = <&gpioe 1 GPIO_ACTIVE_LOW>;
	w5500: w5500@0 {
		compatible = "wiznet,w5500";
		status = "okay";
		reg = <0x0>;
		spi-max-frequency = <10000000>;
		int-gpios = <&gpioa 6 GPIO_ACTIVE_LOW>;
		reset-gpios = <&gpioa 5 GPIO_ACTIVE_LOW>;
	};
};