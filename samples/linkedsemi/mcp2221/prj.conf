## CMakeLists.txt
```
# SPDX-License-Identifier: Apache-2.0

cmake_minimum_required(VERSION 3.20.0)
find_package(Zephyr REQUIRED HINTS $ENV{ZEPHYR_BASE})
project(hid-mouse)

target_include_directories(app PRIVATE src)

FILE(GLOB app_sources src/*.c)
target_sources(app PRIVATE ${app_sources})
```

## Kconfig
```
config USBD_MANUFACTURER
    string "USB device manufacturer string"
    default "Zephyr Project"
    help
      USB device manufacturer string.

config USBD_PRODUCT
    string "USB device product string"
    default "USBD"
    help
      USB device product stringa.

config USBD_PID
    hex "USB device Product ID"
    default 0x0001
    help
      USB device Product ID.

config USBD_VID
    hex "USB device Vendor ID"
    default 0x2fe3
    help
      USB device Vendor ID.

config USBD_SELF_POWERED
    bool "USB device Self-powered attribute"
    default y
    help
      Set the Self-powered attribute in the configuration.

config USBD_REMOTE_WAKEUP
    bool "USB device Remote Wakeup attribute"
    help
      Set the Remote Wakeup attribute in the configuration.

config USBD_MAX_POWER
    int "USB device bMaxPower value"
    default 125
    range 0 250
    help
      bMaxPower value in the configuration in 2 mA units.

choice
    prompt "USB Device Controller"
    default USB_DEVICE_HS_CONTROLLER

config USB_DEVICE_HS_CONTROLLER
    bool "Use zephyr_udc0"
    help
      Use the High Speed USB device controller (zephyr_udc0).

config USB_DEVICE_FS_CONTROLLER
    bool "Use zephyr_udc1"
    help
      Use the Full Speed USB device controller (zephyr_udc1).

endchoice

source "Kconfig.zephyr"
```

## prj.conf
```kconfig
CONFIG_USB_DEVICE_STACK_NEXT=y
CONFIG_USBD_HID_SUPPORT=y
CONFIG_USBD_CDC_ACM_CLASS=y
CONFIG_UART_LINE_CTRL=y
CONFIG_USBD_CDC_ACM_LOG_LEVEL_ERR=y
CONFIG_LOG=y
CONFIG_USBD_LOG_LEVEL_WRN=y
CONFIG_USBD_HID_LOG_LEVEL_WRN=y
CONFIG_UDC_DRIVER_LOG_LEVEL_WRN=y
CONFIG_USBD_PID=0x0007
CONFIG_USBD_VID=0x2fe3
CONFIG_SHELL=y
CONFIG_UDC_BUF_POOL_SIZE=2048
CONFIG_USB_DEVICE_HS_CONTROLLER=y
```

## usbd_fs.overlay
```dts
&zephyr_udc1 {
	 hid_dev_0 {
		compatible = "zephyr,hid-device";
		interface-name = "HID0";
		protocol-code = "none";
		in-polling-period-us = <1000>;
		in-report-size = <32>;
		out-polling-period-us = <1000>;
		out-report-size = <16>;
	};
	cdc_acm_uart0 {
		compatible = "zephyr,cdc-acm-uart";
	};
};
```

## usbd_hs.overlay
```dts
&zephyr_udc0 {
	 hid_dev_0 {
		compatible = "zephyr,hid-device";
		interface-name = "HID0";
		protocol-code = "none";
		in-polling-period-us = <1000>;
		in-report-size = <64>;
		out-polling-period-us = <1000>;
		out-report-size = <64>;
	};
	cdc_acm_uart0 {
		compatible = "zephyr,cdc-acm-uart";
	};
};
```

## src/main.c
```c
/*
 * Copyright (c) 2018 qianfan Zhao
 * Copyright (c) 2018, 2023 Nordic Semiconductor ASA
 *
 * SPDX-License-Identifier: Apache-2.0
 */

#include <string.h>
#include <zephyr/kernel.h>
#include <zephyr/device.h>
#include <zephyr/usb/usb_device.h>
#include <zephyr/usb/usbd.h>
#include <zephyr/usb/class/usb_hid.h>
#include <zephyr/logging/log.h>
#include "hid_bridge.h"
#include <zephyr/sys/ring_buffer.h>
#include <zephyr/drivers/uart.h>
#include <usb_device_init.h>

LOG_MODULE_REGISTER(main, LOG_LEVEL_INF);

#undef HID_USAGE_PAGE
#undef HID_USAGE
#undef HID_COLLECTION
#undef HID_END_COLLECTION
#undef HID_REPORT_SIZE
#undef HID_REPORT_COUNT
#undef HID_INPUT
#undef HID_OUTPUT

#define HID_USAGE_PAGE(page)       0x06, (page) & 0xFF, ((page) >> 8) & 0xFF
#define HID_USAGE(usage)           0x09, (usage)
#define HID_COLLECTION(type)       0xA1, (type)
#define HID_END_COLLECTION         0xC0
#define HID_USAGE_MIN(min)         0x19, (min)
#define HID_USAGE_MAX(max)         0x29, (max)
#define HID_LOGICAL_MIN(min)       0x15, (min)
#define HID_LOGICAL_MAX(max)       0x25, (max)
#define HID_REPORT_SIZE(size)      0x75, (size)
#define HID_REPORT_COUNT(count)    0x95, (count)
#define HID_INPUT(flags)           0x81, (flags)
#define HID_OUTPUT(flags)          0x91, (flags)

#define HID_COLLECTION_APPLICATION 0x01

static const uint8_t hid_report_desc[] = {
    HID_USAGE_PAGE(0xFF00),
    HID_USAGE(0x01),
    HID_COLLECTION(HID_COLLECTION_APPLICATION),
    // Input Report
    HID_USAGE_MIN(0x01),
    HID_USAGE_MAX(0x40),
    HID_LOGICAL_MIN(0x01),
    HID_LOGICAL_MAX(0x40),
    HID_REPORT_SIZE(8),
    HID_REPORT_COUNT(64),
    HID_INPUT(0x00),
    // Output Report
    HID_USAGE_MIN(0x01),
    HID_USAGE_MAX(0x40),
    HID_OUTPUT(0x00),
    HID_END_COLLECTION
};

static void usbd_msg_cb(struct usbd_context *const ctx, const struct usbd_msg *msg);

static int enable_usb_device_next(void)
{
	struct usbd_context *sample_usbd;
	int err;

	sample_usbd = usbd_init_device(usbd_msg_cb);
	if (sample_usbd == NULL) {
		LOG_ERR("Failed to initialize USB device");
		return -ENODEV;
	}

	err = usbd_enable(sample_usbd);
	if (err) {
		LOG_ERR("Failed to enable device support");
		return err;
	}

	LOG_DBG("USB device support enabled");

	return 0;
}

static struct hid_bridge hid;

static void int_in_ok_cb(const struct device *dev)
{
}

static int hid_ep_write(struct hid_bridge *hid, void *data, uint8_t length)
{
	return hid_int_ep_write(hid->user_data, data, length, NULL);
}

static void int_out_ready_cb(const struct device *dev, const uint8_t *buf, const uint16_t len)
{
	hid_bridge_raw_event(&hid, buf);
}

static const struct hid_ops ops = {
	.int_in_ready = int_in_ok_cb,
	.int_out_ready = int_out_ready_cb,
};


#define RING_BUF_SIZE 1024
static uint8_t ring_buffer[RING_BUF_SIZE];
static struct ring_buf ringbuf;

static inline void print_baudrate(const struct device *dev)
{
	uint32_t baudrate;
	int ret;

	ret = uart_line_ctrl_get(dev, UART_LINE_CTRL_BAUD_RATE, &baudrate);
	if (ret) {
		LOG_WRN("Failed to get baudrate, ret code %d", ret);
	} else {
		LOG_INF("Baudrate %u", baudrate);
	}
}

static void usbd_msg_cb(struct usbd_context *const ctx, const struct usbd_msg *msg)
{
	LOG_INF("USBD message: %s", usbd_msg_type_string(msg->type));

	if (usbd_can_detect_vbus(ctx)) {
		if (msg->type == USBD_MSG_VBUS_READY) {
			if (usbd_enable(ctx)) {
				LOG_ERR("Failed to enable device support");
			}
		}

		if (msg->type == USBD_MSG_VBUS_REMOVED) {
			if (usbd_disable(ctx)) {
				LOG_ERR("Failed to disable device support");
			}
		}
	}

	if (msg->type == USBD_MSG_CDC_ACM_LINE_CODING) {
		print_baudrate(msg->dev);
	}
}

static void interrupt_handler(const struct device *dev, void *user_data)
{
	ARG_UNUSED(user_data);
	static bool rx_throttled;

	while (uart_irq_update(dev) && uart_irq_is_pending(dev)) {
		if (!rx_throttled && uart_irq_rx_ready(dev)) {
			int recv_len, rb_len;
			uint8_t buffer[64];
			size_t len = MIN(ring_buf_space_get(&ringbuf),
					 sizeof(buffer));

			if (len == 0) {
				/* Throttle because ring buffer is full */
				uart_irq_rx_disable(dev);
				rx_throttled = true;
				continue;
			}

			recv_len = uart_fifo_read(dev, buffer, len);
			if (recv_len < 0) {
				LOG_ERR("Failed to read UART FIFO");
				recv_len = 0;
			};

			rb_len = ring_buf_put(&ringbuf, buffer, recv_len);
			if (rb_len < recv_len) {
				LOG_ERR("Drop %u bytes", recv_len - rb_len);
			}

			LOG_DBG("tty fifo -> ringbuf %d bytes", rb_len);
			if (rb_len) {
				uart_irq_tx_enable(dev);
			}
		}

		if (uart_irq_tx_ready(dev)) {
			uint8_t buffer[64];
			int rb_len, send_len;

			rb_len = ring_buf_get(&ringbuf, buffer, sizeof(buffer));
			if (!rb_len) {
				LOG_DBG("Ring buffer empty, disable TX IRQ");
				uart_irq_tx_disable(dev);
				continue;
			}

			if (rx_throttled) {
				uart_irq_rx_enable(dev);
				rx_throttled = false;
			}

			send_len = uart_fifo_fill(dev, buffer, rb_len);
			if (send_len < rb_len) {
				LOG_ERR("Drop %d bytes", rb_len - send_len);
			}

			LOG_DBG("ringbuf -> tty fifo %d bytes", send_len);
		}
	}
}

int main(void)
{
	int ret;
	const struct device *hid_dev = DEVICE_DT_GET_ONE(zephyr_hid_device);
	const struct device *uart_dev = DEVICE_DT_GET_ONE(zephyr_cdc_acm_uart);

	if (hid_dev == NULL || uart_dev == NULL) {
		LOG_ERR("Cannot get Device");
		return 0;
	}

	usb_hid_register_device(hid_dev,
				hid_report_desc, sizeof(hid_report_desc),
				&ops);

	usb_hid_init(hid_dev);
	hid_bridge_init(&hid, hid_ep_write, (void *)hid_dev);

	ring_buf_init(&ringbuf, sizeof(ring_buffer), ring_buffer);

	ret = enable_usb_device_next();
	if (ret != 0) {
		LOG_ERR("Failed to enable USB");
		return 0;
	}
	uart_irq_callback_set(uart_dev, interrupt_handler);
	uart_irq_rx_enable(uart_dev);

	while (true) {
		k_msleep(1000);
	}
	return 0;
}
```

## src/hid_bridge.c
```c
#include "hid_bridge.h"
#include <string.h>

/* Commands codes in a raw output report */
enum {
    MCP2221_I2C_WR_DATA = 0x90,
    MCP2221_I2C_WR_NO_STOP = 0x94,
    MCP2221_I2C_RD_DATA = 0x91,
    MCP2221_I2C_RD_RPT_START = 0x93,
    MCP2221_I2C_GET_DATA = 0x40,
    MCP2221_I2C_PARAM_OR_STATUS	= 0x10,
    MCP2221_I2C_SET_SPEED = 0x20,
    MCP2221_I2C_CANCEL = 0x10,
    MCP2221_GPIO_SET = 0x50,
    MCP2221_GPIO_GET = 0x51,
    MCP2221_SET_SRAM_SETTINGS = 0x60,
    MCP2221_GET_SRAM_SETTINGS = 0x61,
    MCP2221_READ_FLASH_DATA = 0xb0,
};

/* Response codes in a raw input report */
enum {
    MCP2221_SUCCESS = 0x00,
    MCP2221_I2C_ENG_BUSY = 0x01,
    MCP2221_I2C_START_TOUT = 0x12,
    MCP2221_I2C_STOP_TOUT = 0x62,
    MCP2221_I2C_WRADDRL_TOUT = 0x23,
    MCP2221_I2C_WRDATA_TOUT = 0x44,
    MCP2221_I2C_WRADDRL_NACK = 0x25,
    MCP2221_I2C_MASK_ADDR_NACK = 0x40,
    MCP2221_I2C_WRADDRL_SEND = 0x21,
    MCP2221_I2C_ADDR_NACK = 0x25,
    MCP2221_I2C_READ_PARTIAL = 0x54,
    MCP2221_I2C_READ_COMPL = 0x55,
    MCP2221_ALT_F_NOT_GPIOV = 0xEE,
    MCP2221_ALT_F_NOT_GPIOD = 0xEF,
};

typedef union
{
    struct
    {
        uint8_t command;
        uint8_t byte_l;
        uint8_t byte_h;
        uint8_t address;
        uint8_t payload[0];
    } mcp2221_i2c;
    struct
    {
        uint8_t command;
        uint8_t reserved;
        uint8_t cancle_transfer;
        uint8_t set_speed;
        uint8_t payload[0];
    } mcp2221_param;
    uint8_t response_raw[64];
} mcp2221_command;

typedef union
{
    struct
    {
        uint8_t response_echo;
        uint8_t is_busy;
        uint8_t response_code; // busy 时，设置这个告诉 host 为啥 busy 啦
    } mcp2221_i2c;

    struct
    {
        uint8_t response_echo;
        uint8_t cmd_complete;
        uint8_t reserved; // busy 时，设置这个告诉 host 为啥 busy 啦
        uint8_t data_len;
        uint8_t data[0];
    } mcp2221_i2c_data;

    struct
    {
        uint8_t response_echo;
        uint8_t cmd_complete;
        uint8_t cancle_transfer;
        uint8_t reserved[5];
        uint8_t i2c_commu_state;
    } mcp2221_param;

    uint8_t response_raw[64];
} mcp2221_response;

static uint8_t i2c_current_state = 0;

static int mcp2221_i2c_write_handle(struct hid_bridge *hid, mcp2221_command *command)
{
    mcp2221_response response = {0};
    /* TODO: 解 command，然后执行相关动作 */

    response.mcp2221_i2c.response_echo = command->mcp2221_i2c.command;
    response.mcp2221_i2c.is_busy = 0;
    hid_bridge_raw_send(hid, response.response_raw);
    i2c_current_state = MCP2221_SUCCESS;

    return 0;
}

static int mcp2221_i2c_param_handle(struct hid_bridge *hid, mcp2221_command *command)
{
    /* hid class 层会拿着这个 buffer 直接到驱动层使用，如果这里返回了，驱动层还没将数据发送出去，buffer 中的数据将会失效，因此这里将 buffer 开在 data 区 */
    static __attribute__((aligned(32))) mcp2221_response response = {0};
    /* TODO: 解 command，然后执行相关动作 */

    /* 构造 response 包 */
    response.mcp2221_param.response_echo = command->mcp2221_param.command;
    response.mcp2221_param.cmd_complete = 0;
    /* 返回上次 i2c 通信的状态, 这里写为 i2c_current_state，这可能得根据义务去改 */
    response.mcp2221_param.i2c_commu_state = i2c_current_state;
    hid_bridge_raw_send(hid, response.response_raw);

    return 0;
}

static int mcp2221_i2c_read_handle(struct hid_bridge *hid, mcp2221_command *command)
{
    static __attribute__((aligned(32))) mcp2221_response response = {0};
    /* TODO: 解 command，然后执行相关动作 */

    i2c_current_state = MCP2221_I2C_READ_COMPL; // 设置为读完成

    response.mcp2221_i2c.response_echo = command->mcp2221_i2c.command;
    response.mcp2221_i2c.is_busy = 0;
    hid_bridge_raw_send(hid, response.response_raw);
    return 0;
}

static int mcp2221_i2c_get_data_handle(struct hid_bridge *hid, mcp2221_command *command)
{
    static __attribute__((aligned(32))) mcp2221_response response = {0};
    /* TODO: 解 command，然后执行相关动作 */
    response.mcp2221_i2c_data.response_echo = command->mcp2221_i2c.command;
    response.mcp2221_i2c_data.cmd_complete = 0;
    response.mcp2221_i2c_data.data_len = strlen("hello world!!");
    strcpy(response.mcp2221_i2c_data.data, "hello world!!");
    hid_bridge_raw_send(hid, response.response_raw);

    return 0;
}

int hid_bridge_init(struct hid_bridge *hid, send_data_2_host send_data, void *user_data)
{
    hid->send_data_2_host = send_data;
    hid->user_data = user_data;
    return 0;
}

int hid_bridge_raw_event(struct hid_bridge *hid, const uint8_t raw_data[64])
{
    /* 这里走 mcp2221 的协议 */
    switch (raw_data[0])
    {
        case MCP2221_I2C_WR_DATA:
            mcp2221_i2c_write_handle(hid, (mcp2221_command *)raw_data);
            break;
        case MCP2221_I2C_PARAM_OR_STATUS:
            mcp2221_i2c_param_handle(hid, (mcp2221_command *)raw_data);
            break;
        case MCP2221_I2C_RD_DATA:
            mcp2221_i2c_read_handle(hid, (mcp2221_command *)raw_data);
            break;
        case MCP2221_I2C_GET_DATA:
            mcp2221_i2c_get_data_handle(hid, (mcp2221_command *)raw_data);
            break;
        default:
            break;
    }

    return 0;
}

int hid_bridge_raw_send(struct hid_bridge *hid, uint8_t raw_data[64])
{
    int res = 0;
    if (hid->send_data_2_host)
    {
        res = hid->send_data_2_host(hid, raw_data, 64);
    }

    return res;
}
```

## src/hid_bridge.h
```c
#ifndef __HID_BRIDGE_H__
#define __HID_BRIDGE_H__

#include <stdint.h>

#ifdef __cplusplus
extern "C" {
#endif

struct hid_bridge
{
    int (*send_data_2_host)(struct hid_bridge *hid, void *data, uint8_t length);
    void *user_data;
};

typedef int (*send_data_2_host)(struct hid_bridge *hid, void *data, uint8_t length);

int hid_bridge_init(struct hid_bridge *hid, send_data_2_host send_data, void *user_data);
int hid_bridge_raw_event(struct hid_bridge *hid, const uint8_t raw_data[64]);
int hid_bridge_raw_send(struct hid_bridge *hid, uint8_t raw_data[64]);

#ifdef __cplusplus
}
#endif

#endif //__HID_BRIDGE_H__
```

## src/usb_device_init.c
```c
/*
 * Copyright (c) 2023 Nordic Semiconductor ASA
 *
 * SPDX-License-Identifier: Apache-2.0
 */

#include <stdint.h>

#include <zephyr/device.h>
#include <zephyr/usb/usbd.h>
#include <zephyr/usb/bos.h>

#include <zephyr/logging/log.h>
LOG_MODULE_REGISTER(usb_device_init);

#if defined(CONFIG_USB_DEVICE_HS_CONTROLLER)
#define UDC_NODE DT_NODELABEL(zephyr_udc0)
#elif defined(CONFIG_USB_DEVICE_FS_CONTROLLER)
#define UDC_NODE DT_NODELABEL(zephyr_udc1)
#else
#error "No UDC node selected"
#endif

USBD_DEVICE_DEFINE(sample_usbd,
		   DEVICE_DT_GET(UDC_NODE),
		   CONFIG_USBD_VID, CONFIG_USBD_PID);
/* doc device instantiation end */

/* doc string instantiation start */
USBD_DESC_LANG_DEFINE(lang);
USBD_DESC_MANUFACTURER_DEFINE(sample_mfr, CONFIG_USBD_MANUFACTURER);
USBD_DESC_PRODUCT_DEFINE(product, CONFIG_USBD_PRODUCT);
USBD_DESC_SERIAL_NUMBER_DEFINE(sn);
/* doc string instantiation end */

USBD_DESC_CONFIG_DEFINE(fs_cfg_desc, "FS Configuration");
USBD_DESC_CONFIG_DEFINE(hs_cfg_desc, "HS Configuration");

/* doc configuration instantiation start */
static const uint8_t attributes = (IS_ENABLED(CONFIG_USBD_SELF_POWERED) ?
				   USB_SCD_SELF_POWERED : 0) |
				  (IS_ENABLED(CONFIG_USBD_REMOTE_WAKEUP) ?
				   USB_SCD_REMOTE_WAKEUP : 0);

/* Full speed configuration */
USBD_CONFIGURATION_DEFINE(fs_config,
			  attributes,
			  CONFIG_USBD_MAX_POWER, &fs_cfg_desc);

/* High speed configuration */
USBD_CONFIGURATION_DEFINE(hs_config,
			  attributes,
			  CONFIG_USBD_MAX_POWER, &hs_cfg_desc);
/* doc configuration instantiation end */

static void sample_fix_code_triple(struct usbd_context *uds_ctx,
				   const enum usbd_speed speed)
{
	/* Always use class code information from Interface Descriptors */
	if (IS_ENABLED(CONFIG_USBD_CDC_ACM_CLASS) ||
	    IS_ENABLED(CONFIG_USBD_CDC_ECM_CLASS) ||
	    IS_ENABLED(CONFIG_USBD_CDC_NCM_CLASS) ||
	    IS_ENABLED(CONFIG_USBD_AUDIO2_CLASS)) {
		/*
		 * Class with multiple interfaces have an Interface
		 * Association Descriptor available, use an appropriate triple
		 * to indicate it.
		 */
		usbd_device_set_code_triple(uds_ctx, speed,
					    USB_BCC_MISCELLANEOUS, 0x02, 0x01);
	} else {
		usbd_device_set_code_triple(uds_ctx, speed, 0, 0, 0);
	}
}

struct usbd_context *usbd_init_device(usbd_msg_cb_t msg_cb)
{
	int err;

	/* doc add string descriptor start */
	err = usbd_add_descriptor(&sample_usbd, &lang);
	if (err) {
		LOG_ERR("Failed to initialize language descriptor (%d)", err);
		return NULL;
	}

	err = usbd_add_descriptor(&sample_usbd, &sample_mfr);
	if (err) {
		LOG_ERR("Failed to initialize manufacturer descriptor (%d)", err);
		return NULL;
	}

	err = usbd_add_descriptor(&sample_usbd, &product);
	if (err) {
		LOG_ERR("Failed to initialize product descriptor (%d)", err);
		return NULL;
	}

	err = usbd_add_descriptor(&sample_usbd, &sn);
	if (err) {
		LOG_ERR("Failed to initialize SN descriptor (%d)", err);
		return NULL;
	}
	/* doc add string descriptor end */

	if (usbd_caps_speed(&sample_usbd) == USBD_SPEED_HS) {
		err = usbd_add_configuration(&sample_usbd, USBD_SPEED_HS,
					     &hs_config);
		if (err) {
			LOG_ERR("Failed to add High-Speed configuration");
			return NULL;
		}

		err = usbd_register_all_classes(&sample_usbd, USBD_SPEED_HS, 1);
		if (err) {
			LOG_ERR("Failed to add register classes");
			return NULL;
		}

		sample_fix_code_triple(&sample_usbd, USBD_SPEED_HS);
	}

	/* doc configuration register start */
	err = usbd_add_configuration(&sample_usbd, USBD_SPEED_FS,
				     &fs_config);
	if (err) {
		LOG_ERR("Failed to add Full-Speed configuration");
		return NULL;
	}
	/* doc configuration register end */

	/* doc functions register start */
	err = usbd_register_all_classes(&sample_usbd, USBD_SPEED_FS, 1);
	if (err) {
		LOG_ERR("Failed to add register classes");
		return NULL;
	}
	/* doc functions register end */

	sample_fix_code_triple(&sample_usbd, USBD_SPEED_FS);

	if (msg_cb != NULL) {
		/* doc device init-and-msg start */
		err = usbd_msg_register_cb(&sample_usbd, msg_cb);
		if (err) {
			LOG_ERR("Failed to register message callback");
			return NULL;
		}
		/* doc device init-and-msg end */
	}

	/* doc device init start */
	err = usbd_init(&sample_usbd);
	if (err) {
		LOG_ERR("Failed to initialize device support");
		return NULL;
	}
	/* doc device init end */

	return &sample_usbd;
}
```

## src/usb_device_init.h
```c
#ifndef USB_DEVICE_INIT_H
#define USB_DEVICE_INIT_H

#include <zephyr/usb/usbd.h>

struct usbd_context *usbd_init_device(usbd_msg_cb_t msg_cb);

#endif /* USB_DEVICE_INIT_H */
```
