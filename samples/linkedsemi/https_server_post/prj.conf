## CMakeLists.txt
```
# SPDX-License-Identifier: Apache-2.0

cmake_minimum_required(VERSION 3.20.0)

set(TOOLCHAIN_HAS_NEWLIB y)

find_package(Zephyr REQUIRED HINTS $ENV{ZEPHYR_BASE})
project(hello_world)

target_sources(app PRIVATE src/main.c)
add_definitions(-DWOLFSSL_ZEPHYR)
add_definitions(-DWOLFSSL_USER_SETTINGS)
```

## prj.conf
```kconfig
# Kernel options
CONFIG_CPP=y
CONFIG_REQUIRES_FULL_LIBCPP=y

CONFIG_POSIX_API=y

CONFIG_MAIN_STACK_SIZE=40960
CONFIG_ENTROPY_GENERATOR=y
CONFIG_INIT_STACKS=y
CONFIG_COMMON_LIBC_MALLOC_ARENA_SIZE=131072

# Enable wolfSSH
CONFIG_WOLFSSH=y
CONFIG_WOLFSSH_SETTINGS_FILE="wolfssh_user_settings_nofs.h"

# Pthreads
CONFIG_PTHREAD_IPC=y

# Clock for time()
CONFIG_POSIX_CLOCK=y

# Networking
CONFIG_NETWORKING=y
# CONFIG_NET_TEST=y
CONFIG_NET_IPV4=y
CONFIG_NET_IPV6=n
CONFIG_NET_TCP=y
CONFIG_NET_SOCKETS=y
CONFIG_NET_SOCKETS_POSIX_NAMES=y

CONFIG_NET_TEST=n
CONFIG_NET_LOOPBACK=n

# Network driver config
CONFIG_TEST_RANDOM_GENERATOR=y

# Network address config
CONFIG_NET_CONFIG_SETTINGS=y
CONFIG_NET_CONFIG_NEED_IPV4=y
CONFIG_NET_CONFIG_MY_IPV4_ADDR="192.168.1.123"
CONFIG_NET_CONFIG_PEER_IPV4_ADDR="192.168.1.124"
CONFIG_NET_CONFIG_MY_IPV4_GW="192.168.1.2"

CONFIG_NET_PKT_TX_COUNT=10

# Logging
CONFIG_PRINTK=y
CONFIG_LOG=y
CONFIG_LOG_MODE_IMMEDIATE=y
# CONFIG_WOLFSSH_DEBUG=y
# CONFIG_WOLFSSL_DEBUG=y
# CONFIG_DEBUG=y

# Enable logging using RTT and UART
#CONFIG_CBPRINTF_LIBC_SUBSTS=y
#CONFIG_CBPRINTF_FP_SUPPORT=y
#CONFIG_CONSOLE=y
#CONFIG_LOG_BACKEND_UART=y
#CONFIG_LOG_BUFFER_SIZE=15360

# TLS configuration
CONFIG_WOLFSSL=y
CONFIG_WOLFSSL_BUILTIN=y
CONFIG_WOLFSSL_SETTINGS_FILE="wolfssl_user_settings_nofs.h"

CONFIG_WOLFSSL_TLS_VERSION_1_2=y
CONFIG_WOLFSSL_KEY_EXCHANGE_ALL_ENABLED=y
CONFIG_WOLFSSL_CIPHER_ALL_ENABLED=y
CONFIG_WOLFSSL_MAC_ALL_ENABLED=y
CONFIG_WOLFSSL_HMAC_DRBG_ENABLED=y
```

## boards/lsqsh_evb_cpu1.conf
```kconfig
CONFIG_CACHE=y
CONFIG_CACHE_MANAGEMENT=y
CONFIG_CACHE_LINKEDSEMI=y
```

## src/main.c
```c
/*
 * Copyright (c) 2012-2014 Wind River Systems, Inc.
 *
 * SPDX-License-Identifier: Apache-2.0
 */

#include <stdio.h>
#include <stdio.h>
#include <stdlib.h>
#include <string.h>
#include <wolfssl/wolfcrypt/settings.h>
#include <wolfssl/ssl.h>
#include <zephyr/kernel.h>
#include <zephyr/posix/arpa/inet.h>

#define LOG_LEVEL LOG_LEVEL_DBG
#include <zephyr/logging/log.h>
LOG_MODULE_REGISTER(main);

uint8_t server_cert[] = "-----BEGIN CERTIFICATE-----\n"
                        "MIIDSTCCAjECFH3QXyfwVWnXKo0NBGx4Y+IrVQ50MA0GCSqGSIb3DQEBCwUAMGEx\n"
                        "CzAJBgNVBAYTAkNOMQswCQYDVQQIDAJDTjELMAkGA1UEBwwCQ04xCzAJBgNVBAoM\n"
                        "AkNOMQswCQYDVQQLDAJDTjELMAkGA1UEAwwCQ04xETAPBgkqhkiG9w0BCQEWAkNO\n"
                        "MB4XDTI0MDgxNDA5MzQ1NVoXDTI1MDgxNDA5MzQ1NVowYTELMAkGA1UEBhMCQ04x\n"
                        "CzAJBgNVBAgMAkNOMQswCQYDVQQHDAJDTjELMAkGA1UECgwCQ04xCzAJBgNVBAsM\n"
                        "AkNOMQswCQYDVQQDDAJDTjERMA8GCSqGSIb3DQEJARYCQ04wggEiMA0GCSqGSIb3\n"
                        "DQEBAQUAA4IBDwAwggEKAoIBAQDI2SHfvLPiVkN8OAj+kdkBTNIfwHjYqHVk5rza\n"
                        "QQy/q9QKRWkXfDiP2k/qPCFGEIaEpm6KTClyVw0IoZo4PdWqLl4S1DBkkfFg5CYE\n"
                        "4jR0vHIaqm0KwdR1xQRIN2cbm76MCoF9MyCTmQhrp11fjSJyu3MxwnbmKqvknWQ6\n"
                        "9QDJlGQK8UfBridk3Njeq8WaHQ/Z3+KSrPyFdPBgV0lTvqOPe+deCd/eTtUS4CPP\n"
                        "MTvQSXL2kK9M5b7TyRFo1KvkuOhSzbYzW8i22mf3IRvmLw4EDzlA46XbOmogrl3I\n"
                        "lLiG98jpEiW66P8crlxGw3Ednv22M9qNLDFHlccPKZo0J/yDAgMBAAEwDQYJKoZI\n"
                        "hvcNAQELBQADggEBAC877eQK4rBEUWW1/IK2IiWvvxBZfH5JUAYwY3ncBC07bYPI\n"
                        "zo7n4UhVfjC9saX+p6njIoxJlLhruKX2eu1RmurszoZeJQgLVgWUpl8VFfAKunpV\n"
                        "WCDibDpTdWpl7Dxbwar+z2oNj42BZDjj0MWN8TEq9E5JGt0l+iU4dY4j/3gPtN64\n"
                        "G3F/RvMJfbTO0BYQYwxulpnjvGlwBPWnMxA1ZXpX6n71xmpX5x4UsNe6kZIz8Aye\n"
                        "8c06cIcez0T+JLTZhhKAyDlxTGnM+IAGbLz96MY06k3tj3Bnef1JtiE5+2qybniS\n"
                        "s9J2kYWMZf2kmj3jTP8ta1AyqRLZ/TS92/OdCMs=\n"
                        "-----END CERTIFICATE-----\n";

uint8_t server_key[] = "-----BEGIN PRIVATE KEY-----\n"
                       "MIIEvQIBADANBgkqhkiG9w0BAQEFAASCBKcwggSjAgEAAoIBAQDI2SHfvLPiVkN8\n"
                       "OAj+kdkBTNIfwHjYqHVk5rzaQQy/q9QKRWkXfDiP2k/qPCFGEIaEpm6KTClyVw0I\n"
                       "oZo4PdWqLl4S1DBkkfFg5CYE4jR0vHIaqm0KwdR1xQRIN2cbm76MCoF9MyCTmQhr\n"
                       "p11fjSJyu3MxwnbmKqvknWQ69QDJlGQK8UfBridk3Njeq8WaHQ/Z3+KSrPyFdPBg\n"
                       "V0lTvqOPe+deCd/eTtUS4CPPMTvQSXL2kK9M5b7TyRFo1KvkuOhSzbYzW8i22mf3\n"
                       "IRvmLw4EDzlA46XbOmogrl3IlLiG98jpEiW66P8crlxGw3Ednv22M9qNLDFHlccP\n"
                       "KZo0J/yDAgMBAAECggEARWBHJJ7sbdKJRgefB7v+PsY30JLtyzzJLBzNgAA3NJ/Y\n"
                       "QuH97ohQi1QIBatWfPqpVHmetjOfn2i1TlVvzVyCiOGySgO0YZDN1T+JaGdwYiBT\n"
                       "s6VJvAz+4901YPKOMYmnFH1ug/4ckw8pyvHJPX+lNgdMv5Ph+RglPvckz36gkoAL\n"
                       "wHwD0PKWIi6uW0z/a0pMR3GIWET8wPmIEU094ii4dW1UzvBgiZUwIoj6EMIAY4vp\n"
                       "A56pk+us44nyMWnIOz9IkAIXt3b6evI+LhDX/27Ih9njQXfKlAHrx98LhOrji4Sz\n"
                       "LdtVPYWBJIIWVuWq9iNCO4bO3JP9ARnVB2wK6B5RpQKBgQD0yIa7ZJ300F3SW16r\n"
                       "/SU9hBaJ3Me7WgPO8qsDaNV1gXKm848wtmdfxFAjAi8VmwqJ5d8kru70bPzLL0GY\n"
                       "lEFJf0w7nCa3zXono/wWmK+UcWpwqSllVJWZjdebkmZ5+QTgnbqxSh36Q+M4ADrC\n"
                       "XTPJOcEVWoXz3y3hpjWPbLsURwKBgQDSDTea4O3aK+eHRgszsvGpy+QGrI0B0adM\n"
                       "cs8p9rXU4O8TNk35w+kLbUxXm/Hp+65lcAd9o7BikBxCBntzM0BLfrYsutVCd5GU\n"
                       "CKGreByKmidQCz1KbdDNXUE2ywsY8WIacpaVmtvIPOaigjt3+A+CmPfkPc6cY2o3\n"
                       "9dvGkDPf5QKBgQC64+NibebfxLrtYc99dvCY8CGZLpTcaVShC8wf9UmMxsG30BuS\n"
                       "cKGqj6Mzp3Y1g8NfF7/wLRPKUPANXc4yZXcXW3bjyEwTZ3GNlHli8z6TEqjWzYEK\n"
                       "mbMCozZr1DIjjEn6CNNCizkqG+z+k8ZJIYnpaAwQdqXxVYOdVh5sm/KV/wKBgAZF\n"
                       "uMRaNSAPsZE7iTgY/thoKz37xxYn0YwZ3Y/OOy3JLbpwI7HypLHfqKjxEi8/gbyr\n"
                       "tL2OtsSqsv1Rvjv5atEWTpBVX+rlMSavf0xkgM2uvr/IJiNj1hlb0Ie3VnR/OMO7\n"
                       "aj27axa2oth1dRsnACeRM83P/qxy14gmQlLSmYn1AoGAAOvR+CJ5sh31zW0CnPQj\n"
                       "MsfURUxlk8h/F22MikFxIhnnDO5iQV1QITtsG5pgjKmw8XKWtWRKn5mNabP5yQ+w\n"
                       "PWJth0Z7ug2v4BW+VZetl75jExXBhR7l8MdAeatpYJpGb4NRSKMsOhYkDZwRnRez\n"
                       "7gIomK+77VVqHGZ/ykNI3dM=\n"
                       "-----END PRIVATE KEY-----\n";

long atol(const char *s)
{
    return strtol(s, NULL, 10);
}

int base64_decode(const char *in, char *out)
{
    const char *b64 = "ABCDEFGHIJKLMNOPQRSTUVWXYZabcdefghijklmnopqrstuvwxyz0123456789+/";
    int val = 0, valb = -8;
    for (; *in; in++) {
        unsigned char c = *in;
        if (c == '=')
            break;
        c = strchr(b64, c) - b64;
        val = (val << 6) + c;
        valb += 6;
        if (valb >= 0) {
            *out++ = (char)((val >> valb) & 0xFF);
            valb -= 8;
        }
    }
    return 0;
}

#define DEFAULT_PORT 443
#define BUFFER_SIZE  4096

void handle_client(WOLFSSL *ssl)
{
    const char *response;
    char buffer[BUFFER_SIZE];
    int bytes = 0;
    bytes = wolfSSL_read(ssl, buffer, sizeof(buffer) - 1);
    if (bytes > 0) {
        for (int i = 0; i < bytes; i++) {
            putchar(buffer[i]);
        }
    }

    char *auth = strstr(buffer, "Authorization: Basic ");
    if (auth) {
        char b64[256], creds[256];
        sscanf(auth, "Authorization: Basic %s", b64);
        base64_decode(b64, creds);
        if (strcmp(creds, "root:zephyr0penBmc") != 0) {
            printf("creds: %s\n", creds);
            const char *resp = "HTTP/1.1 401 Unauthorized\r\n\r\n";
            wolfSSL_write(ssl, resp, strlen(resp));
            return;
        }
    } else {
        goto BAD_REQUEST;
    }

    if (strstr(buffer, "POST /redfish/v1/UpdateService/")) {
        char *cl_header = strstr(buffer, "Content-Length: ");
        long content_length = cl_header ? atol(cl_header + 16) : 0;
        // printf("\n\ncontent_length: %ld\n", content_length);

        char *body_ptr = strstr(buffer, "\r\n\r\n");
        int header_size = 0;
        if (body_ptr != NULL) {
            body_ptr += 4;
            header_size = body_ptr - buffer;

            int total_read = bytes - header_size;

            printf("\n--------------------------------\n");
            for (int i = 0; i < total_read; i++) {
                putchar(body_ptr[i]);
            }

            while (total_read < content_length) {
                bytes = wolfSSL_read(
                    ssl,
                    buffer,
                    (content_length - total_read > BUFFER_SIZE) ? BUFFER_SIZE : (content_length - total_read));
                if (bytes <= 0)
                    break;
                total_read += bytes;

                for (int i = 0; i < bytes; i++) {
                    putchar(buffer[i]);
                }
            }
            printf("\n--------------------------------\n");

            const char *response = "HTTP/1.1 200 OK\r\n"
                                   "Content-Type: application/json\r\n"
                                   "Content-Length: 17\r\n"
                                   "\r\n"
                                   "{\"v1\": \"Redfish\"}";

            wolfSSL_write(ssl, response, strlen(response));
        } else {
            // header_size = bytes;
            goto BAD_REQUEST;
        }

    } else {
        goto NOT_FOUND;
    }

BAD_REQUEST:
    response = "HTTP/1.1 400 Bad Request\r\nContent-Length: 11\r\n\r\nBad Request";
    wolfSSL_write(ssl, response, (int)strlen(response));
    return;
NOT_FOUND:
    response = "HTTP/1.1 404 Not Found\r\nContent-Length: 9\r\n\r\nNot Found";
    wolfSSL_write(ssl, response, (int)strlen(response));
    return;
}

int main()
{
    WOLFSSL_CTX *ctx;
    WOLFSSL *ssl;
    int sockfd, clientfd;
    struct sockaddr_in servAddr, clientAddr;
    socklen_t clientLen = sizeof(clientAddr);

#ifdef DEBUG_WOLFSSH
    wolfSSL_Debugging_ON();
#endif

    wolfSSL_Init();

    ctx = wolfSSL_CTX_new(wolfTLSv1_2_server_method());
    if (ctx == NULL) {
        fprintf(stderr, "wolfSSL_CTX_new error.\n");
        return EXIT_FAILURE;
    }

    if (wolfSSL_CTX_use_certificate_buffer(ctx, server_cert, sizeof(server_cert), SSL_FILETYPE_PEM) != SSL_SUCCESS) {
        fprintf(stderr, "Error loading server certificate.\n");
        return EXIT_FAILURE;
    }

    if (wolfSSL_CTX_use_PrivateKey_buffer(ctx, server_key, sizeof(server_key), SSL_FILETYPE_PEM) != SSL_SUCCESS) {
        fprintf(stderr, "Error loading server key.\n");
        return EXIT_FAILURE;
    }

    sockfd = socket(AF_INET, SOCK_STREAM, 0);
    if (sockfd < 0) {
        LOG_ERR("Socket error");
        return EXIT_FAILURE;
    }

    memset(&servAddr, 0, sizeof(servAddr));
    servAddr.sin_family = AF_INET;
    servAddr.sin_addr.s_addr = INADDR_ANY;
    servAddr.sin_port = htons(DEFAULT_PORT);

    if (bind(sockfd, (struct sockaddr *)&servAddr, sizeof(servAddr)) < 0) {
        LOG_ERR("Bind error");
        close(sockfd);
        return EXIT_FAILURE;
    }

    if (listen(sockfd, 5) < 0) {
        LOG_ERR("Listen error");
        close(sockfd);
        return EXIT_FAILURE;
    }

    printf("Server listening on port %d\n", DEFAULT_PORT);

    while (1) {
        clientfd = accept(sockfd, (struct sockaddr *)&clientAddr, &clientLen);
        if (clientfd < 0) {
            LOG_ERR("Accept error");
            continue;
        }

        ssl = wolfSSL_new(ctx);
        if (ssl == NULL) {
            fprintf(stderr, "wolfSSL_new error.\n");
            close(clientfd);
            continue;
        }

        wolfSSL_set_fd(ssl, clientfd);

        if (wolfSSL_accept(ssl) != SSL_SUCCESS) {
            fprintf(stderr, "wolfSSL_accept error.\n");
        } else {
            handle_client(ssl);
        }

        wolfSSL_shutdown(ssl);
        wolfSSL_free(ssl);
        close(clientfd);
    }

    wolfSSL_CTX_free(ctx);
    wolfSSL_Cleanup();
    close(sockfd);

    return 0;
}
```
