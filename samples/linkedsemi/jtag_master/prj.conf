## CMakeLists.txt
```
# SPDX-License-Identifier: Apache-2.0

cmake_minimum_required(VERSION 3.20.0)

find_package(Zephyr REQUIRED HINTS $ENV{ZEPHYR_BASE})
project(jtag_master)

target_sources(app PRIVATE src/main.c)
```

## sample.yaml
```
sample:
  description: jtag master sample, the simplest Zephyr
    application
  name: jtag_master_test
common:
  tags: introduction
  integration_platforms:
    - native_sim
  harness: console
  harness_config:
    type: one_line
    regex:
      - "Hello World! (.*)"
tests:
  sample.basic.helloworld:
    tags: introduction
```

## prj.conf
```kconfig
# nothing here
CONFIG_JTAG=y
CONFIG_SHELL=y
```

## boards/lsqsh_evb_cpu1.overlay
```dts
/ {
    aliases {
        testjtag = &jtag3;
    };
};

&jtag3 {
    pinctrl-0 = <&mjtag3_tck_pf04 &mjtag3_tms_pf08 &mjtag3_tdi_pf06 &mjtag3_tdo_pf10>;
    pinctrl-1 = <&mjtag3_gpio_pf04 &mjtag3_gpio_pf08 &mjtag3_gpio_pf06>;
    tck-gpios = <&gpiof 4 0>;
    tms-gpios = <&gpiof 8 0>;
    tdi-gpios = <&gpiof 6 0>;
    tdo-gpios = <&gpiof 10 0>;
    pinctrl-names = "default", "priv_start";
    status = "okay";
};

// &jtag1 {
//     pinctrl-0 = <&mjtag1_tck_pn06 &mjtag1_tms_pn07 &mjtag1_tdi_pn09 &mjtag1_tdo_pn08>;
//     pinctrl-1 = <&mjtag1_gpio_pn06 &mjtag1_gpio_pn07 &mjtag1_gpio_pn09>;
//     tck-gpios = <&gpion 6 0>;
//     tms-gpios = <&gpion 7 0>;
//     tdi-gpios = <&gpion 9 0>;
//     tdo-gpios = <&gpion 8 0>;
//     pinctrl-names = "default", "priv_start";
//     status = "disabled";
// };
```

## src/main.c
```c
/*
 * Copyright (c) 2012-2014 Wind River Systems, Inc.
 *
 * SPDX-License-Identifier: Apache-2.0
 */

#include <zephyr/kernel.h>
#include <zephyr/device.h>
#include <zephyr/drivers/jtag.h>
#include <stdlib.h>
#include <stdio.h>
#include <string.h>

static uint8_t tdi_buffer[512];
uint8_t id_code[4] = {0x3d,0x56,0x0,0x10};  //GD32 id-code：0x1000563d
uint8_t ir_scan_value = 0x1;
uint8_t dr_scan_value = 0x0;
bool state = false;
int main(void)
{
	printf("start jtag master test! %s\n", CONFIG_BOARD_TARGET);

	const struct device *const jtag = DEVICE_DT_GET(DT_ALIAS(testjtag));

	if (!device_is_ready(jtag))
	{
		__ASSERT(0,"JTAG device is not ready");
	}

	state = true;
	if(!jtag_tap_set(jtag, TAP_RESET))
		state = false;
	if(state == false)
	{
		state = true;
		if(!jtag_ir_scan(jtag, 0x5, &ir_scan_value, tdi_buffer,TAP_IDLE))
			state = false;
	}

	if(state == false)
	{
		state = true;
		if(!jtag_dr_scan(jtag, 0x20, &dr_scan_value, tdi_buffer,TAP_IDLE))
		{
			state = false;
		}
		if (!memcmp(tdi_buffer, id_code, sizeof(id_code))) {
			printf("jtag master test pass!\n");
		}
	}

	return 0;
}
 
```
