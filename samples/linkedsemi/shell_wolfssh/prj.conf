## CMakeLists.txt
```
cmake_minimum_required(VERSION 3.20.0)

find_package(Zephyr REQUIRED HINTS $ENV{ZEPHYR_BASE})
project(shell_wolfssh)

FILE(GLOB app_sources src/main.c)
target_sources(app PRIVATE ${app_sources})
add_definitions(-DWOLFSSL_ZEPHYR)
add_definitions(-DWOLFSSL_USER_SETTINGS)
```

## prj.conf
```kconfig
# Kernel options
CONFIG_MAIN_STACK_SIZE=32768
CONFIG_ENTROPY_GENERATOR=y
CONFIG_INIT_STACKS=y
CONFIG_COMMON_LIBC_MALLOC_ARENA_SIZE=524288

# Enable wolfSSH
CONFIG_WOLFSSH=y
CONFIG_WOLFSSH_SETTINGS_FILE="wolfssh_user_settings.h"
CONFIG_WOLFSSH_SFTP_DEFAULT_DIR="/RAM:"

# Pthreads
CONFIG_PTHREAD_IPC=y

# Clock for time()
CONFIG_POSIX_CLOCK=y

# Networking
CONFIG_NETWORKING=y
# CONFIG_NET_TEST=y
CONFIG_NET_IPV4=y
CONFIG_NET_IPV6=n
CONFIG_NET_TCP=y
CONFIG_NET_SOCKETS=y
CONFIG_NET_SOCKETS_POSIX_NAMES=y

CONFIG_NET_TEST=n
CONFIG_NET_LOOPBACK=n

# Network driver config
CONFIG_TEST_RANDOM_GENERATOR=y

# Network address config
CONFIG_NET_CONFIG_SETTINGS=y
CONFIG_NET_CONFIG_NEED_IPV4=y
CONFIG_NET_CONFIG_MY_IPV4_ADDR="192.168.1.123"
CONFIG_NET_CONFIG_PEER_IPV4_ADDR="192.168.1.124"
CONFIG_NET_CONFIG_MY_IPV4_GW="192.168.1.2"

CONFIG_NET_PKT_TX_COUNT=10

# Logging
CONFIG_PRINTK=y
CONFIG_LOG=y
CONFIG_LOG_MODE_IMMEDIATE=y
#CONFIG_WOLFSSH_DEBUG=y
#CONFIG_WOLFSSL_DEBUG=y
#CONFIG_DEBUG=y

# Enable logging using RTT and UART
#CONFIG_CBPRINTF_LIBC_SUBSTS=y
#CONFIG_CBPRINTF_FP_SUPPORT=y
#CONFIG_CONSOLE=y
#CONFIG_LOG_BACKEND_UART=y
#CONFIG_LOG_BUFFER_SIZE=15360

# TLS configuration
CONFIG_WOLFSSL=y
CONFIG_WOLFSSL_BUILTIN=y
CONFIG_WOLFSSL_SETTINGS_FILE="wolfssl_user_settings.h"

CONFIG_WOLFSSL_TLS_VERSION_1_2=y
CONFIG_WOLFSSL_KEY_EXCHANGE_ALL_ENABLED=y
CONFIG_WOLFSSL_CIPHER_ALL_ENABLED=y
CONFIG_WOLFSSL_MAC_ALL_ENABLED=y
CONFIG_WOLFSSL_HMAC_DRBG_ENABLED=y

# FS
CONFIG_DISK_ACCESS=y
CONFIG_DISK_DRIVERS=y
CONFIG_DISK_DRIVER_RAM=y
CONFIG_FILE_SYSTEM=y
CONFIG_FILE_SYSTEM_MKFS=y
CONFIG_FAT_FILESYSTEM_ELM=y
CONFIG_FS_FATFS_LFN=y
CONFIG_FS_FATFS_LFN_MODE_STACK=y
```

## prj_nofs.conf
```kconfig
# Kernel options
CONFIG_MAIN_STACK_SIZE=32768
CONFIG_SHELL_STACK_SIZE=3072
CONFIG_ENTROPY_GENERATOR=y
CONFIG_COMMON_LIBC_MALLOC_ARENA_SIZE=131072
CONFIG_NET_SOCKETS_SERVICE_STACK_SIZE=8192

# Enable wolfSSH
CONFIG_WOLFSSH=y
CONFIG_WOLFSSH_SETTINGS_FILE="wolfssh_user_settings_nofs.h"

# Pthreads
CONFIG_PTHREAD_IPC=y

# Clock for time()
CONFIG_POSIX_CLOCK=y

# Networking
CONFIG_NETWORKING=y
# CONFIG_NET_TEST=y
CONFIG_NET_IPV4=y
CONFIG_NET_IPV6=n
CONFIG_NET_TCP=y
CONFIG_NET_SOCKETS=y
CONFIG_NET_SOCKETS_POSIX_NAMES=y

CONFIG_NET_TEST=n
CONFIG_NET_LOOPBACK=n

# Network driver config
CONFIG_TEST_RANDOM_GENERATOR=y

# Network address config
CONFIG_NET_CONFIG_SETTINGS=y
CONFIG_NET_CONFIG_NEED_IPV4=y
CONFIG_NET_CONFIG_MY_IPV4_ADDR="192.168.1.123"
CONFIG_NET_CONFIG_PEER_IPV4_ADDR="192.168.1.124"
CONFIG_NET_CONFIG_MY_IPV4_GW="192.168.1.2"

CONFIG_NET_PKT_TX_COUNT=10

# Logging
CONFIG_PRINTK=y
CONFIG_LOG=n
CONFIG_LOG_MODE_IMMEDIATE=y
# CONFIG_WOLFSSH_DEBUG=y
# CONFIG_WOLFSSL_DEBUG=y
# CONFIG_DEBUG=y

# Enable logging using RTT and UART
#CONFIG_CBPRINTF_LIBC_SUBSTS=y
#CONFIG_CBPRINTF_FP_SUPPORT=y
#CONFIG_CONSOLE=y
#CONFIG_LOG_BACKEND_UART=y
#CONFIG_LOG_BUFFER_SIZE=15360

# TLS configuration
CONFIG_WOLFSSL=y
CONFIG_WOLFSSL_BUILTIN=y
CONFIG_WOLFSSL_SETTINGS_FILE="wolfssl_user_settings_nofs.h"

CONFIG_WOLFSSL_TLS_VERSION_1_2=y
CONFIG_WOLFSSL_KEY_EXCHANGE_ALL_ENABLED=y
CONFIG_WOLFSSL_CIPHER_ALL_ENABLED=y
CONFIG_WOLFSSL_MAC_ALL_ENABLED=y
CONFIG_WOLFSSL_HMAC_DRBG_ENABLED=y


CONFIG_MDIO=y
CONFIG_SHELL=y
CONFIG_SHELL_BACKEND_SERIAL=n
CONFIG_SHELL_BACKEND_WOLFSSH=y

CONFIG_NET_PKT_RX_COUNT=16
CONFIG_NET_BUF_RX_COUNT=32
CONFIG_NET_IF_MAX_IPV6_COUNT=2

CONFIG_NET_SOCKETS_SERVICE=y

CONFIG_SHELL_LOG_BACKEND=n

CONFIG_INIT_STACKS=y

# CONFIG_STACK_USAGE=y
# CONFIG_THREAD_STACK_INFO=y
# CONFIG_STACK_SENTINEL=y

# CONFIG_ETH_DW=y
# CONFIG_ETH_DW_MAC_DW_GMAC=y
# CONFIG_ETH_DW_PHY_ADDR=0
```

## src/main.c
```c
/*
 * Copyright (c) 2012-2014 Wind River Systems, Inc.
 *
 * SPDX-License-Identifier: Apache-2.0
 */

 #include <stdio.h>

 int main(void)
 {
     printf("Test shell_wolfssh! %s\n", CONFIG_BOARD_TARGET);
 
     return 0;
 }
 
```
