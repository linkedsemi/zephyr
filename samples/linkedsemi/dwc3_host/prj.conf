## CMakeLists.txt
```
# SPDX-License-Identifier: Apache-2.0

cmake_minimum_required(VERSION 3.20.0)

find_package(Zephyr REQUIRED HINTS $ENV{ZEPHYR_BASE})
project(hello_world)

target_sources(app PRIVATE src/main.c src/xhci.c src/xhci_port.c)
```

## prj.conf
```kconfig
# nothing here
CONFIG_SHELL=y
CONFIG_HEAP_MEM_POOL_SIZE=20480
```

## src/main.c
```c
/*
 * Copyright (c) 2012-2014 Wind River Systems, Inc.
 *
 * SPDX-License-Identifier: Apache-2.0
 */

#include <stdio.h>
#include <zephyr/kernel.h>
#include <zephyr/irq.h>
#include "xhci.h"

#define DWC_USB3_HOST_NUM_U2_ROOT_PORTS_MAX 16
#define DWC_USB3_HOST_NUM_U2_ROOT_PORTS 1
#define DWC_USB3_HOST_NUM_U3_ROOT_PORTS_MAX 16
#define DWC_USB3_HOST_NUM_U3_ROOT_PORTS 1
#define DWC_USB3_DEVICE_NUM_INT_MAX 32
#define DWC_USB3_DEVICE_NUM_INT 1

struct dwc3_gevnt_reg{
	volatile uint32_t ADRLO;		//0x300
	volatile uint32_t ADRHI;		//0x304
	volatile uint32_t SIZ;			//0x308
	volatile uint32_t COUNT;		//0x30c
};

#define DWC_USB3_NUM_EPS_MAX 32
#define DWC_USB3_NUM_EPS 8
struct dwc3_dev_ep_reg{
	volatile uint32_t CMDPAR2;
	volatile uint32_t CMDPAR1;
	volatile uint32_t CMDPAR0;
	volatile uint32_t CMD;
};

struct dwc3_global_reg {
	volatile uint32_t GSBUSCFG0;		//0x00
	volatile uint32_t GSBUSCFG1;		//0x04
	volatile uint32_t GTXTHRCFG;		//0x08
	volatile uint32_t GRXTHRCFG;		//0x0c
	volatile uint32_t GCTL;				//0x10
	volatile uint32_t GPMSTS;			//0x14
	volatile uint32_t GSTS;				//0x18
	volatile uint32_t GUCTL1;			//0x1c
	volatile uint32_t GSNPSID;			//0x20
	volatile uint32_t GGPIO;			//0x24
	volatile uint32_t GUID;				//0x28
	volatile uint32_t GUCTL;			//0x2c
	volatile uint32_t GBUSERRADDRLO;	//0x30
	volatile uint32_t GBUSERRADDRHI;	//0x34
	volatile uint32_t GPRTBIMAPLO;		//0x38
	volatile uint32_t GPRTBIMAPHI;		//0x3c
	volatile uint32_t GHWPARAMS0;		//0x40
	volatile uint32_t GHWPARAMS1;		//0x44
	volatile uint32_t GHWPARAMS2;		//0x48
	volatile uint32_t GHWPARAMS3;		//0x4c
	volatile uint32_t GHWPARAMS4;		//0x50
	volatile uint32_t GHWPARAMS5;		//0x54
	volatile uint32_t GHWPARAMS6;		//0x58
	volatile uint32_t GHWPARAMS7;		//0x5c
	volatile uint32_t GDBGFIFOSPACE;	//0x60
	volatile uint32_t GDBGLTSSM;		//0x64
	volatile uint32_t GDBGLNMCC;		//0x68
	volatile uint32_t GDBGBMU;			//0x6c
	volatile uint32_t GDBGLSPMUX;		//0x70
	volatile uint32_t GDBGLSP;			//0x74
	volatile uint32_t GDBGEPINFO0;		//0x78
	volatile uint32_t GDBGEPINFO1;		//0x7c
	volatile uint32_t GPRTBIMAP_HSLO;	//0x80
	volatile uint32_t GPRTBIMAP_HSHI;	//0x84
	volatile uint32_t GPRTBIMAP_FSLO;	//0x88
	volatile uint32_t GPRTBIMAP_FSHI;	//0x8c
	volatile uint32_t RESERVED1;
	volatile uint32_t GERRINJCTL_1;		//0x94
	volatile uint32_t GERRINJCTL_2;		//0x98
	volatile uint32_t GUCTL2;			//0x9c
	volatile uint32_t RESERVED[24];
	volatile uint32_t GUSB2PHYCFG[DWC_USB3_HOST_NUM_U2_ROOT_PORTS]; //0x100
	volatile uint32_t RESERVED2[DWC_USB3_HOST_NUM_U2_ROOT_PORTS_MAX-DWC_USB3_HOST_NUM_U2_ROOT_PORTS];
	volatile uint32_t GUSB2I2CCTL[DWC_USB3_HOST_NUM_U2_ROOT_PORTS]; //0x140
	volatile uint32_t RESERVED3[DWC_USB3_HOST_NUM_U2_ROOT_PORTS_MAX-DWC_USB3_HOST_NUM_U2_ROOT_PORTS];
	volatile uint32_t GUSB2PHYACC[DWC_USB3_HOST_NUM_U2_ROOT_PORTS]; //0x180
	volatile uint32_t RESERVED4[DWC_USB3_HOST_NUM_U2_ROOT_PORTS_MAX-DWC_USB3_HOST_NUM_U2_ROOT_PORTS];
	volatile uint32_t GUSB3PIPECTL[DWC_USB3_HOST_NUM_U3_ROOT_PORTS]; //0x1c0
	volatile uint32_t RESERVED5[DWC_USB3_HOST_NUM_U3_ROOT_PORTS_MAX-DWC_USB3_HOST_NUM_U3_ROOT_PORTS];
	volatile uint32_t GTXFIFOSIZ[32];	//0x200
	volatile uint32_t GRXFIFOSIZ[32];	//0x280
	struct dwc3_gevnt_reg GEVNT[DWC_USB3_DEVICE_NUM_INT]; //0x300
	volatile uint32_t RESERVED6[(DWC_USB3_DEVICE_NUM_INT_MAX-DWC_USB3_DEVICE_NUM_INT)*sizeof(struct dwc3_gevnt_reg)/sizeof(uint32_t)];
	volatile uint32_t GHWPARAMS8;		//0x500
	volatile uint32_t RESERVED7[2];
	volatile uint32_t GUCTL3;			//0x50c
	volatile uint32_t GTXFIFOPRIDEV;	//0x510
	volatile uint32_t RESERVED8;
	volatile uint32_t GTXFIFOPRIHST;	//0x518
	volatile uint32_t GRXFIFOPRIHST;	//0x51c
	volatile uint32_t GFIFOPRIDBC;		//0x520
	volatile uint32_t GDMAHLRATIO;		//0x524
	volatile uint32_t RESERVED9[2];
	volatile uint32_t GFLADJ;			//0x530
	volatile uint32_t RESERVED10[3];
	volatile uint32_t GUSB2RHBCTL[DWC_USB3_HOST_NUM_U2_ROOT_PORTS]; //0x540
};

struct dwc3_dev_reg {
	volatile uint32_t DCFG;				//0x00
	volatile uint32_t DCTL;				//0x04
	volatile uint32_t DEVTEN;			//0x08
	volatile uint32_t DSTS;				//0x0c
	volatile uint32_t DGCMDPAR;			//0x10
	volatile uint32_t DGCMD;			//0x14
	volatile uint32_t RESERVED1[2];
	volatile uint32_t DALEPENA;			//0x20
	volatile uint32_t RESERVED2[55];
	struct dwc3_dev_ep_reg DEP[DWC_USB3_NUM_EPS]; //0x100
	volatile uint32_t RESERVED3[(DWC_USB3_NUM_EPS_MAX-DWC_USB3_NUM_EPS)*sizeof(struct dwc3_dev_ep_reg)/sizeof(uint32_t)];
	volatile uint32_t DEV_IMOD[DWC_USB3_DEVICE_NUM_INT]; //0x300
};

#define DWC3_XHCI_REGS_START		0x0
#define DWC3_XHCI_REGS_END		0x7fff
#define DWC3_GLOBALS_REGS_START		0xc100
#define DWC3_GLOBALS_REGS_END		0xc6ff
#define DWC3_DEVICE_REGS_START		0xc700
#define DWC3_DEVICE_REGS_END		0xcbff
#define DWC3_OTG_REGS_START		0xcc00
#define DWC3_OTG_REGS_END		0xccf

/* Device Control Register */
#define DWC3_DCTL_RUN_STOP	BIT(31)
#define DWC3_DCTL_CSFTRST	BIT(30)
#define DWC3_DCTL_LSFTRST	BIT(29)

#define EVT_BUF_LENGTH_WORDS 16

/* Device Event Enable Register */
#define DWC3_DEVTEN_VNDRDEVTSTRCVEDEN	BIT(12)
#define DWC3_DEVTEN_EVNTOVERFLOWEN	BIT(11)
#define DWC3_DEVTEN_CMDCMPLTEN		BIT(10)
#define DWC3_DEVTEN_ERRTICERREN		BIT(9)
#define DWC3_DEVTEN_SOFEN		BIT(7)
#define DWC3_DEVTEN_U3L2L1SUSPEN	BIT(6)
#define DWC3_DEVTEN_HIBERNATIONREQEVTEN	BIT(5)
#define DWC3_DEVTEN_WKUPEVTEN		BIT(4)
#define DWC3_DEVTEN_ULSTCNGEN		BIT(3)
#define DWC3_DEVTEN_CONNECTDONEEN	BIT(2)
#define DWC3_DEVTEN_USBRSTEN		BIT(1)
#define DWC3_DEVTEN_DISCONNEVTEN	BIT(0)

union evt_buf_u {
	struct {
		uint32_t :1,
				phy_ep_num:5,
				ep_evt_type:4,
				:2,
				evt_status:4,
				evt_param:16;
	}depevt;
	struct {
		uint32_t :8,
				dev_evt_type:5,
				:3,
				evt_info:9,
				:7;
	}devt;
	uint32_t dev_ep:1;
};

struct dwc3_trb {
	uint32_t BPTRL;
	uint32_t BPTRH;
	uint32_t BUFSIZ:24,
			PCM1:2,
			SPR:1,
			Reserved1:1,
			TRBSTS:4;
	uint32_t HWO:1,
			LST:1,
			CHN:1, // 为 1 的时候，硬件会自动取下一个 trb (当前 trb + sizeof trb)
			CSP:1,
			TRBCTL:6, // 为 link 的时候，BPTRL 指向一个 trb 的地址， bufsize 为 0
			ISP_IMI:1,
			IOC:1,
			Reserved2:2,
			SID_SOFN:16,
			Reserved3:2;
};

enum ep_evt {
	DEPEVT_XferComplete = 1,
	DEPEVT_XferInProgress = 2,
	DEPEVT_XferNotReady = 3,
	DEPEVT_StreamEvt = 6,
	DEPEVT_EPCmdCmplt = 7,
};

#define DWC3_GEVNTSIZ_INTMASK		BIT(31)
#define DWC3_GEVNTSIZ_SIZE(n)		((n) & 0xffff)
#define DWC3_GEVNT_HANDLER_BUSY BIT(31)
#define USB_BASE  (0x40050000)

#define LS_CLK_SET(base, n)   (*(volatile uint32_t *)((base) + (n)))

enum TRB_Control {
	TRB_Normal = 1,
	TRB_Control_Setup,
	TRB_Control_Status_2,
	TRB_Control_Status_3,
	TRB_Control_Data,
	TRB_Isochronous_First,
	TRB_Isochronous,
	TRB_Link,
	TRB_Normal_ZLP
};

static void udc_dwc3_isr_handler(void *param)
{
	xhci_isr(param);
}

static struct xhci_hcd hcd;

static volatile struct dwc3_global_reg *dwc3_gbl = (struct dwc3_global_reg *)(USB_BASE + DWC3_GLOBALS_REGS_START);

#include <zephyr/shell/shell.h>

static int xhci_noop_command(const struct shell *sh, size_t argc, char **argv)
{
	if(xhci_cmd_noop(&hcd) == 0)
		printk("cmd exec ok!!\n");
	return 0;
}
SHELL_CMD_REGISTER(xhci_noop_command, NULL, "test command ring and event ring", xhci_noop_command);

static int slot_id = 0;

static int xhci_alloc_dev(const struct shell *sh, size_t argc, char **argv)
{
	slot_id = xhci_alloc_device(&hcd);
	xhci_set_dev_speed(&hcd, slot_id, xhci_get_port_speed(&hcd, 0));
	xhci_cmd_address_device(&hcd, slot_id, 0);
	printk("alloc slot_id = %d.\n", slot_id);
	return 0;
}
SHELL_CMD_REGISTER(xhci_alloc_dev, NULL, "alloc device", xhci_alloc_dev);

#include <stdlib.h>
static int xhci_address_dev(const struct shell *sh, size_t argc, char **argv)
{
	int res = xhci_cmd_address_device(&hcd, slot_id, 1);
	printk("xhci_address_dev res = %d.\n", res);
	return 0;
}
SHELL_CMD_REGISTER(xhci_address_dev, NULL, "address device", xhci_address_dev);

static int xhci_disable_slot(const struct shell *sh, size_t argc, char **argv)
{
	if (argc < 2)
	{
		printk("%s <slot id> \n", argv[0]);
		return 0;
	}
	xhci_cmd_disable_slot(&hcd, atoi(argv[1]));
	slot_id = 0;
	return 0;
}
SHELL_CMD_REGISTER(xhci_disable_slot, NULL, "disable sloat", xhci_disable_slot);

static int xhci_enable_slot(const struct shell *sh, size_t argc, char **argv)
{
	slot_id = xhci_cmd_enable_slot(&hcd);
	printk("slot_id = %d.\n", slot_id);
	return 0;
}
SHELL_CMD_REGISTER(xhci_enable_slot, NULL, "enable sloat", xhci_enable_slot);

volatile uint32_t connect_done = 0;

static int xhci_get_dev_desc(const struct shell *sh, size_t argc, char **argv)
{
	static __attribute__((aligned(32)))  uint8_t dev_desc[64];
	int xfer_len = 0;
	struct usb_setup_packet setup = {
		.bmRequestType = 0x80,
		.bRequest = 0x6,
		.wValue = 0x100,
		.wIndex = 0x0,
		.wLength = 64,
	};
	xfer_len = xhci_xfer_control(&hcd, slot_id, 0, &setup, dev_desc, 64);
	xhci_cache_invalid(dev_desc, 64);

	if (xfer_len >= 0)
	{
		printk("device desc: ");
		for (int i = 0; i < 64 - xfer_len; i++)
		{
			printk("0x%x ", dev_desc[i]);
		}
		printk("\n");
	}
	return 0;
}
SHELL_CMD_REGISTER(xhci_get_dev_desc, NULL, "get device desc", xhci_get_dev_desc);

static int xhci_get_config_desc(const struct shell *sh, size_t argc, char **argv)
{
	static __attribute__((aligned(32)))  uint8_t config_desc[255];
	int xfer_len = 0;

	struct usb_setup_packet setup = {
		.bmRequestType = 0x80,
		.bRequest = 0x6,
		.wValue = 0x200,
		.wIndex = 0x0,
		.wLength = 255,
	};
	xfer_len = xhci_xfer_control(&hcd, slot_id, 0, &setup, config_desc, 255);
	xhci_cache_invalid(config_desc, 255);

	if (xfer_len >= 0)
	{
		printk("config desc: ");
		for (int i = 0; i < 255 - xfer_len; i++)
		{
			printk("0x%x ", config_desc[i]);
		}
		printk("\n");
	}
	return 0;
}
SHELL_CMD_REGISTER(xhci_get_config_desc, NULL, "xhci_get_config_desc", xhci_get_config_desc);

static size_t usb_string_desc_inplace(uint8_t *buf, size_t buf_len)
{
    if (!buf || buf_len < 2 || buf[1] != 0x03)
		return 0;

    size_t available_bytes = buf_len - 2;
    size_t str_len = available_bytes / 2; // 每个字符占 2 字节 (UTF-16LE)

    for (size_t i = 0; i < str_len; i++)
	{
        buf[i] = buf[2 + i*2];
    }
    buf[str_len] = '\0';

    return str_len;
}

static int xhci_get_string_desc(const struct shell *sh, size_t argc, char **argv)
{
	static __attribute__((aligned(32))) uint8_t string_desc[255];
	int xfer_len = 0;

	if (argc < 2)
	{
		printk("%s <string index> \n", argv[0]);
		return 0;
	}

	struct usb_setup_packet setup = {
		.bmRequestType = 0x80,
		.bRequest = 0x6,
		.wValue = 0x300 | atoi(argv[1]),
		.wIndex = 0x409,
		.wLength = 255,
	};
	xfer_len = xhci_xfer_control(&hcd, slot_id, 0, &setup, string_desc, 255);
	xhci_cache_invalid(string_desc, 255);

	if (xfer_len >= 0)
	{
		usb_string_desc_inplace(string_desc, 255 - xfer_len);
		printk("String Descriptor %d: %s\n", atoi(argv[1]), string_desc);
	}
	return 0;
}
SHELL_CMD_REGISTER(xhci_get_string_desc, NULL, "xhci_get_string_desc", xhci_get_string_desc);

static int xhci_control_transfer(const struct shell *sh, size_t argc, char **argv)
{
	static __attribute__((aligned(32)))  uint8_t dev_desc[64];
	int xfer_len = 0;
	struct usb_setup_packet setup = {
		.bmRequestType = 0x81,
		.bRequest = 0x6,
		.wValue = 0x100,
		.wIndex = 0x0,
		.wLength = 64,
	};

	struct xhci_ep_config ep_config = {
		.ep_addr = 0x82,
		.ep_interval = 3,
		.ep_mps = 64,
		.ep_type = EP_CONTROL_BIDIR
	};
	xhci_cmd_add_endpoint(&hcd, slot_id, &ep_config);

	xfer_len = xhci_xfer_control(&hcd, slot_id, 0x82, &setup, dev_desc, 64);
	xhci_cache_invalid(dev_desc, 64);

	if (xfer_len >= 0)
	{
		printk("device desc: ");
		for (int i = 0; i < 64 - xfer_len; i++)
		{
			printk("0x%x ", dev_desc[i]);
		}
		printk("\n");
	}
	return 0;
}
SHELL_CMD_REGISTER(xhci_control_transfer, NULL, "xhci_control_transfer", xhci_control_transfer);

static int xhci_bulk_in_transfer(const struct shell *sh, size_t argc, char **argv)
{
	/* Allowed to begin on a byte address boundary, However, user may find other alignments, such as 64-byte or 128-byte
	alignments, to be more efficient and provide better performance */

	static __attribute__((aligned(64))) uint8_t dev_desc[128];
	int xfer_len = 0;

	struct xhci_ep_config ep_config = {
		.ep_addr = 0x83,
		.ep_interval = 3,
		.ep_mps = 512,
		.ep_type = EP_BULK_IN
	};
	xhci_cmd_add_endpoint(&hcd, slot_id, &ep_config);
	xfer_len = xhci_xfer_bulk(&hcd, slot_id, 0x83, dev_desc, 128);
	xhci_cache_invalid(dev_desc, 128);

	printk("xfer_len = %d.\n", xfer_len);
	if (xfer_len >= 0)
	{
		printk("IN Data: ");
		for (int i = 0; i < 128 - xfer_len; i++)
		{
			printk("0x%x ", dev_desc[i]);
		}
		printk("\n");
	}

	return 0;
}
SHELL_CMD_REGISTER(xhci_bulk_in_transfer, NULL, "xhci_bulk_in_transfer", xhci_bulk_in_transfer);

static int xhci_bulk_out_transfer(const struct shell *sh, size_t argc, char **argv)
{
	uint8_t dev_desc[64];

	for (int i = 0; i < 64; i++)
	{
		dev_desc[i] = i;
	}

	struct xhci_ep_config ep_config = {
		.ep_addr = 0x4,
		.ep_interval = 3,
		.ep_mps = 512,
		.ep_type = EP_BULK_OUT
	};
	xhci_cmd_add_endpoint(&hcd, slot_id, &ep_config);
	xhci_xfer_bulk(&hcd, slot_id, 0x4, dev_desc, 64);

	return 0;
}
SHELL_CMD_REGISTER(xhci_bulk_out_transfer, NULL, "xhci_bulk_out_transfer", xhci_bulk_out_transfer);

static int xhci_show_dev_ctx(const struct shell *sh, size_t argc, char **argv)
{
	xhci_device_ctx_show(&hcd, slot_id);
	return 0;
}
SHELL_CMD_REGISTER(xhci_show_dev_ctx, NULL, "xhci_show_dev_ctx", xhci_show_dev_ctx);

static int xhci_noop_transfer(const struct shell *sh, size_t argc, char **argv)
{	
	/* test ep0 transfer ring */
	if (xhci_xfer_noop(&hcd, slot_id, 0x80, EP_CONTROL_BIDIR) == 0)
		printk("transfer ring ok!!\n");
	else
		printk("transfer ring error!!\n");
	return 0;
}
SHELL_CMD_REGISTER(xhci_noop_transfer, NULL, "send noop for ep transfer ring", xhci_noop_transfer);

static int xhci_show_portsc(const struct shell *sh, size_t argc, char **argv)
{	
	printk("portsc = 0x%x\n", xhci_get_portsc(&hcd, 0));
	return 0;
}
SHELL_CMD_REGISTER(xhci_show_portsc, NULL, "xhci show portsc", xhci_show_portsc);

static int xhci_reset_port(const struct shell *sh, size_t argc, char **argv)
{	
	xhci_port_reset(&hcd, 0);
	return 0;
}
SHELL_CMD_REGISTER(xhci_reset_port, NULL, "xhci reset port", xhci_reset_port);

static uint8_t dwc3_phy_cfg_read(uint8_t reg_addr)
{
    uint32_t res;
    /* rst en */
    *(uint32_t *)0x40058010 |= BIT(25);
    k_usleep(1);
    /* set reg_addr and write_data*/
    *(uint32_t *)0x40058010 &= ~(0xff << 2);
    *(uint32_t *)0x40058010 |= (reg_addr << 2);
    k_usleep(1);
    /* enable read */
    *(uint32_t *)0x40058010 |= (0x1 << 0);
    k_usleep(1);
    *(uint32_t *)0x40058010 &= ~(0x1 << 0);
    k_usleep(1);
    res = *(uint32_t *)0x40058010;
    return (res >> 8) & 0xff;
}

static void dwc3_phy_cfg_write(uint8_t reg_addr, uint8_t write_data)
{
    /* rst en */
    *(uint32_t *)0x40058010 |= BIT(25);
    k_usleep(1);
    /* set reg_addr and write_data*/
    *(uint32_t *)0x40058010 &= ~(0xff << 2);
    *(uint32_t *)0x40058010 |= (reg_addr << 2);
    *(uint32_t *)0x40058010 &= ~(0xff << 16);
    *(uint32_t *)0x40058010 |= (write_data << 16);
    k_usleep(1);
    /* enable write */
    *(uint32_t *)0x40058010 |= (0x1 << 1);
    k_usleep(1);
    *(uint32_t *)0x40058010 &= ~(0x1 << 1);
}

int main(void)
{
	/* clock gate */
	LS_CLK_SET(0x40062000, 0x10) = BIT(0xd);
	/* reset */
	LS_CLK_SET(0x40062000, 0x18) = BIT(0xd);
	LS_CLK_SET(0x40062000, 0x18) = BIT(0xc);
	LS_CLK_SET(0x40062000, 0x10) = BIT(0xc);

	IRQ_CONNECT(29, 3, udc_dwc3_isr_handler, &hcd, 0);
	irq_enable(29);

	/* enable phy pll */
	*(uint32_t *)0x40058014 = 0x131; // pll_en, refclk div, refclk mode (5M or 12M align)
	*(uint32_t *)0x40058004 |= BIT(8); // xhc_bme enable
	*(uint32_t *)0x40058000 |= BIT(5); // Number of USB 2.0 Ports

	dwc3_gbl->GUSB2PHYCFG[0] = 0x40002407;

	uint32_t gctl = dwc3_gbl->GCTL;
	gctl &= ~(0x3 << 12);
	gctl |= 0x1 << 12; // device mode
	dwc3_gbl->GCTL = gctl;

	/* The disconnect detection voltage threshold is set to 490mv */
	uint8_t value = dwc3_phy_cfg_read(0xb);
	value &= ~BIT(6);
	dwc3_phy_cfg_write(0xb, value);

	xhci_init(&hcd, USB_BASE);

	while (1) {
		k_msleep(2000);
	}

	return 0;
}
```

## src/xhci.h
```c
#ifndef __XHCI_H__
#define __XHCI_H__

#include <stdint.h>
#include <stddef.h>
#include "xhci_def.h"

#ifdef __cplusplus
extern "C" {
#endif

/* init */
int xhci_init(struct xhci_hcd *hcd, uint32_t xhci_base_addr);

/* command */
int xhci_cmd_disable_slot(struct xhci_hcd *xhci, int slot);
int xhci_cmd_enable_slot(struct xhci_hcd *xhci);
int xhci_cmd_address_device(struct xhci_hcd *xhci, int slot, xhci_addr_dev_type_t type);
int xhci_cmd_reset_device(struct xhci_hcd *xhci, int slot);
int xhci_cmd_add_endpoint(struct xhci_hcd *xhci, int slot, struct xhci_ep_config *ep_config);
int xhci_cmd_drop_endpoint(struct xhci_hcd *xhci, int slot, uint8_t ep);
int xhci_cmd_noop(struct xhci_hcd *xhci);

/* function */
int xhci_alloc_device(struct xhci_hcd *xhci);
int xhci_free_device(struct xhci_hcd *xhci, int slot);
int xhci_address_device(struct xhci_hcd *xhci, int slot, int type);
struct xhci_ep_ctx *xhci_get_ep_ctx(struct xhci_hcd *hcd, struct xhci_ctx *ctx, int ep_index);
struct xhci_slot_ctx *xhci_get_slot_ctx(struct xhci_hcd *hcd, struct xhci_ctx *ctx);
int xhci_device_ctx_show(struct xhci_hcd *hcd, size_t slot);
int xhci_port_reset(struct xhci_hcd *hcd, int port);
uint32_t xhci_get_portsc(struct xhci_hcd *hcd, int port);
enum xhci_usb_speed xhci_get_port_speed(struct xhci_hcd *xhci, int port_id);
void xhci_set_dev_speed(struct xhci_hcd *xhci, int slot, enum xhci_usb_speed speed);

/* transfer */
int xhci_xfer_control(struct xhci_hcd *xhci, int slot, int ep, struct usb_setup_packet *req, void *data, uint32_t length);
int xhci_xfer_bulk(struct xhci_hcd *xhci, int slot, int ep, void *data, int length);
int xhci_xfer_interrupt(struct xhci_hcd *xhci, int slot, int ep, void *data, int length);
int xhci_xfer_noop(struct xhci_hcd *xhci, int slot, uint8_t ep, xhci_ep_type_t type);

/* isr */
void xhci_isr(struct xhci_hcd *hcd);

/* port */
void xhci_enqueue_lock();
void xhci_enqueue_unlock();
void xhci_event_complete();
void xhci_event_wait();
void *xhci_mem_alloc(size_t align, size_t size);
void xhci_mem_free(void *ptr);
void xhci_cache_flush(void *buf, size_t size);
void xhci_cache_invalid(void *buf, size_t size);

#ifdef __cplusplus
}
#endif

#endif // __XHCI_H__
```

## src/xhci_def.h
```c
#ifndef __XHCI_DEF_H__
#define __XHCI_DEF_H__

#ifdef __cplusplus
extern "C" {
#endif

#ifndef XHCI_LOG_DBG
#define XHCI_LOG_DBG(...)           printf("XHCI: ");printf(__VA_ARGS__)
#endif 

#if defined(__GNUC__) || defined(__clang__)
#define XHCI_MEM_ALIGN(n)           __attribute__((aligned(n)))
#else
#define XHCI_MEM_ALIGN(n)
#endif

#define XHCI_RING_TRB_MAX_NUM       32
#define XHCI_ALIGN                  64
#define XHCI_SLOT_MAX               16

/* TRB bit mask */
#define TRB_TYPE_BITMASK     (0xfc00)
#define TRB_TYPE(p)        ((p) << 10)
#define TRB_FIELD_TO_TYPE(p)     (((p) & TRB_TYPE_BITMASK) >> 10)

#define TRB_IDT             (1 << 6)
#define TRB_TRT(p)          ((p) << 16)
#define TRB_ISP             (1 << 2)
#define TRB_DIR_IN          (1 << 16)
#define TRB_IOC             (1 << 5)

#define TRB_DATA_IN         3
#define TRB_DATA_OUT        2
#define TRB_DATA_NO         0

#define TRB_BSR              (1<<9)
#define TRB_CYCLE            (1<<0)
#define LINK_TOGGLE          (0x1<<1)

#define STS_HALT        (1 << 0)
#define STS_CNR         (1 << 11)

#define CMD_RUN        (1 << 0)
#define CMD_RESET     (1 << 1)
#define CMD_EIE        (1 << 2)

#define ERST_EHB        (1 << 3)
#define ERST_PTR_MASK        (0xf)

#define GET_PORT_ID(p)        (((p) & (0xff << 24)) >> 24)
#define SLOT_FLAG             (1 << 0)
#define EP0_FLAG              (1 << 1)

#define COMP_CODE_MASK        (0xff << 24)
#define GET_COMP_CODE(p)     (((p) & COMP_CODE_MASK) >> 24)

#define TRB_TO_SLOT_ID(p)      (((p) & (0xff<<24)) >> 24)
#define SLOT_ID_FOR_TRB(p)     (((p) & 0xff) << 24)

#define HCC_64BYTE_CONTEXT(p)  ((p) & (1 << 2))
#define CTX_SIZE(_hcc)         (HCC_64BYTE_CONTEXT(_hcc) ? 64 : 32)

/* portsc */
#define XHCI_OP_PORTSC_PRC                  (1 << 21)
#define XHCI_OP_PORTSC_RESET                (1 << 4)
#define XHCI_OP_PORTSC_CSC                  (1 << 17)
#define XHCI_OP_PORTSC_PED                  (1 << 18)

#define XHCI_OP_PORTSC_SPEED(psc)           ((psc >> 10) & 0xf)
#define XHCI_OP_PORTSC_LINK_STATE(psc)           ((psc >> 5) & 0xf)

/* usbsts */
#define XHCI_USBSTS_EINT            (1 << 3)
/* imain */
#define XHCI_IMAIN_IP               (1 << 0)

/* hscratpd num */
#define HCSPARAMS2_SCRATPAD_NUM(hcsparams2)       ((((hcsparams2) >> 16) & 0x3e0) | (((hcsparams2) >> 27) & 0x1f))

#define PORTSC        0
#define PORTPMSC     1
#define PORTLI        2
#define PORTHLPMC     3

enum XHCI_TRB_TYPE
{
    TRB_NORMAL = 1,
    TRB_SETUP,
    TRB_DATA,
    TRB_STATUS,
    TRB_ISOC,
    TRB_LINK,
    TRB_EVENT_DATA,
    TRB_TR_NOOP,
    TRB_ENABLE_SLOT,
    TRB_DISABLE_SLOT,
    TRB_ADDR_DEV,
    TRB_CONFIG_EP,
    TRB_EVAL_CONTEXT,
    TRB_RESET_EP,
    TRB_STOP_RING,
    TRB_SET_DEQ,
    TRB_RESET_DEV,
    TRB_FORCE_EVENT,
    TRB_NEG_BANDWIDTH,
    TRB_SET_LT,
    TRB_GET_BW,
    TRB_FORCE_HEADER,
    TRB_CMD_NOOP,
    TRB_TRANSFER = 32,
    TRB_COMPLETION,
    TRB_PORT_STATUS,
    TRB_BANDWIDTH_EVENT,
    TRB_DOORBELL,
    TRB_HC_EVENT,
    TRB_DEV_NOTE,
    TRB_MFINDEX_WRAP,
    TRB_TYPE_MAX
};

enum XHCI_COMP_CODE
{
    COMP_INVALID,
    COMP_SUCCESS,
    COMP_DATA_BUFFER_ERROR,
    COMP_BABBLE_DETECTED_ERROR,
    COMP_USB_TRANSACTION_ERROR,
    COMP_TRB_ERROR,
    COMP_STALL_ERROR,
    COMP_RESOURCE_ERROR,
    COMP_BANDWIDTH_ERROR,
    COMP_NO_SLOTS_AVAILABLE_ERROR,
    COMP_INVALID_STREAM_TYPE_ERROR,
    COMP_SLOT_NOT_ENABLED_ERROR,
    COMP_ENDPOINT_NOT_ENABLED_ERROR,
    COMP_SHORT_PACKET,
    COMP_RING_UNDERRUN,
    COMP_RING_OVERRUN,
    COMP_VF_EVENT_RING_FULL_ERROR,
    COMP_PARAMETER_ERROR,
    COMP_BANDWIDTH_OVERRUN_ERROR,
    COMP_CONTEXT_STATE_ERROR,
    COMP_NO_PING_RESPONSE_ERROR,
    COMP_EVENT_RING_FULL_ERROR,
    COMP_INCOMPATIBLE_DEVICE_ERROR,
    COMP_MISSED_SERVICE_ERROR,
    COMP_COMMAND_RING_STOPPED,
    COMP_COMMAND_ABORTED,
    COMP_STOPPED,
    COMP_STOPPED_LENGTH_INVALID,
    COMP_STOPPED_SHORT_PACKET,
    COMP_MAX_EXIT_LATENCY_TOO_LARGE_ERROR,
    COMP_ISOCH_BUFFER_OVERRUN = 31,
    COMP_EVENT_LOST_ERROR,
    COMP_UNDEFINED_ERROR,
    COMP_INVALID_STREAM_ID_ERROR,
    COMP_SECONDARY_BANDWIDTH_ERROR,
    COMP_SPLIT_TRANSACTION_ERROR
};

enum xhci_usb_speed
{
    USB_SPEED_UNKNOWN = 0,
    USB_SPEED_FULL,
    USB_SPEED_LOW,
    USB_SPEED_HIGH,
};

struct xhci_cap_regs
{
    volatile uint32_t caplength;
    volatile uint32_t hcsparams1;
    volatile uint32_t hcsparams2;
    volatile uint32_t hcsparams3;
    volatile uint32_t hccparams1;
    volatile uint32_t dboff;
    volatile uint32_t rtsoff;
    volatile uint32_t hccparams2;
};

struct xhci_port_regs
{
    volatile uint32_t portsc;
    volatile uint32_t portpmsc;
    volatile uint32_t portli;
    volatile uint32_t porthlpmc; // usb2.0：If LPM is not supported (HLC = '0') then this register is reserved
}; 

struct xhci_op_regs
{
    volatile uint32_t command;
    volatile uint32_t status;
    volatile uint32_t page_size;
    volatile uint32_t reserved1;
    volatile uint32_t reserved2;
    volatile uint32_t dev_notification;
    volatile uint64_t cmd_ring;
    /* rsvd: offset 0x20-2F */
    volatile uint32_t reserved3[4];
    volatile uint64_t dcbaa_ptr;
    volatile uint32_t config_reg;
    /* rsvd: offset 0x3C-3FF */
    volatile uint32_t reserved4[241];
    volatile struct xhci_port_regs port[1]; // 400-13FFh
};

struct interrupter_regs
{
    volatile uint32_t iman;
    volatile uint32_t imod;
    volatile uint32_t erstsz;
    volatile uint32_t rsvd;
    volatile uint64_t erstba;
    volatile uint64_t erdp;
};
struct xhci_doorbell_arry
{
    volatile uint32_t doorbell[256];
};

struct xhci_erst_entry
{
    uint64_t seg_addr;
    uint32_t seg_size;
    uint32_t rsvd;
};

struct xhci_erst
{
    struct xhci_erst_entry *entry;
};

struct xhci_runtime_regs
{
    volatile uint32_t micro_frame;
    volatile uint32_t rsvd[7];
    volatile struct interrupter_regs ir_set[1];
};

typedef enum
{
    EP_ISO_OUT = 1,
    EP_BULK_OUT,
    EP_INT_OUT,
    EP_CONTROL_BIDIR,
    EP_ISO_IN,
    EP_BULK_IN,
    EP_INT_IN
} xhci_ep_type_t;

struct xhci_ep_config
{
    xhci_ep_type_t ep_type;
    uint8_t ep_addr;
    uint8_t ep_interval;
    uint16_t ep_mps;
};

struct xhci_trb
{
    uint64_t paramater;
    uint32_t status;
    uint32_t control;
};

struct xhci_generic_trb
{
    uint32_t field[4];
};

struct xhci_slot_ctx
{
    uint32_t dev_info;
    uint32_t dev_info2;
    uint32_t tt_info;
    uint32_t dev_state;
    /* offset 0x10 to 0x1f reserved for HC internal use */
    uint32_t reserved[4];
};

struct xhci_ep_ctx
{
    uint32_t ep_info[2];
    uint64_t deq;
    uint32_t tx_info;
    /* offset 0x14 - 0x1f reserved for HC internal use */
    uint32_t reserved[3];
};

struct xhci_input_control_ctx
{
    uint32_t drop_flags;
    uint32_t add_flags;
    uint32_t rsvd2[6];
};

struct xhci_device_ctx
{
    struct xhci_slot_ctx slot_ctx;
    struct xhci_ep_ctx ep_ctx[31];
};

struct xhci_input_ctx
{
    struct xhci_input_control_ctx control_ctx;
    struct xhci_slot_ctx slot_ctx;
    struct xhci_ep_ctx ep_ctx[31];
};

typedef enum
{
    EVENT_RING,
    COMMAND_RING,
    CTRL_RING,
    BULK_RING,
    INTR_RING
} ring_type_t;

typedef enum 
{
    DEFAULT_TYPE,
    ADDRESSED_TYPE,
} xhci_addr_dev_type_t;

struct xhci_ring
{
    struct xhci_trb *trb;
    uint32_t num_trb;
    ring_type_t type;
    uint32_t write_index;
    uint32_t read_index;
    uint32_t cycle_bit;
};

struct xhci_hcd;

struct xhci_ep
{
    struct xhci_ring ep_ring;
    uint8_t state;
};

struct usb_setup_packet
{
    uint8_t bmRequestType;
    uint8_t bRequest;
    uint16_t wValue;
    uint16_t wIndex;
    uint16_t wLength;
};
struct xhci_ctx
{
#define XHCI_CTX_TYPE_DEVICE  0x1
#define XHCI_CTX_TYPE_INPUT   0x2
    int type;
    int size;
    uint8_t *ctx;
};

struct xhci_device
{
    uint32_t slot;
    struct xhci_ctx device_ctx;
    struct xhci_ctx input_ctx;
    struct xhci_hcd *hcd;
    struct xhci_ep ep[31];
    enum xhci_usb_speed speed;
};

struct xhci_hcd
{
    /* regs */
    uint32_t base_addr;
    struct xhci_cap_regs *cap_reg;
    struct xhci_op_regs *op_reg;
    struct xhci_runtime_regs *runtime_reg;
    struct xhci_doorbell_arry *db_reg;

    /* ring struct */
    struct xhci_erst erst;
    struct xhci_ring event_ring;
    struct xhci_ring cmd_ring;

    /* device struct */
    struct xhci_device device[XHCI_SLOT_MAX];
    uint64_t *dev_ctx_tab;
    uint64_t *scratchpad_tab;
    uint8_t *scratchpad_buf;
    struct xhci_trb *command_trb;
    struct xhci_trb *event_trb;
    struct xhci_trb evt_trb;

    uint32_t version;
    uint16_t page_size;
    uint8_t max_slots;
    uint8_t max_port;
};

#ifdef __cplusplus
}
#endif

#endif //__XHCI_DEF_H__
```

## src/xhci_port.c
```c
#include <stddef.h>
#include <zephyr/kernel.h>
#include <zephyr/cache.h>

static volatile int event_sync = 0;

void xhci_enqueue_lock()
{

}

void xhci_enqueue_unlock()
{

}

void xhci_event_complete()
{
    event_sync = 1;
}

void xhci_event_wait()
{
    while (!event_sync);
    event_sync = 0;
}

void *xhci_mem_alloc(size_t align, size_t size)
{
    return k_aligned_alloc(align, size);;
}

void xhci_mem_free(void *ptr)
{
    k_free(ptr);
}

void xhci_cache_flush(void *buf, size_t size)
{
    sys_cache_data_flush_range(buf, size);
}

void xhci_cache_invalid(void *buf, size_t size)
{
    sys_cache_data_invd_range(buf, size);
}
```
