## CMakeLists.txt
```
# Copyright (c) 2022 Intel Corporation.
# SPDX-License-Identifier: Apache-2.0

cmake_minimum_required(VERSION 3.20.0)
find_package(Zephyr REQUIRED HINTS $ENV{ZEPHYR_BASE})
project(mbedtls_test)

target_sources(app PRIVATE src/main.c)
```

## prj.conf
```kconfig
CONFIG_LOG=y
CONFIG_LOG_MODE_MINIMAL=y
CONFIG_MAIN_STACK_SIZE=4096
CONFIG_COMPILER_SAVE_TEMPS=y
```

## boards/lsqsh_evb_cpu1.conf
```kconfig
CONFIG_MBEDTLS=y
CONFIG_MBEDTLS_BUILTIN=y
CONFIG_MBEDTLS_ENABLE_HEAP=y
CONFIG_MBEDTLS_HEAP_SIZE=4096
CONFIG_MBEDTLS_CIPHER_AES_ENABLED=y
CONFIG_MBEDTLS_CIPHER_AES_LINKEDSEMI=y # When opened, it uses the hardware encryption of linkedsemi
CONFIG_MBEDTLS_CIPHER_MODE_CBC_ENABLED=y
CONFIG_MBEDTLS_CIPHER_MODE_CFB_ENABLED=y
CONFIG_MBEDTLS_CIPHER_MODE_OFB_ENABLED=y
CONFIG_MBEDTLS_CIPHER_MODE_CTR_ENABLED=y
CONFIG_MBEDTLS_CIPHER_MODE_XTS_ENABLED=y
CONFIG_MBEDTLS_CIPHER_CCM_ENABLED=y
CONFIG_MBEDTLS_CIPHER_GCM_ENABLED=y

CONFIG_MBEDTLS_SHA224=y
CONFIG_MBEDTLS_SHA256=y
CONFIG_MBEDTLS_SHA224_SHA256_SM3_LINKEDSEMI_HARDWARE_ALT=n
CONFIG_MBEDTLS_SHA256_SM3_LINKEDSEMI_OTBN_ALT=n

CONFIG_MBEDTLS_SHA384=y
CONFIG_MBEDTLS_SHA512=y
CONFIG_MBEDTLS_SHA384_SHA512_LINKEDSEMI_HARDWARE_ALT=n
CONFIG_MBEDTLS_SHA384_SHA512_LINKEDSEMI_OTBN_ALT=n

CONFIG_MBEDTLS_SM4_LINKEDSEMI_HARDWARE_ALT=n

CONFIG_CRYPTO_MBEDTLS_SHIM=y
# ecc
CONFIG_MBEDTLS_ECP_C=y
CONFIG_MBEDTLS_ECDSA_C=y
CONFIG_MBEDTLS_ECP_ALL_ENABLED=y
CONFIG_MBEDTLS_ECDSA_SECP256R1_SECP384R1_SM2_LINKEDSEMI_OTBN_ALT=y

CONFIG_MBEDTLS_THREADING_LINKEDSEMI_ALT=y
# delegation
# CONFIG_MEBDTLS_LINKEDSEMI_OTBN_DELEGATION_CLIENT=n
CONFIG_MEBDTLS_LINKEDSEMI_OTBN_DELEGATION_SERVER=y

CONFIG_MBEDTLS_LOG_LEVEL_DBG=n
```

## src/main.c
```c
#include <string.h>
#include <stdio.h>
#include <zephyr/devicetree.h>
#include "mbedtls/threading.h"


#if defined(CONFIG_MEBDTLS_LINKEDSEMI_OTBN_DELEGATION_CLIENT)
void mbedtls_ls_otbn_delegation_client_chanels_init(void);
#else
void mbedtls_ls_otbn_delegation_server_chanels_init(void);
#endif

int main(void)
{
    mbedtls_ls_otbn_delegation_server_chanels_init();

    return 0;
}
```
